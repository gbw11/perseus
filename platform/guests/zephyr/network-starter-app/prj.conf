## CMakeLists.txt
```
# SPDX-License-Identifier: Apache-2.0
cmake_minimum_required(VERSION 3.20.5)
list(APPEND ZEPHYR_EXTRA_MODULES ${CMAKE_CURRENT_SOURCE_DIR}/../xen-store ${CMAKE_CURRENT_SOURCE_DIR}/../xen-runtime ${CMAKE_CURRENT_SOURCE_DIR}/../diagnostics ${CMAKE_CURRENT_SOURCE_DIR}/../telemetry)
find_package(Zephyr REQUIRED HINTS $ENV{ZEPHYR_BASE})
project(xenova_network_starter)
target_sources(app PRIVATE src/main.c)
target_sources_ifdef(CONFIG_XENOVA_DIAGNOSTICS app PRIVATE src/diagnostics.c)
target_sources_ifdef(CONFIG_XENOVA_DIAGNOSTICS_EXERCISE app PRIVATE src/exercise.c)
target_sources_ifdef(CONFIG_XENOVA_TELEMETRY app PRIVATE src/telemetry.c)
```

## Kconfig
```
# SPDX-License-Identifier: Apache-2.0
mainmenu "Xenova Network Starter"

config XENOVA_DIAGNOSTICS_EXERCISE
	bool "Optional 20ms periodic diagnostic exercise (no driving output)"
	default n
	depends on TIMER_HAS_64BIT_CYCLE_COUNTER
	help
	  Same fixed arithmetic workload with diagnostics on/off. Not a driving app.
	  Default firmware creates no periodic exercise thread.

source "Kconfig.zephyr"
```

## prj.conf
```kconfig
CONFIG_CONSOLE=y
CONFIG_PRINTK=y
CONFIG_BOOT_BANNER=n
CONFIG_TIMER_READS_ITS_FREQUENCY_AT_RUNTIME=y
CONFIG_XENOVA_XENSTORE=y
CONFIG_XEN_GRANT_TABLE=n
CONFIG_XENOVA_RUNTIME=y
CONFIG_XENOVA_NETFRONT=y
CONFIG_MAIN_STACK_SIZE=8192
CONFIG_HEAP_MEM_POOL_SIZE=65536
CONFIG_ASSERT=y
CONFIG_NETWORKING=y
CONFIG_NET_L2_ETHERNET=y
CONFIG_NET_IPV4=y
CONFIG_NET_IPV6=n
CONFIG_NET_ARP=y
CONFIG_NET_DHCPV4=y
CONFIG_NET_UDP=y
CONFIG_NET_TCP=y
CONFIG_NET_CONFIG_SETTINGS=n
CONFIG_NET_RX_STACK_SIZE=4096
CONFIG_NET_TX_STACK_SIZE=4096
CONFIG_NET_PKT_RX_COUNT=16
CONFIG_NET_PKT_TX_COUNT=16
CONFIG_NET_BUF_RX_COUNT=32
CONFIG_NET_BUF_TX_COUNT=32
CONFIG_NET_BUF_DATA_SIZE=256
CONFIG_SHELL=y
CONFIG_SHELL_STACK_SIZE=4096
CONFIG_SHELL_BACKEND_SERIAL=y
# Xen HVC poll_out drops bytes on a full ring; FIFO TX retries until consumed.
CONFIG_SHELL_BACKEND_SERIAL_API_INTERRUPT_DRIVEN=y
CONFIG_NET_SHELL=y
CONFIG_LOG=y
CONFIG_LOG_MODE_DEFERRED=y
CONFIG_THREAD_NAME=y
CONFIG_INIT_STACKS=y
CONFIG_THREAD_STACK_INFO=y
CONFIG_XENOVA_DIAGNOSTICS=y
CONFIG_XENOVA_TELEMETRY=y

# DHCP transaction IDs and diagnostic ping only; no cryptographic identity.
CONFIG_TEST_RANDOM_GENERATOR=y
CONFIG_TIMER_RANDOM_GENERATOR=y
```

## src/main.c
```c
/* SPDX-License-Identifier: Apache-2.0 */
/* Development Starter: standard Zephyr network stack, no driving state/output. */
#include <xenova/shutdown.h>
#include <xenova/netfront.h>
#include <xenova/runtime.h>
#include <zephyr/kernel.h>
#include <zephyr/sys/printk.h>
#include <zephyr/shell/shell.h>
#include <stdlib.h>
#include <string.h>
#include <stdatomic.h>
#include "diagnostics_app.h"
#if defined(CONFIG_XENOVA_TELEMETRY)
#include <xenova/telemetry.h>
int starter_telemetry_start(void);
#endif
#if defined(CONFIG_XENOVA_DIAGNOSTICS)
#include <xenova/diagnostics.h>
#endif
static atomic_int hook_mode;
static atomic_bool stopping;
static int64_t unwind_deadline;
K_MUTEX_DEFINE(starter_lifecycle_lock);
static struct k_spinlock admission_lock;
static bool admit(void) {
 k_spinlock_key_t key=k_spin_lock(&admission_lock);
 bool allowed=!atomic_load(&stopping);
 k_spin_unlock(&admission_lock,key);return allowed;
}
static int quiesce(const char *request,int64_t end,void *context) {
 ARG_UNUSED(context);
 int mode=hook_mode;
 if(mode==1)return -EBUSY;
 if(mode==2)return -EIO;
 if(mode==3){while(k_uptime_get()<end)k_sleep(K_MSEC(10));return -ETIMEDOUT;}
 if(k_uptime_get()>=end)return -ETIMEDOUT;
 k_spinlock_key_t key=k_spin_lock(&admission_lock);
 atomic_store(&stopping,true);
 k_spin_unlock(&admission_lock,key);xnet_stop_request();
 int64_t left=end-k_uptime_get();
 if(left<=0||k_mutex_lock(&starter_lifecycle_lock,K_MSEC(left)))return -ETIMEDOUT;
 k_mutex_unlock(&starter_lifecycle_lock);
 int rc=starter_exercise_stop(end);if(rc)return rc;
#if defined(CONFIG_XENOVA_TELEMETRY)
 rc=xt_stop(end);if(rc)return rc;
#endif
 printk("XENOVA demo quiesce %s: no vehicle output or driving state; hook completed\n",request);
 return 0;
}
static int unwind(int original) {
 if(!unwind_deadline)unwind_deadline=k_uptime_get()+CONFIG_XENOVA_SHUTDOWN_BUDGET_MS;
 int64_t end=unwind_deadline;
 int cleanup=xshutdown_stop(end);
 if(cleanup==-EBUSY)return original; /* External request already owns cleanup. */
 int rc=starter_exercise_stop(end);if(rc&&!cleanup)cleanup=rc;
#if defined(CONFIG_XENOVA_TELEMETRY)
 int publisher=xt_stop(end);if(publisher&&!cleanup)cleanup=publisher;
 if(publisher)rc=publisher;
#endif
 if(!rc){rc=xnet_close(end);if(rc&&!cleanup)cleanup=rc;}
 if(!cleanup)cleanup=xsr_close(end);
 starter_diag_boot("starter-cleanup",cleanup);
 printk("XENOVA Starter initialization rc=%d cleanup=%d; local diagnostics retained\n",original,cleanup);
 return original?original:cleanup;
}
int main(void) {
 k_mutex_lock(&starter_lifecycle_lock,K_FOREVER);
 starter_diag_boot("main-enter",0);
 int rc=xshutdown_start(quiesce,NULL);
 starter_diag_boot("shutdown-handler",rc);
 printk("XENOVA cooperative handler rc=%d\n",rc);
 if(rc||atomic_load(&stopping))goto failed;
 rc=xnet_start();
 starter_diag_network_result(rc);
 printk("XENOVA Ethernet startup rc=%d; DHCP/app readiness independent\n",rc);
 if(rc||atomic_load(&stopping))goto failed;
 if(!admit()){rc=-ECANCELED;goto failed;}
 rc=starter_exercise_start();
 starter_diag_boot("exercise-start",rc); /* Optional exercise is degradable. */
#if defined(CONFIG_XENOVA_TELEMETRY)
 if(admit()) {
  rc=starter_telemetry_start();
  starter_diag_boot("telemetry-start",rc); /* Local diagnostics remain usable. */
 }
#endif
 k_mutex_unlock(&starter_lifecycle_lock);
 return 0;
failed:
 atomic_store(&stopping,true);
 if(!rc)rc=-ECANCELED;
 k_mutex_unlock(&starter_lifecycle_lock);
 return unwind(rc);
}

static int stats_cmd(const struct shell *sh,size_t argc,char **argv) {
 if(argc==2&&!strcmp(argv[1],"waits")) {
  struct xnet_waits w;struct xnet_status s;
  int rc=xnet_waits_get(&w);if(rc)return rc;
  rc=xnet_status_get(&s);if(rc)return rc;
  shell_print(sh,"{\"clock\":\"%s\",\"started\":%s,\"connected\":%s,\"backend_observation\":%d,\"backend_error\":%d,\"observation_error\":%d,\"first_observation_error\":%d,\"backend_wait_stage\":%d,\"packet_polls\":%llu,\"pending_batches\":%llu,\"packet_gap_max_us\":%llu,\"packet_lock_wait_max_us\":%llu,\"packet_lock_hold_max_us\":%llu,\"packet_lock_timeouts\":%llu,\"packet_last_poll_ms\":%llu,\"packet_lock_first_error\":%d,\"store_observations\":%llu,\"store_lock_wait_max_us\":%llu,\"store_response_max_us\":%llu,\"store_unavailable\":%llu,\"store_recoveries\":%llu,\"last_backend_success_ms\":%llu}",
   w.cycle_clock?"cycles":"kernel_ticks",s.started?"true":"false",s.connected?"true":"false",s.backend_observation,s.backend_error,s.observation_error,s.first_observation_error,s.backend_wait_stage,
   (unsigned long long)w.packet_polls,(unsigned long long)w.pending_batches,(unsigned long long)w.packet_gap_max_us,
   (unsigned long long)w.packet_lock_wait_max_us,(unsigned long long)w.packet_lock_hold_max_us,
   (unsigned long long)w.packet_lock_timeouts,(unsigned long long)w.packet_last_poll_ms,w.packet_lock_first_error,
   (unsigned long long)w.store_observations,(unsigned long long)w.store_lock_wait_max_us,(unsigned long long)w.store_response_max_us,
   (unsigned long long)w.store_unavailable,(unsigned long long)w.store_recoveries,(unsigned long long)w.last_backend_success_ms);
  return 0;
 }
 if(argc!=1)return -EINVAL;
 ARG_UNUSED(argc);ARG_UNUSED(argv);struct xnf_stats v;int rc=xnet_stats(&v);if(rc)return rc;
 shell_print(sh,"{\"tx\":%u,\"rx\":%u,\"tx_drop\":%u,\"rx_drop\":%u,\"pool_busy\":%u,\"protocol_errors\":%u}",
             v.tx,v.rx,v.tx_drop,v.rx_drop,v.pool_busy,v.protocol_errors);return 0;
}
static int hook_cmd(const struct shell *sh,size_t argc,char **argv) {
 ARG_UNUSED(sh);if(argc!=2)return -EINVAL;
 if(!strcmp(argv[1],"normal"))hook_mode=0;
 else if(!strcmp(argv[1],"reject"))hook_mode=1;
 else if(!strcmp(argv[1],"fail"))hook_mode=2;
 else if(!strcmp(argv[1],"timeout"))hook_mode=3;
 else return -EINVAL;
 return 0;
}
SHELL_STATIC_SUBCMD_SET_CREATE(xenova_commands,
#if defined(CONFIG_XENOVA_TELEMETRY)
 SHELL_CMD(telemetry,NULL,"Publisher status; threads/history request an explicit snapshot",xt_shell_cmd),
#endif
#if defined(CONFIG_XENOVA_DIAGNOSTICS)
 SHELL_CMD(diag,NULL,"Local snapshot; add threads for intrusive stack analysis",xdiag_shell_cmd),
#endif
#if defined(CONFIG_XENOVA_DIAGNOSTICS_EXERCISE)
 SHELL_CMD(exercise,NULL,"Read common on/off benchmark observer",starter_exercise_cmd),
#endif
 SHELL_CMD(stats,NULL,"Netfront counters; waits for packet/Store observations",stats_cmd),
 SHELL_CMD(hook,NULL,"Development hook: normal/reject/fail/timeout",hook_cmd),
 SHELL_SUBCMD_SET_END);
SHELL_CMD_REGISTER(xenova,&xenova_commands,"Xenova development diagnostics",NULL);
```

## src/diagnostics.c
```c
/* SPDX-License-Identifier: Apache-2.0 */
/* The application adapts netfront counters; Diagnostics Core knows no Xen ABI. */
#include <xenova/diagnostics.h>
#include <xenova/netfront.h>
#include <zephyr/net/net_if.h>
#include <stdatomic.h>
#include <errno.h>
#include "diagnostics_app.h"

static atomic_int startup_rc = -EAGAIN;

static int network_snapshot(struct xdiag_network *out, void *context)
{
	ARG_UNUSED(context);
	int rc = atomic_load(&startup_rc);
	if (rc) { return rc; }
	struct xnf_stats stats;
	rc = xnet_stats_try(&stats);
	if (rc) { return rc; }
	struct net_if *iface = net_if_get_default();
	if (!iface) { return -ENODEV; }
	*out = (struct xdiag_network){
		.link_up = net_if_is_up(iface) && net_if_is_carrier_ok(iface),
		.tx = stats.tx, .rx = stats.rx, .tx_drop = stats.tx_drop,
		.rx_drop = stats.rx_drop, .pool_busy = stats.pool_busy,
		.protocol_errors = stats.protocol_errors,
		.tx_bytes=stats.tx_bytes,.rx_bytes=stats.rx_bytes,.counter_epoch=stats.counter_epoch,
		.bytes_rc=stats.bytes_saturated?-ERANGE:0,
	};
	return 0;
}

void starter_diag_boot(const char *stage, int rc) { (void)xdiag_boot(stage, rc); }

void starter_diag_network_result(int rc)
{
	atomic_store(&startup_rc, rc);
	(void)xdiag_network_register(network_snapshot, NULL);
	(void)xdiag_boot("ethernet-start", rc);
}
```

## src/diagnostics_app.h
```c
/* SPDX-License-Identifier: Apache-2.0 */
#ifndef XENOVA_STARTER_DIAGNOSTICS_H
#define XENOVA_STARTER_DIAGNOSTICS_H
#include <stdint.h>
#include <stddef.h>
#if defined(CONFIG_XENOVA_DIAGNOSTICS)
void starter_diag_network_result(int rc);
void starter_diag_boot(const char *stage, int rc);
#else
static inline void starter_diag_network_result(int rc) { (void)rc; }
static inline void starter_diag_boot(const char *stage, int rc) { (void)stage; (void)rc; }
#endif
#if defined(CONFIG_XENOVA_DIAGNOSTICS_EXERCISE)
struct shell;
int starter_exercise_start(void);
int starter_exercise_stop(int64_t deadline_ms);
int starter_exercise_cmd(const struct shell *, size_t argc, char **argv);
#else
static inline int starter_exercise_start(void) { return 0; }
static inline int starter_exercise_stop(int64_t deadline_ms) { (void)deadline_ms; return 0; }
#endif
#endif
```

## src/exercise.c
```c
/* SPDX-License-Identifier: Apache-2.0 */
/* Optional bounded arithmetic job. No drive.command, MQTT or vehicle output. */
#include <zephyr/kernel.h>
#include <stdatomic.h>
#include <zephyr/shell/shell.h>
#include <inttypes.h>
#if defined(CONFIG_XENOVA_DIAGNOSTICS)
#include <xenova/diagnostics.h>
static struct xdiag_loop measured;
#endif
#include "diagnostics_app.h"

K_THREAD_STACK_DEFINE(exercise_stack, 2048);
static struct k_thread exercise_thread;
static atomic_bool stopping;
static volatile uint32_t checksum;
static bool started;
K_MUTEX_DEFINE(exercise_lock);
/* Same outside-hook observer in both variants, solely for on/off comparison.
 * Aggregate only; its own cost remains present in both measured binaries. */
static struct k_spinlock observer_lock;
static struct {
	uint64_t completed, intervals, last_start, max_interval_us;
	uint64_t max_absolute_jitter_us, max_lateness_us, max_job_us;
} observer;

static void observe(uint64_t start, uint64_t finish, uint64_t release)
{
	k_spinlock_key_t key = k_spin_lock(&observer_lock);
	if (observer.completed) {
		uint64_t interval = start - observer.last_start;
		uint64_t jitter = interval > 20000 ? interval - 20000 : 20000 - interval;
		observer.max_interval_us = MAX(observer.max_interval_us, interval);
		observer.max_absolute_jitter_us = MAX(observer.max_absolute_jitter_us, jitter);
		++observer.intervals;
	}
	observer.last_start = start;
	observer.max_lateness_us = MAX(observer.max_lateness_us, start - release);
	observer.max_job_us = MAX(observer.max_job_us, finish - start);
	++observer.completed;
	k_spin_unlock(&observer_lock, key);
}

static void exercise(void *a, void *b, void *c)
{
	ARG_UNUSED(a); ARG_UNUSED(b); ARG_UNUSED(c);
	const uint64_t period = 20000;
	uint64_t next = k_cyc_to_us_floor64(k_cycle_get_64());
#if defined(CONFIG_XENOVA_DIAGNOSTICS)
	int rc = xdiag_loop_init(&measured, period, period);
	if (!rc) { rc = xdiag_loop_watch(&measured); }
	if (rc) { (void)xdiag_error("exercise-init", rc); return; }
	next = measured.timing.next_release_us;
#endif
	while (!atomic_load(&stopping)) {
		uint64_t now = k_cyc_to_us_floor64(k_cycle_get_64());
		if (now < next) { k_usleep(next - now); continue; }
#if defined(CONFIG_XENOVA_DIAGNOSTICS)
		rc = xdiag_loop_begin(&measured);
		if (rc) { (void)xdiag_error("exercise-begin", rc); break; }
#endif
		uint32_t value = checksum;
		for (unsigned i = 0; i < 128; ++i) { value = value * 1664525U + 1013904223U; }
		checksum = value;
#if defined(CONFIG_XENOVA_DIAGNOSTICS)
		rc = xdiag_loop_end(&measured);
		if (rc) { (void)xdiag_error("exercise-end", rc); break; }
#endif
		uint64_t end = k_cyc_to_us_floor64(k_cycle_get_64());
		observe(now, end, next);
		/* Identical scheduling/work in both builds, independent of measurement. */
		next += period;
		if (end > next) { next += ((end - next - 1) / period + 1) * period; }
	}
}

int starter_exercise_start(void)
{
	if (k_mutex_lock(&exercise_lock, K_NO_WAIT)) { return -EBUSY; }
	if (started || atomic_load(&stopping)) { k_mutex_unlock(&exercise_lock); return -EALREADY; }
	started = true;
	k_thread_create(&exercise_thread, exercise_stack, K_THREAD_STACK_SIZEOF(exercise_stack),
			exercise, NULL, NULL, NULL, 8, 0, K_NO_WAIT);
	(void)k_thread_name_set(&exercise_thread, "diag-exercise");
	k_mutex_unlock(&exercise_lock);
	return 0;
}

int starter_exercise_stop(int64_t deadline)
{
	if (k_current_get()==&exercise_thread) { return -EDEADLK; }
	atomic_store(&stopping, true);
	int64_t left = deadline - k_uptime_get();
	if (left <= 0 || k_mutex_lock(&exercise_lock, K_MSEC(left))) { return -ETIMEDOUT; }
	/* Join confirms the kernel no longer references this TCB/stack, including
	 * natural initialization failure. A final user signal alone cannot do so. */
	left = deadline - k_uptime_get();
	int rc = !started ? 0 : k_thread_join(&exercise_thread, left > 0 ? K_MSEC(left) : K_NO_WAIT);
	k_mutex_unlock(&exercise_lock);
	return rc ? -ETIMEDOUT : 0;
}

int starter_exercise_cmd(const struct shell *sh, size_t argc, char **argv)
{
	ARG_UNUSED(argv);
	if (argc != 1) { return -EINVAL; }
	k_spinlock_key_t key = k_spin_lock(&observer_lock);
	uint64_t completed = observer.completed, intervals = observer.intervals;
	uint64_t interval = observer.max_interval_us, jitter = observer.max_absolute_jitter_us;
	uint64_t lateness = observer.max_lateness_us, job = observer.max_job_us;
	k_spin_unlock(&observer_lock, key);
	shell_fprintf(sh, SHELL_NORMAL,
		"{\"diagnostics_enabled\":%s,\"period_us\":20000,\"completed\":%" PRIu64
		",\"interval_samples\":%" PRIu64 ",\"value\":", IS_ENABLED(CONFIG_XENOVA_DIAGNOSTICS) ?
		"true" : "false", completed, intervals);
	if (!completed) { shell_print(sh, "null}"); return 0; }
	shell_fprintf(sh, SHELL_NORMAL, "{\"max_job_with_hooks_us\":%" PRIu64
		",\"max_lateness_us\":%" PRIu64 ",\"max_interval_us\":", job, lateness);
	if (!intervals) { shell_fprintf(sh, SHELL_NORMAL, "null,\"max_absolute_jitter_us\":null"); }
	else { shell_fprintf(sh, SHELL_NORMAL, "%" PRIu64 ",\"max_absolute_jitter_us\":%" PRIu64,
		interval, jitter); }
	shell_print(sh, "}}");
	return 0;
}
```

## src/telemetry.c
```c
/* SPDX-License-Identifier: Apache-2.0 */
/* Own-domain bootstrap only. Host prepares a read-only, execution-bound node;
 * no identity or secret is compiled into this shared firmware. */
#include <xenova/telemetry.h>
#include <xenova/runtime.h>
#include <zephyr/version.h>
#include <errno.h>
#include <stdlib.h>
#include <string.h>
#include <stdio.h>

struct bootstrap_read { char own_vm[64],json[XS_VALUE_LIMIT+1]; };

static int read_transaction(struct xs_client *xs,uint32_t tx,int64_t end,void *context)
{
	struct bootstrap_read *value=context;char domid[16],path[128],*tail;
	int rc=xs_read_text(xs,tx,"domid",domid,sizeof(domid),xs_remaining(xs,end));
	if (rc) { return rc; }
	unsigned long id=strtoul(domid,&tail,10);
	if (!domid[0] || *tail || !id || id>0x7fef) { return -EPROTO; }
	(void)snprintf(path,sizeof(path),"/local/domain/%lu/vm",id);
	rc=xs_read_text(xs,tx,path,value->own_vm,sizeof(value->own_vm),xs_remaining(xs,end));
	if (rc) { return rc; }
	(void)snprintf(path,sizeof(path),"/local/domain/%lu/data/xenova-telemetry/bootstrap",id);
	return xs_read_text(xs,tx,path,value->json,sizeof(value->json),xs_remaining(xs,end));
}

static int bootstrap_load(struct xt_bootstrap *out,int64_t end,void *context)
{
	ARG_UNUSED(context);struct bootstrap_read input={0};
	int64_t left=end-k_uptime_get();if (left<=0) { return -ETIMEDOUT; }
	/* main's existing shutdown/runtime initialization owns opening the session.
	 * Avoid xsr_open's independent 1s lock budget inside this 500ms loader. */
	int rc=xsr_transaction((int)left,read_transaction,&input);
	if (!rc) {
		if (strncmp(input.own_vm,"/vm/",4)) { rc=-EACCES; }
		else { rc=xt_bootstrap_decode(input.json,strlen(input.json),input.own_vm+4,out); }
	}
	/* Input is mutable JSON and contains credentials. Never log or shell-print it. */
	for (volatile unsigned char *p=(volatile unsigned char *)&input;p<(volatile unsigned char *)&input+sizeof(input);++p) { *p=0; }
	return rc;
}

int starter_telemetry_start(void)
{
	static const struct xt_inventory info={.os_version=KERNEL_VERSION_STRING,
		.build_id="network-starter-telemetry-2.0",.task_id="diagnostic.exercise",.interface_name="netfront",
#if defined(CONFIG_XENOVA_DIAGNOSTICS_EXERCISE)
		.profile="diagnostic_exercise",
#else
		.profile="network_starter",
#endif
		.diagnostics=true,.publisher=true,.timing=IS_ENABLED(CONFIG_XENOVA_DIAGNOSTICS_TIMING),
		.threads=IS_ENABLED(CONFIG_XENOVA_DIAGNOSTICS_THREADS),.heap=IS_ENABLED(CONFIG_XENOVA_DIAGNOSTICS_HEAP)};
	return xt_start(bootstrap_load,NULL,&info);
}
```
