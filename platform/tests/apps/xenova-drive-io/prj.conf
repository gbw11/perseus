## CMakeLists.txt
```
cmake_minimum_required(VERSION 3.20.5)
set(PLATFORM ${CMAKE_CURRENT_SOURCE_DIR}/../../..)
list(APPEND ZEPHYR_EXTRA_MODULES ${PLATFORM}/guests/zephyr/diagnostics
  ${PLATFORM}/guests/zephyr/telemetry ${PLATFORM}/apps/common/xenova-mqtt-c
  ${PLATFORM}/apps/common/xenova-drive-runtime)
find_package(Zephyr REQUIRED HINTS $ENV{ZEPHYR_BASE})
project(xenova_drive_io)
# Compile the product exchange/owner unchanged, with real kernel locks/threads.
# Only Bootstrap, MQTT I/O and capture sink are external boundaries here.
if(TARGET xenova_drive_runtime)
  set_property(TARGET xenova_drive_runtime PROPERTY SOURCES ${PLATFORM}/apps/common/xenova-drive-runtime/src/io.c)
endif()
if(XL_INPUT_BOUNDARY)
  set(DRIVE ${PLATFORM}/apps/drive/zephyr/src)
  zephyr_link_libraries(-Wl,--wrap=xm_zclient_poll,--wrap=xm_zclient_close,--wrap=mqtt_readall_publish_payload,--wrap=mqtt_subscribe)
  target_include_directories(app PRIVATE ${DRIVE} ${PLATFORM}/apps/autonomous/zephyr/src ${PLATFORM}/apps/manual/zephyr/src)
  target_sources(app PRIVATE src/receive.c ${DRIVE}/adapter.c
    ${PLATFORM}/apps/autonomous/zephyr/src/autonomous.c ${PLATFORM}/apps/manual/zephyr/src/manual.c)
elseif(XL_NODELAY_BOUNDARY)
  # Real Zephyr TCP socket options; replace only the MQTT connection/peer I/O.
  zephyr_link_libraries(-Wl,--wrap=mqtt_connect,--wrap=mqtt_abort,--wrap=mqtt_live,--wrap=mqtt_publish,--wrap=z_impl_zsock_setsockopt)
  target_sources(app PRIVATE src/nodelay.c)
elseif(XL_CAPTURE_BOUNDARY)
  # Compile the real console/capture callbacks in the test translation unit;
  # only the authenticated-bootstrap setup and MQTT I/O boundary are fixtures.
  zephyr_link_libraries(-Wl,--wrap=xm_zclient_poll,--wrap=xm_zclient_publish_until,--wrap=xm_zclient_close)
  if(XL_CAPTURE_DRIVE_SOURCE)
    target_compile_definitions(app PRIVATE XL_CAPTURE_DRIVE_SOURCE="${XL_CAPTURE_DRIVE_SOURCE}")
  endif()
  target_sources(app PRIVATE src/capture.c)
elseif(XL_MQTT_BOUNDARY)
  zephyr_link_libraries(-Wl,--wrap=mqtt_publish,--wrap=mqtt_abort,--wrap=xt_socket_close)
  target_sources(app PRIVATE src/mqtt.c)
else()
  zephyr_link_libraries(-Wl,--wrap=xm_zclient_latest,--wrap=xm_zclient_poll,--wrap=xm_zclient_publish_until,--wrap=xm_zclient_close,--wrap=z_impl_k_thread_create,--wrap=xm_zclient_subscribe)
  if(XL_FAULT_BOUNDARY)
    # The real command owner/parser is tested; calculation and cached resource
    # evidence are external boundaries, not simulated application failures.
    zephyr_link_libraries(-Wl,--wrap=xm_zclient_publish)
  endif()
  target_sources(app PRIVATE src/main.c)
endif()
```

## prj.conf
```kconfig
CONFIG_XENOVA_DIAGNOSTICS=y
CONFIG_XENOVA_TELEMETRY=y
CONFIG_XENOVA_MQTT=y
CONFIG_XENOVA_DRIVE_RUNTIME=y
CONFIG_XENOVA_DRIVE_RECORDER=y
CONFIG_XENOVA_DRIVE_CAPTURE_ROWS=128
CONFIG_NETWORKING=y
CONFIG_NET_L2_ETHERNET=y
CONFIG_NET_IPV4=y
CONFIG_NET_IPV6=n
CONFIG_NET_ARP=y
CONFIG_NET_TCP=y
CONFIG_NET_SOCKETS=y
CONFIG_ETH_NATIVE_TAP=n
CONFIG_MAIN_STACK_SIZE=8192
CONFIG_HEAP_MEM_POOL_SIZE=65536
CONFIG_SHELL=y
CONFIG_SHELL_BACKEND_SERIAL=n
CONFIG_SHELL_BACKEND_DUMMY=y
CONFIG_SHELL_BACKEND_DUMMY_BUF_SIZE=4096
CONFIG_ASSERT=y
CONFIG_THREAD_NAME=y
CONFIG_TEST_RANDOM_GENERATOR=y
```

## fault-scope.conf
```kconfig
CONFIG_XENOVA_DRIVE_WORKERS=y
CONFIG_XENOVA_AUTO_DELAY_INJECTION=y
```

## nodelay.conf
```kconfig
CONFIG_XENOVA_DIAGNOSTICS=y
CONFIG_XENOVA_TELEMETRY=y
CONFIG_XENOVA_MQTT=y
CONFIG_NETWORKING=y
CONFIG_NET_L2_ETHERNET=y
CONFIG_NET_IPV4=y
CONFIG_NET_IPV6=n
CONFIG_NET_ARP=y
CONFIG_NET_TCP=y
CONFIG_NET_SOCKETS=y
CONFIG_ETH_NATIVE_TAP=n
CONFIG_MAIN_STACK_SIZE=8192
CONFIG_HEAP_MEM_POOL_SIZE=65536
CONFIG_ASSERT=y
CONFIG_TEST_RANDOM_GENERATOR=y
```

## src/main.c
```c
/* Product owner/exchange with real Zephyr thread/join; bounded I/O is injected. */
#include <xenova/drive_io.h>
#include <zephyr/sys/atomic.h>
#include <assert.h>
#include <errno.h>
#include <stdio.h>
#include <stdlib.h>
#include <string.h>
#include <stdatomic.h>
#if defined(CONFIG_XENOVA_AUTO_DELAY_INJECTION)
#include <xenova/auto_delay.h>
#endif
static const char *scenario;
static struct xm_zclient client;
static struct xd_inputs snapshot,previous;
static struct xd_candidate command;
static struct xd_delivery results[32];
static unsigned result_count,sends,beats,readies,closes;
static unsigned subscriptions,auto_beats,manual_beats;
static atomic_t block_poll,block_send,block_prepare;
static atomic_t new_sender,source_closed;
static atomic_bool connected=true;
K_SEM_DEFINE(entered,0,1);
K_SEM_DEFINE(release,0,1);
K_SEM_DEFINE(poll_entered,0,1);
static bool is(const char *s){return scenario&&!strcmp(scenario,s);}
#if defined(CONFIG_XENOVA_AUTO_DELAY_INJECTION)
/* Command/owner boundary only. Real calculation health and pool exhaustion
 * are exercised separately by workers and memory-native product tests. */
K_MUTEX_DEFINE(fault_results_lock);
static unsigned trust_events,fault_results,fault_starts;
static char fault_result[512],fault_status[12];
static int64_t injected_until;
int drive_auto_delay_start(uint32_t delay,uint32_t duration){
 assert(delay==2&&duration==1);fault_starts++;injected_until=k_uptime_get()+1000;return 0;
}
void drive_auto_delay_stop(void){injected_until=0;}
void drive_auto_delay_status_get(struct drive_auto_delay_status *out){
 *out=(struct drive_auto_delay_status){.active=k_uptime_get()<injected_until,
  .unhealthy=true,.consecutive_deadline_misses=5};
}
int __wrap_xm_zclient_publish(struct xm_zclient *c,const char *topic,const char *type,const char *json){
 ARG_UNUSED(c);ARG_UNUSED(topic);k_mutex_lock(&fault_results_lock,K_FOREVER);
 if(!strcmp(type,"vm.trust"))trust_events++;
 else {assert(!strcmp(type,"agent.command_result"));fault_results++;
  assert(strlen(json)<sizeof(fault_result));strcpy(fault_result,json);
  const char *states[]={"RUNNING","SUCCEEDED","FAILED","REJECTED"};
  for(unsigned i=0;i<ARRAY_SIZE(states);i++)if(strstr(json,states[i]))strcpy(fault_status,states[i]);
 }
 k_mutex_unlock(&fault_results_lock);return 0;
}
#endif
bool xd_owner_admit(void){return !atomic_get(&source_closed);}
k_tid_t __real_z_impl_k_thread_create(struct k_thread *,k_thread_stack_t *,size_t,k_thread_entry_t,void *,void *,void *,int,uint32_t,k_timeout_t);
k_tid_t __wrap_z_impl_k_thread_create(struct k_thread *t,k_thread_stack_t *stack,size_t size,k_thread_entry_t entry,void *a,void *b,void *c,int priority,uint32_t options,k_timeout_t delay) {
 if(is("start-fail"))return NULL;
 if(is("start-race")&&priority==CONFIG_XENOVA_DRIVE_IO_PRIORITY){k_sem_give(&entered);k_sem_take(&release,K_SECONDS(1));}
 return __real_z_impl_k_thread_create(t,stack,size,entry,a,b,c,priority,options,delay);
}
int xd_owner_prepare(struct xm_zclient *c,const char *control,const char *input) {
 assert(!strcmp(control,"control")&&!strcmp(input,"input"));
 if(atomic_get(&block_prepare)){k_sem_give(&entered);k_sem_take(&release,K_MSEC(500));}
 c->connected=connected;c->id.app_id="manual";
#if defined(CONFIG_XENOVA_AUTO_DELAY_INJECTION)
 c->id.vm_id="11111111-1111-4111-8111-111111111111";
 strcpy(c->id.boot_id,"22222222-2222-4222-8222-222222222222");
#endif
 return 0;
}
int __wrap_xm_zclient_poll(struct xm_zclient *c,int32_t ms) {
 k_sem_give(&poll_entered);
 if(atomic_get(&block_poll))k_sem_take(&release,(is("heartbeat-expire")||is("readiness-expire"))?K_SECONDS(2):K_MSEC(250));
 else k_sleep(K_MSEC(ms));
 c->connected=connected;
 return 0;
}
int __wrap_xm_zclient_latest(struct xm_zclient *c,const char *topic,struct xm_envelope *e,int64_t *age) {
#if defined(CONFIG_XENOVA_AUTO_DELAY_INJECTION)
 if(strstr(topic,"/command")){
  struct xm_zlatest *s=&c->latest[3];if(!s->len)return -ENODATA;
  *e=(struct xm_envelope){.type={"agent.command",13},.payload={s->data,s->len}};
  *age=k_uptime_get()-s->rx_ms;return 0;
 }
#endif
 unsigned i=!strcmp(topic,"control")?0:!strcmp(topic,"perception")?2:1;
 struct xm_zlatest *s=&c->latest[i];
 *e=(struct xm_envelope){.type={!i?"vehicle.control":i==2?"perception.result":"drive.input",!i?15:i==2?17:11},
  .payload={s->data,s->len},.seq=(int64_t)s->rx_ms+1,
  .source_id={"source",6},.boot_id={"11111111-1111-4111-8111-111111111111",36},
  .instance_id={"22222222-2222-4222-8222-222222222222",36}};
 if(!i&&atomic_get(&new_sender))e->instance_id=(struct xm_span){"44444444-4444-4444-8444-444444444444",36};
 *age=k_uptime_get()-s->rx_ms;return 0;
}
int __wrap_xm_zclient_subscribe(struct xm_zclient *c,const char *topic,uint8_t qos) {
#if defined(CONFIG_XENOVA_AUTO_DELAY_INJECTION)
 if(strstr(topic,"/command")){assert(qos==1);strcpy(c->latest[3].topic,topic);return 0;}
#endif
 ARG_UNUSED(c);assert(!strcmp(topic,"perception")&&qos==0);subscriptions++;return 0;
}
int __wrap_xm_zclient_publish_until(struct xm_zclient *c,const char *topic,const char *type,const char *json,int64_t end) {
 assert(end>k_uptime_get());
 char before[160];strcpy(before,json);
 if(is("wake"))k_sem_give(&entered);
 if(atomic_get(&block_send)){k_sem_give(&entered);k_sem_take(&release,K_MSEC(250));}
 assert(!strcmp(before,json)); /* In-flight bytes are never replaced. */
 if(!strcmp(type,"app.readiness")){readies++;}
 else if(!strcmp(type,"app.heartbeat")){
  beats++;
  if(!strcmp(topic,"xenova/v1/apps/autonomous/events"))auto_beats++;
  if(!strcmp(topic,"xenova/v1/apps/manual/events"))manual_beats++;
 }
 else if(!strcmp(type,"perception.event")&&is("events-starve")) {
  /* A continuously replenished external event source must not starve the
   * one heartbeat generated by main. Never synthesize another heartbeat. */
  int rc=xd_io_report(topic,type,"{}",1,&snapshot);
  assert(!rc||rc==-ESHUTDOWN);
 }
 else if(!strcmp(type,"drive.command"))sends++;
 c->message_counter++;strcpy(c->pubs[0].topic,topic);c->pubs[0].seq++;
 return is("send-fail")?-ETIMEDOUT:0;
}
void __wrap_xm_zclient_close(struct xm_zclient *c){c->connected=false;closes++;}
void xd_delivery_record(const struct xd_delivery *d){assert(result_count<ARRAY_SIZE(results));results[result_count++]=*d;}
static void update(void) {
 strcpy(client.latest[0].topic,"control");strcpy(client.latest[0].data,"{\"generation\":1}");client.latest[0].len=strlen(client.latest[0].data);
 strcpy(client.latest[1].topic,"input");strcpy(client.latest[1].data,"{\"keys\":[\"up\"]}");client.latest[1].len=strlen(client.latest[1].data);
 client.latest[0].rx_ms=client.latest[1].rx_ms=k_uptime_get();
 strcpy(client.latest[2].topic,"perception");strcpy(client.latest[2].data,"{}");client.latest[2].len=2;
}
static void read_ready(void) {
 int64_t end=k_uptime_get()+1000;
 do {k_sleep(K_MSEC(10));assert(!xd_io_snapshot(&snapshot));}while((!snapshot.connected||!snapshot.input.length)&&k_uptime_get()<end);
 assert(snapshot.connected&&snapshot.input.length);
}
static void candidate(unsigned id) {
 command=(struct xd_candidate){.id=id,.created_us=(uint64_t)k_uptime_get()*1000,
  .queued_us=(uint64_t)k_uptime_get()*1000,.control_revision=snapshot.control_revision,
  .connection_revision=snapshot.connection_revision,.expires_ms=k_uptime_get()+200};
 strcpy(command.topic,"events");snprintf(command.json,sizeof(command.json),"{\"generation\":1,\"id\":%u}",id);
}
static void freeze(void){atomic_set(&block_poll,1);k_sem_reset(&poll_entered);assert(!k_sem_take(&poll_entered,K_SECONDS(1)));}
static void unfreeze(void){atomic_set(&block_poll,0);k_sem_give(&release);}
K_THREAD_STACK_DEFINE(stop_stack,2048);
static struct k_thread stopper;
static void stop_during_create(void *a,void *b,void *c) {
 ARG_UNUSED(a);ARG_UNUSED(b);ARG_UNUSED(c);
 assert(!k_sem_take(&entered,K_SECONDS(1)));xd_io_stop_request();k_sem_give(&release);
}
int main(void) {
 scenario=getenv("XL_CASE");assert(scenario);update();
 if(is("start-race"))k_thread_create(&stopper,stop_stack,K_THREAD_STACK_SIZEOF(stop_stack),stop_during_create,NULL,NULL,NULL,6,0,K_NO_WAIT);
 if(is("prepare-delay")||is("stop-prepare"))atomic_set(&block_prepare,1);
 int64_t begin=k_uptime_get();int rc=is("dual")?xd_io_start_dual(&client,"control","input","perception"):xd_io_start(&client,"control","input");
 if(is("start-fail")){assert(rc==-ENOMEM);assert(!xd_io_join(k_uptime_get()+100));assert(!closes);puts("PASS owner start failure");exit(0);}
 if(is("start-race")){
  assert(!rc);assert(!k_thread_join(&stopper,K_SECONDS(1)));assert(!xd_io_join(k_uptime_get()+1000));
  struct xd_io_stats s;assert(!xd_io_stats_get(&s));assert(s.started&&s.joined&&!closes&&!sends);puts("PASS late owner creation is owned and joined");exit(0);
 }
 assert(!rc&&k_uptime_get()-begin<20);
 if(atomic_get(&block_prepare)) {
  assert(!k_sem_take(&entered,K_SECONDS(1)));
  for(unsigned i=0;i<5;i++){assert(!xd_io_snapshot(&snapshot));k_sleep(K_MSEC(20));}
  assert(!sends&&!beats);
  if(is("stop-prepare")){xd_io_stop_request();assert(xd_io_join(k_uptime_get()+10)<0);}
  atomic_set(&block_prepare,0);k_sem_give(&release);
 } else {
  read_ready();previous=snapshot;
  if(is("fault-scope")) {
#if defined(CONFIG_XENOVA_AUTO_DELAY_INJECTION)
   freeze();struct xm_zlatest *s=&client.latest[3];assert(s->topic[0]);
   snprintf(s->data,sizeof(s->data),"{\"command_id\":\"test-1\",\"operation_id\":\"op-1\",\"expected_boot_id\":\"22222222-2222-4222-8222-222222222222\",\"expires_at\":\"2026-11-07T00:00:00Z\",\"action\":\"auto_delay\",\"parameters\":{\"delay_ms\":2,\"duration_s\":1}}");
   s->len=strlen(s->data);s->rx_ms=k_uptime_get();unfreeze();
   int64_t until=k_uptime_get()+1500;
   for(;;){
    k_mutex_lock(&fault_results_lock,K_FOREVER);bool done=fault_results>=2;k_mutex_unlock(&fault_results_lock);
    if(done||k_uptime_get()>=until)break;k_sleep(K_MSEC(10));
   }
   freeze();assert(fault_results==2&&fault_starts==1&&!trust_events);
   assert(strstr(fault_result,"test-1")&&strstr(fault_result,"op-1"));
   assert(!strcmp(fault_status,"SUCCEEDED"));
   /* Same request replays the original failure, never a second injection. */
   s->rx_ms++;unfreeze();k_sleep(K_MSEC(30));freeze();
   assert(fault_results==3&&fault_starts==1&&!trust_events);
   assert(strstr(fault_result,"test-1")&&strstr(fault_result,"op-1"));
   unfreeze();candidate(1);assert(!xd_io_command(&command));k_sleep(K_MSEC(30));assert(sends==1);
#else
   assert(false);
#endif
  } else if(is("dual")) {
   assert(snapshot.dual_mode&&!snapshot.perception.error&&snapshot.perception.length==2);
   assert(subscriptions==1);
   assert(xd_io_start(&client,"control","input")==-EINVAL);
   assert(!xd_io_start_dual(&client,"control","input","perception"));
   freeze();
   assert(!xd_io_report("xenova/v1/apps/manual/events","app.heartbeat","{}",1,&snapshot));
   assert(!xd_io_report("xenova/v1/apps/autonomous/events","app.heartbeat","{}",1,&snapshot));
   unfreeze();k_sleep(K_MSEC(100));
   assert(auto_beats==1&&manual_beats==1&&subscriptions==1);
  } else if(is("wake")) {
   k_sem_reset(&poll_entered);assert(!k_sem_take(&poll_entered,K_SECONDS(1)));
   candidate(1);int64_t before=k_uptime_get();assert(!xd_io_command(&command));
   assert(!k_sem_take(&entered,K_MSEC(5)));assert(k_uptime_get()==before);
  } else if(is("snapshot")||is("age")||is("malformed")) {
   freeze();
   if(is("malformed")){strcpy(client.latest[1].data,"{bad}");client.latest[1].len=5;client.latest[1].rx_ms++;}
   else {strcpy(client.latest[1].data,"{\"keys\":[]}");client.latest[1].len=strlen(client.latest[1].data);}
   unfreeze();k_sleep(K_MSEC(30));assert(!xd_io_snapshot(&snapshot));
   assert(!strcmp(previous.input.payload,"{\"keys\":[\"up\"]}"));
   assert(snapshot.input.received_ms==client.latest[1].rx_ms);
   if(is("age"))assert(k_uptime_get()-snapshot.input.received_ms>=20);
   if(is("malformed"))assert(!strcmp(snapshot.input.payload,"{bad}"));
  } else if(is("reconnect-input-first")) {
   freeze();connected=false;unfreeze();k_sleep(K_MSEC(30));
   assert(!xd_io_snapshot(&snapshot)&&!snapshot.connected);
   freeze();connected=true;client.latest[1].rx_ms=k_uptime_get();
   strcpy(client.latest[1].data,"{\"keys\":[]}");client.latest[1].len=strlen(client.latest[1].data);
   unfreeze();read_ready();
   assert(snapshot.connection_revision>=previous.connection_revision+2);
   assert(snapshot.control.seq==previous.control.seq);
   assert(snapshot.control.received_ms==previous.control.received_ms);
   assert(snapshot.input.received_ms>previous.input.received_ms);
   candidate(1);command.connection_revision=previous.connection_revision;
   assert(xd_io_command(&command)==-EXDEV); /* old candidate cannot cross reconnect */
   candidate(2);assert(!xd_io_command(&command));k_sleep(K_MSEC(60));
  } else if(is("inflight")||is("stop-send")||is("join-timeout")) {
   atomic_set(&block_send,1);candidate(1);assert(!xd_io_command(&command));
   assert(!k_sem_take(&entered,K_SECONDS(1)));
   if(is("inflight")){candidate(2);assert(!xd_io_command(&command));candidate(3);assert(!xd_io_command(&command));}
   else {xd_io_stop_request();if(is("join-timeout"))assert(xd_io_join(k_uptime_get()+10)<0);}
   atomic_set(&block_send,0);k_sem_give(&release);k_sleep(K_MSEC(60));
  } else {
   freeze();candidate(1);
   if(is("expire"))command.expires_ms=k_uptime_get()+5;
   assert(!xd_io_command(&command));
   if(is("replace")){candidate(2);assert(!xd_io_command(&command));candidate(3);assert(!xd_io_command(&command));}
   if(is("context")){strcpy(client.latest[0].data,"{\"generation\":2}");client.latest[0].len=strlen(client.latest[0].data);client.latest[0].rx_ms++;}
   if(is("same-control"))client.latest[0].rx_ms++;
   if(is("identity"))atomic_set(&new_sender,1);
   if(is("stop-guard"))atomic_set(&source_closed,1);
   if(is("disconnect"))connected=false;
   if(is("heartbeat")){assert(xd_io_report("events","app.heartbeat","{}",0,&snapshot)==-EINVAL);assert(!xd_io_report("events","app.heartbeat","{\"uptime_s\":1}",1,&snapshot));}
   if(is("events-full")){
    for(unsigned i=0;i<4;i++)assert(!xd_io_report("events","perception.event","{}",1,&snapshot));
    assert(xd_io_report("events","perception.event","{}",1,&snapshot)==-ENOBUFS);
   }
   if(is("events-starve")) {
    for(unsigned i=0;i<4;i++)assert(!xd_io_report("events","perception.event","{}",1,&snapshot));
    assert(!xd_io_report("events","app.heartbeat","{\"uptime_s\":1}",1,&snapshot));
   }
   if(is("heartbeat-expire")) {
    assert(!xd_io_report("events","app.heartbeat","{\"uptime_s\":1}",1,&snapshot));
    k_sleep(K_MSEC(1100));
   }
   if(is("readiness")||is("readiness-expire")){
    assert(!xd_io_report("events","app.readiness","{\"progress_seq\":\"1\"}",1,&snapshot));
    assert(!xd_io_report("events","app.readiness","{\"progress_seq\":\"2\"}",2,&snapshot));
    if(is("readiness-expire"))k_sleep(K_MSEC(350));
   }
   if(is("producer-readiness")||is("producer-heartbeat")){
    bool ready=is("producer-readiness");int64_t lifetime=ready?300:1000;
    const char *type=ready?"app.readiness":"app.heartbeat";
    /* Receipt by the coordinator must not renew the actual producer's age. */
    k_sleep(K_MSEC(lifetime+1));int64_t now=k_uptime_get();
    assert(xd_io_report_at("events",type,"{}",1,&snapshot,now+1)==-EINVAL);
    assert(xd_io_report_at("events",type,"{}",1,&snapshot,now-lifetime)==-ETIME);
    assert(!xd_io_report_at("events",type,"{}",1,&snapshot,now-lifetime+50));
    k_sleep(K_MSEC(70));
   }
   if(is("expire"))k_sleep(K_MSEC(20));
   unfreeze();k_sleep(K_MSEC(120));
   if(is("heartbeat")){assert(beats==1);k_sleep(K_MSEC(100));assert(beats==1);}
   if(is("events-starve")){assert(beats==1);k_sleep(K_MSEC(100));assert(beats==1);}
  }
 }
 assert(!xd_io_join(k_uptime_get()+1000));
 struct xd_io_stats stats;assert(!xd_io_stats_get(&stats));assert(stats.started&&stats.joined&&closes==1);
 if(is("replace"))assert(stats.enqueued==3&&stats.replaced==2&&sends==1);
 if(is("inflight"))assert(stats.enqueued==3&&stats.replaced==1&&sends==2);
 if(is("context")||is("disconnect")||is("identity"))assert(!sends&&stats.context_dropped==1);
 if(is("same-control"))assert(sends==1&&!stats.context_dropped);
 if(is("stop-guard"))assert(!sends&&stats.stopped==1);
 if(is("expire"))assert(!sends&&stats.expired==1);
 if(is("send-fail"))assert(stats.failed==1&&stats.sent==0);
 if(is("events-full"))assert(stats.event_dropped>=1);
 if(is("heartbeat-expire"))assert(!beats&&!stats.event_dropped&&stats.heartbeat_dropped==1&&stats.heartbeat_expired==1);
 if(is("readiness"))assert(readies==1&&stats.readiness_replaced==1&&!stats.heartbeat_replaced);
 if(is("readiness-expire"))assert(!readies&&stats.readiness_dropped==1&&stats.readiness_expired==1&&!stats.heartbeat_dropped&&!stats.event_dropped);
 if(is("producer-readiness"))assert(!readies&&stats.readiness_expired==1&&!stats.event_dropped);
 if(is("producer-heartbeat"))assert(!beats&&stats.heartbeat_expired==1&&!stats.event_dropped);
 if(is("reconnect-input-first"))assert(sends==1);
 candidate(9);assert(xd_io_command(&command)==-ESHUTDOWN);
 assert(xd_io_start(&client,"control","input")==-ESHUTDOWN);
 printf("PASS real owner/exchange %s enqueued=%llu replaced=%llu sent=%llu failed=%llu records=%u\n",scenario,
  (unsigned long long)stats.enqueued,(unsigned long long)stats.replaced,(unsigned long long)stats.sent,(unsigned long long)stats.failed,result_count);
 exit(0);
}
```

## src/capture.c
```c
/* Real recorder and I/O owner; delay only the external MQTT completion. */
#include <assert.h>
#include <errno.h>
#include <stdio.h>
#include <stdlib.h>
#include <zephyr/shell/shell_dummy.h>
#ifndef XL_CAPTURE_DRIVE_SOURCE
#define XL_CAPTURE_DRIVE_SOURCE "../../../../apps/common/xenova-drive-runtime/src/runtime.c"
#endif
#include XL_CAPTURE_DRIVE_SOURCE

static struct xm_zclient test_client;
K_SEM_DEFINE(send_entered, 0, 1);
K_SEM_DEFINE(send_release, 0, 1);

int __wrap_xm_zclient_poll(struct xm_zclient *client, int32_t timeout)
{
	ARG_UNUSED(client); ARG_UNUSED(timeout); return 0;
}
int __wrap_xm_zclient_publish_until(struct xm_zclient *client, const char *topic,
		const char *type, const char *json, int64_t deadline)
{
	ARG_UNUSED(topic); ARG_UNUSED(json);
	assert(!strcmp(type, "drive.command") && deadline > k_uptime_get());
	k_sem_give(&send_entered);
	assert(!k_sem_take(&send_release, K_MSEC(150)));
	client->message_counter++;
	return 0;
}
void __wrap_xm_zclient_close(struct xm_zclient *client) { client->connected = false; }

int main(void)
{
	/* The fixture supplies a bootstrapped/CONNACKed client, not real broker
	 * authentication evidence. Capture, exchange, thread, clock and shell
	 * callback code remain the product implementation. */
	app = "manual";
	struct xm_zconfig cfg = {.host="192.0.2.1", .port=1883,
		.boot_id="11111111-1111-4111-8111-111111111111",
		.instance_id="22222222-2222-4222-8222-222222222222"};
	assert(!xm_zclient_init(&test_client,"33333333-3333-4333-8333-333333333333",NULL,app,&cfg));
	test_client.connected = true; client_ready = true; app_client = &test_client;
	strcpy(app_bootstrap.identity.vm_id,"33333333-3333-4333-8333-333333333333");
	strcpy(app_bootstrap.identity.execution_id,"44444444-4444-4444-8444-444444444444");
	assert(!xdiag_loop_init(&loop, 20000, 20000));
	assert(!xd_client_prepare(&test_client,"control","input"));
	for (unsigned i=0; i<20; i++) {
		struct xd_inputs state; assert(!xd_io_snapshot(&state));
		if (state.connected) { break; }
		k_sleep(K_MSEC(10));
	}
	char *arm[] = {"drive","capture","0","20"};
	assert(!drive_cmd(NULL,4,arm));
	assert(!xd_iteration_begin() && !xd_step_begin() && !xd_step_end());
	xd_command(&test_client,"events","{}",2,0,0,0,-1,-1,0,200);
	assert(!current.rc && !k_sem_take(&send_entered,K_MSEC(100)));
	k_sleep(K_MSEC(30)); xd_iteration_end();
	assert(capture_complete); /* The calculation window has ended. */
	char *transmissions[] = {"drive","transmissions","0","1"};
	char *records[] = {"drive","records","0","1"};
	assert(drive_cmd(NULL,4,transmissions)==-EBUSY);
	assert(drive_cmd(NULL,4,records)==-EBUSY);
	assert(drive_cmd(NULL,4,arm)==-EBUSY); /* no reset across in-flight work */
	k_sem_give(&send_release);
	assert(!xd_io_join(k_uptime_get()+1000));
	assert(!drive_cmd(NULL,4,transmissions));
	size_t sealed_count=delivery_count;
	assert(sealed_count==1 && !drive_cmd(NULL,4,transmissions));
	assert(delivery_count==sealed_count && !drive_cmd(NULL,4,records));
	const struct shell *sh=shell_backend_dummy_get_ptr(); assert(sh);
	for (unsigned page=0; page<2; page++) {
		shell_backend_dummy_clear_output(sh);
		assert(!shell_execute_cmd(sh,"xenova drive transmissions 0 1"));
		size_t bytes; const char *output=shell_backend_dummy_get_output(sh,&bytes);
		assert(bytes && strstr(output,"XD_PAGE {\"offset\":0,\"next\":1,\"total\":1}"));
		assert(strstr(output,"\"transmissions_complete\":true"));
		printf("PAGE_EVIDENCE %.*s\n",(int)bytes,output);
	}
	const char *streams[]={"records","transmissions"};
	for(unsigned i=0;i<ARRAY_SIZE(streams);i++){
		char command[64];snprintf(command,sizeof(command),"xenova drive %s 0 4",streams[i]);
		shell_backend_dummy_clear_output(sh);assert(!shell_execute_cmd(sh,command));
		size_t bytes;const char *output=shell_backend_dummy_get_output(sh,&bytes);
		printf("COLLECT_BEGIN %s\n%.*s\nCOLLECT_END %s\n",streams[i],(int)bytes,output,streams[i]);
	}
	puts("PASS window ended before socket completion; no premature pages/reset; sealed transmission total stable");
	exit(0);
}
```

## src/mqtt.c
```c
/* Real v1 encoder/owner code; only MQTT/TCP submission and close are replaced. */
#include <xenova/drive_io.h>
#include <assert.h>
#include <errno.h>
#include <stdio.h>
#include <stdlib.h>
#include <string.h>
static struct xm_zclient c;
static unsigned writes,aborts,closes;
static bool fail=true;
static int64_t ceiling;
int __wrap_mqtt_publish(struct mqtt_client *m,const struct mqtt_publish_param *p) {
 assert(m==&c.mqtt&&p->message.payload.len>0);
 assert(c.socket_io.deadline_ms==ceiling);writes++;
 return fail?-ETIMEDOUT:0;
}
int __wrap_mqtt_abort(struct mqtt_client *m){assert(m==&c.mqtt);aborts++;return 0;}
int __wrap_xt_socket_close(struct xt_socket *s){assert(s==&c.socket_io);closes++;s->fd=-1;return 0;}
int main(void) {
 struct xm_zconfig cfg={.host="192.0.2.1",.port=1883,.boot_id="11111111-1111-4111-8111-111111111111",.instance_id="22222222-2222-4222-8222-222222222222"};
 assert(!xm_zclient_init(&c,"33333333-3333-4333-8333-333333333333",NULL,"manual",&cfg));
 c.connected=c.socket_open=true;c.socket_io.fd=9;
 ceiling=k_uptime_get()+100;
 const char *topic="xenova/v1/apps/manual/events";
 const char *payload="{\"generation\":1,\"v_mps\":1,\"steer_rad\":0}";
 assert(xm_zclient_publish_until(&c,topic,"drive.command",payload,ceiling)==-ETIMEDOUT);
 assert(writes==1&&aborts==1&&closes==1&&!c.connected&&!c.socket_open&&c.socket_io.fd==-1);
 assert(c.message_counter==1&&c.published==0&&c.pubs[0].seq==0&&c.retry_at_ms>k_uptime_get());
 assert(!c.publish_deadline_ms);
 assert(xm_zclient_publish_until(&c,topic,"drive.command",payload,k_uptime_get())==-ETIMEDOUT);
 assert(writes==1&&c.message_counter==1);
 assert(xm_zclient_publish_until(&c,topic,"drive.command",payload,ceiling)==-ENOTCONN);
 assert(writes==1&&c.message_counter==1);
 fail=false;c.connected=c.socket_open=true;c.socket_io.fd=10;
 assert(!xm_zclient_publish_until(&c,topic,"drive.command",payload,ceiling));
 assert(writes==2&&c.message_counter==2&&c.published==1&&c.pubs[0].seq==1);
 puts("PASS production MQTT remaining deadline, partial-frame close, no automatic retry, v1 sequences");exit(0);
}
```

## src/nodelay.c
```c
/* Real v1 connect/retry and Zephyr TCP options; only the MQTT peer is replaced. */
#include "xm_zclient.h"
#include <assert.h>
#include <errno.h>
#include <stdio.h>
#include <stdlib.h>

static struct xm_zclient client;
static unsigned connections, options, closes, writes;
static int connect_error;
static bool option_failure;

static int socket_fd(void)
{
#if defined(CONFIG_XENOVA_MQTT_BOUNDED_IO)
	return client.socket_io.fd;
#else
	return client.mqtt.transport.tcp.sock;
#endif
}

static void set_socket_fd(int fd)
{
#if defined(CONFIG_XENOVA_MQTT_BOUNDED_IO)
	client.socket_io.fd = fd;
#else
	client.mqtt.transport.tcp.sock = fd;
#endif
}

static int nodelay(void)
{
	int value = -1;
	net_socklen_t length = sizeof(value);
	assert(!zsock_getsockopt(socket_fd(), NET_IPPROTO_TCP, ZSOCK_TCP_NODELAY,
				 &value, &length));
	assert(length == sizeof(value));
	return value;
}

int __wrap_mqtt_connect(struct mqtt_client *mqtt)
{
	assert(mqtt == &client.mqtt);
	connections++;
	if (connect_error) { return connect_error; }
	set_socket_fd(zsock_socket(NET_AF_INET, NET_SOCK_STREAM, NET_IPPROTO_TCP));
	assert(socket_fd() >= 0 && nodelay() == 0);
	return 0;
}

int __real_z_impl_zsock_setsockopt(int, int, int, const void *, net_socklen_t);
int __wrap_z_impl_zsock_setsockopt(int fd, int level, int name, const void *value,
			   net_socklen_t length)
{
	assert(fd == socket_fd() && level == NET_IPPROTO_TCP && name == ZSOCK_TCP_NODELAY);
	assert(length == sizeof(int) && *(const int *)value == 1);
	assert(!client.socket_open && !client.connected);
	options++;
	if (option_failure) { errno = ENOPROTOOPT; return -1; }
	return __real_z_impl_zsock_setsockopt(fd, level, name, value, length);
}

int __wrap_mqtt_abort(struct mqtt_client *mqtt)
{
	assert(mqtt == &client.mqtt);
	if (socket_fd() >= 0) {
		assert(!zsock_close(socket_fd()));
		set_socket_fd(-1);
		closes++;
	}
	return 0;
}

int __wrap_mqtt_live(struct mqtt_client *mqtt)
{
	assert(mqtt == &client.mqtt);
	return -EAGAIN;
}

int __wrap_mqtt_publish(struct mqtt_client *mqtt, const struct mqtt_publish_param *message)
{
	assert(mqtt == &client.mqtt && message->message.payload.len > 0 && nodelay() == 1);
	writes++;
	return 0;
}

int main(void)
{
	struct xm_zconfig config = {.host="192.0.2.1", .port=1883,
		.boot_id="11111111-1111-4111-8111-111111111111",
		.instance_id="22222222-2222-4222-8222-222222222222"};
	assert(!xm_zclient_init(&client, "33333333-3333-4333-8333-333333333333",
				NULL, "manual", &config));
	set_socket_fd(-1);
	for (unsigned attempt = 1; attempt <= 2; attempt++) {
		client.retry_at_ms = 0; /* Skip the existing backoff only in this test. */
		assert(!xm_zclient_poll(&client, 0));
		assert(connections == attempt && options == attempt && client.socket_open);
		assert(nodelay() == 1);
		client.connected = true; /* The peer's successful CONNACK boundary. */
		assert(!xm_zclient_publish(&client, "xenova/v1/apps/manual/events", "drive.command",
			"{\"generation\":1,\"v_mps\":1,\"steer_rad\":0}"));
		xm_zclient_close(&client);
		assert(socket_fd() == -1 && closes == attempt);
	}
	assert(writes == 2);
	client.retry_at_ms = 0;
	option_failure = true;
	assert(xm_zclient_poll(&client, 0) == -ENOTCONN);
	assert(connections == 3 && options == 3 && closes == 3 && writes == 2);
	assert(!client.socket_open && !client.connected && socket_fd() == -1);
	assert(client.last_io_rc == -ENOPROTOOPT && client.retry_at_ms > k_uptime_get());
	assert(xm_zclient_poll(&client, 0) == -ENOTCONN && connections == 3);
	option_failure = false;
	client.retry_at_ms = 0;
	assert(!xm_zclient_poll(&client, 0) && nodelay() == 1);
	xm_zclient_close(&client);
	assert(connections == 4 && options == 4 && closes == 4);
	client.retry_at_ms = 0;
	connect_error = -ECONNREFUSED;
	assert(xm_zclient_poll(&client, 0) == -ENOTCONN);
	assert(connections == 5 && options == 4 && closes == 4 && writes == 2);
	assert(client.last_io_rc == -ECONNREFUSED && !client.socket_open);
	puts("PASS real TCP_NODELAY=1 on initial/reconnected v1 sockets; option failure closes and retries");
	exit(0);
}
```

## src/receive.c
```c
/* Actual MQTT event/decoder/sequence/cache + io owner thread + C adapter.
 * Only peer payload delivery, socket polling and Bootstrap are substituted. */
#include <xenova/drive_io.h>
#include "adapter.h"
#include <assert.h>
#include <errno.h>
#include <stdio.h>
#include <stdlib.h>
#include <string.h>
#define A "aaaaaaaa-aaaa-4aaa-8aaa-aaaaaaaaaaaa"
#define B "bbbbbbbb-bbbb-4bbb-8bbb-bbbbbbbbbbbb"
static struct xm_zclient client;
static struct xm_identity sender;
static bool prepared;
static const char *incoming;
static size_t incoming_length;
struct frame {const char *topic,*type,*payload;unsigned seq;};
static struct frame frames[3];
static unsigned count;
static char encoded[2048];
static struct xd_inputs snapshot;
K_SEM_DEFINE(inject,0,1);
K_SEM_DEFINE(injected,0,1);
static struct xm_span span(const char *p){return (struct xm_span){p,strlen(p)};}
bool xd_owner_admit(void){return true;}
int xd_owner_prepare(struct xm_zclient *c,const char *control,const char *input)
{
 if(!prepared){
  struct xm_zconfig cfg={.host="127.0.0.1",.port=1883,.boot_id=A,.instance_id=B};
  assert(!xm_zclient_init(c,A,NULL,"drive-controller",&cfg));
  assert(!xm_zclient_subscribe(c,control,1));assert(!xm_zclient_subscribe(c,input,0));
  c->connected=true;prepared=true;
 }
 return 0;
}
int __wrap_mqtt_subscribe(struct mqtt_client *c,const struct mqtt_subscription_list *list)
{ARG_UNUSED(c);ARG_UNUSED(list);return 0;}
int __wrap_mqtt_readall_publish_payload(struct mqtt_client *c,uint8_t *out,size_t n)
{ARG_UNUSED(c);assert(n==incoming_length);memcpy(out,incoming,n);return 0;}
int __wrap_xm_zclient_poll(struct xm_zclient *c,int32_t timeout)
{
 ARG_UNUSED(timeout);
 if(k_sem_take(&inject,K_NO_WAIT))return 0;
 for(unsigned i=0;i<count;i++){
  int n=xm_envelope_encode(encoded,sizeof(encoded),&sender,frames[i].topic,frames[i].type,
   frames[i].seq,"1","1970-01-01T00:00:00.000Z",frames[i].payload);assert(n>0);
  incoming=encoded;incoming_length=n;
  struct mqtt_evt event={.type=MQTT_EVT_PUBLISH};
  event.param.publish.message.topic.topic.utf8=(const uint8_t *)frames[i].topic;
  event.param.publish.message.topic.topic.size=strlen(frames[i].topic);
  event.param.publish.message.payload.len=n;
  c->mqtt.evt_cb(&c->mqtt,&event);
 }
 k_sem_give(&injected);return 0;
}
void __wrap_xm_zclient_close(struct xm_zclient *c){c->connected=false;}
void xd_delivery_record(const struct xd_delivery *d){ARG_UNUSED(d);}
static void send_frames(unsigned n)
{
 count=n;k_sem_give(&inject);assert(!k_sem_take(&injected,K_SECONDS(1)));
 k_sleep(K_MSEC(30));assert(!xd_io_snapshot(&snapshot));
}
int main(void)
{
 const char *control="{\"generation\":42,\"mode\":\"MANUAL\",\"active_app\":\"manual\",\"active_vm_id\":\"" A
  "\",\"manual_policy\":\"NEUTRAL_THEN_ACTION\",\"manual_session\":\"" B "\"}";
 const char *neutral="{\"profile\":\"manual-session-1\",\"session_id\":\"" B "\",\"sample_seq\":\"1\",\"action_seq\":\"1\","
  "\"generation\":42,\"keys\":[],\"valid\":true,\"age_ms\":0}";
 const char *action="{\"profile\":\"manual-session-1\",\"session_id\":\"" B "\",\"sample_seq\":\"2\",\"action_seq\":\"2\","
  "\"generation\":42,\"keys\":[\"up\"],\"valid\":true,\"age_ms\":0}";
 assert(!xm_identity_init(&sender,NULL,"browser","manual-input",A,B));
 assert(!xd_io_start_dual(&client,"xenova/v1/vehicle/control","xenova/v1/apps/manual/input","xenova/v1/apps/perception/events"));
 frames[0]=(struct frame){"xenova/v1/vehicle/control","vehicle.control",control,1};
 send_frames(1);assert(!snapshot.control.error);
 frames[0]=(struct frame){"xenova/v1/apps/manual/input","drive.input",neutral,1};
 frames[1]=(struct frame){"xenova/v1/apps/manual/input","drive.input",action,2};
 send_frames(2);assert(!snapshot.input.error&&snapshot.input.seq==2&&snapshot.manual_witness.present);
 struct drive_adapter adapter;struct manual_cfg cfg;struct drive_sample output;
 drive_manual_adapter(&adapter,&cfg);
 assert(!drive_adapter_run_observed(&adapter,span(control),span(action),k_uptime_get()-snapshot.input.received_ms,
  &snapshot.manual_witness,"",&output));assert(output.v_mps>0);
 int64_t original=snapshot.input.received_ms;
 k_sleep(K_MSEC(250));client.connected=false;client.connected=true;
 frames[0]=(struct frame){"xenova/v1/apps/manual/input","drive.input",action,3};
 send_frames(1);
 assert(snapshot.input.seq==2&&snapshot.input.received_ms==original&&client.dropped==1);
 assert(!drive_adapter_run_observed(&adapter,span(control),span(action),k_uptime_get()-original,
  &snapshot.manual_witness,"",&output));assert(!output.v_mps&&!strcmp(output.reason,"INPUT_STALE"));
 frames[0]=(struct frame){"xenova/v1/apps/manual/input","drive.input",neutral,4};
 send_frames(1);assert(snapshot.input.received_ms==original&&client.dropped==2);
 assert(!xd_io_join(k_uptime_get()+1000));
 puts("PASS real receive owner: neutral survives coalescing; duplicate/reversed original samples never refresh age; join succeeds");
 exit(0);
}
```
