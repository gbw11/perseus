## CMakeLists.txt
```
# Production lifecycle sources with only Xen/Store/net-device boundaries replaced.
cmake_minimum_required(VERSION 3.20.5)
find_package(Zephyr REQUIRED HINTS $ENV{ZEPHYR_BASE})
project(xenova_lifecycle)
zephyr_link_libraries(-Wl,--wrap=xnf_poll,--wrap=z_impl_k_thread_create)
set(BASE ${CMAKE_CURRENT_SOURCE_DIR}/../../../guests/zephyr)
target_include_directories(app BEFORE PRIVATE boundaries ${BASE}/xen-runtime/include ${BASE}/xen-store/include)
target_compile_definitions(app PRIVATE CONFIG_XENOVA_NETFRONT=1
  CONFIG_XENOVA_NETFRONT_THREAD_PRIORITY=7 CONFIG_XENOVA_SHUTDOWN_THREAD_PRIORITY=6
  CONFIG_XENOVA_SHUTDOWN_BUDGET_MS=15000)
target_sources(app PRIVATE src/boundaries.c
  ${BASE}/xen-runtime/src/netfront.c ${BASE}/xen-runtime/src/netfront_ring.c
  ${BASE}/xen-runtime/src/shutdown.c ${BASE}/xen-runtime/src/shutdown_flow.c
  ${BASE}/xen-runtime/src/grant_pool.c)
if(XL_NETFRONT_POLICY)
  target_sources(app PRIVATE src/net_policy.c)
elseif(XL_PACKET_LOCK_TEST)
  target_compile_definitions(app PRIVATE XL_PACKET_LOCK_TEST=1)
  zephyr_link_libraries(-Wl,--wrap=z_impl_k_mutex_lock)
  target_sources(app PRIVATE src/packet_lock.c)
elseif(XL_WAIT_TEST)
  target_sources(app PRIVATE src/wait.c)
elseif(XL_STARTER)
  target_compile_definitions(app PRIVATE CONFIG_XENOVA_DIAGNOSTICS_EXERCISE=1)
  set_source_files_properties(${BASE}/network-starter-app/src/main.c PROPERTIES COMPILE_DEFINITIONS main=xl_starter_main)
  target_sources(app PRIVATE src/starter.c ${BASE}/network-starter-app/src/main.c ${BASE}/network-starter-app/src/exercise.c)
elseif(XL_BASELINE_NET_SOURCE)
  # The task runner supplies an immutable git-show source outside the repo.
  set_property(SOURCE ${BASE}/xen-runtime/src/netfront.c PROPERTY HEADER_FILE_ONLY TRUE)
  target_sources(app PRIVATE ${XL_BASELINE_NET_SOURCE} ${XL_BASELINE_NET_MAIN})
else()
  target_sources(app PRIVATE src/main.c)
endif()
```

## prj.conf
```kconfig
CONFIG_MAIN_STACK_SIZE=8192
CONFIG_HEAP_MEM_POOL_SIZE=16384
CONFIG_THREAD_NAME=y
CONFIG_ASSERT=y
CONFIG_INIT_STACKS=y
CONFIG_THREAD_STACK_INFO=y
CONFIG_SHELL=y
CONFIG_SHELL_BACKEND_SERIAL=n
```

## src/main.c
```c
/* Each process is a fresh guest lifetime: one-shot transports never reset. */
#include <lifecycle_boundary.h>
#include <xenova/netfront.h>
#include <xenova/shutdown.h>
#include <assert.h>
#include <errno.h>
#include <stdlib.h>
#include <stdio.h>
#include <string.h>
K_THREAD_STACK_DEFINE(start_stack,4096);
static struct k_thread starter;
static int start_rc;
static unsigned hooks;
K_THREAD_STACK_DEFINE(close_stack,4096);
static struct k_thread closer;
static int close_result;
static void send_packet(void *a,void *b,void *c) {
 ARG_UNUSED(a);ARG_UNUSED(b);ARG_UNUSED(c);
 struct net_pkt packet={.length=14};start_rc=xl_api->send(NULL,&packet);
}
static void close_network(void *a,void *b,void *c) {
 ARG_UNUSED(a);ARG_UNUSED(b);ARG_UNUSED(c);close_result=xnet_close(k_uptime_get()+1000);
}
static void start_thread(void *a,void *b,void *c) { ARG_UNUSED(a);ARG_UNUSED(b);ARG_UNUSED(c);start_rc=xnet_start(); }
static int hook(const char *request,int64_t end,void *ctx) {
 ARG_UNUSED(ctx);assert(!strcmp(request,"reboot"));assert(end>k_uptime_get());assert(xl_features==2);hooks++;
 return strstr(xl_case,"reject")?-EBUSY:strstr(xl_case,"hook")?-EIO:0;
}
int main(void) {
 xl_case=getenv("XL_CASE");assert(xl_case);xl_net_init();
 if(!strncmp(xl_case,"net-",4)) {
  if(!strcmp(xl_case,"net-race")) {
   xl_race=true;
   k_thread_create(&starter,start_stack,K_THREAD_STACK_SIZEOF(start_stack),start_thread,NULL,NULL,NULL,8,0,K_NO_WAIT);
   assert(!k_sem_take(&xl_acquired,K_SECONDS(1)));xnet_stop_request();
   k_sem_give(&xl_release);assert(!k_thread_join(&starter,K_SECONDS(1)));
   assert(start_rc==-ECANCELED&&xl_grants==1);
  } else {
   start_rc=xnet_start();
   bool succeeds=!strcmp(xl_case,"net-ok")||!strcmp(xl_case,"net-busy")||!strcmp(xl_case,"net-close-timeout")||!strcmp(xl_case,"net-send-race");
   assert(succeeds?start_rc==0:start_rc<0);
  }
  if(!strcmp(xl_case,"net-send-race")) {
   k_thread_create(&starter,start_stack,K_THREAD_STACK_SIZEOF(start_stack),send_packet,NULL,NULL,NULL,8,0,K_NO_WAIT);
   assert(!k_sem_take(&xl_acquired,K_SECONDS(1)));
   k_thread_create(&closer,close_stack,K_THREAD_STACK_SIZEOF(close_stack),close_network,NULL,NULL,NULL,6,0,K_NO_WAIT);
   k_sleep(K_MSEC(1));assert(!xl_revokes);k_sem_give(&xl_release);
   assert(!k_thread_join(&starter,K_SECONDS(1)));assert(!start_rc);xl_complete_tx();
   assert(!k_thread_join(&closer,K_SECONDS(1)));assert(!close_result);
   struct net_pkt packet={.length=14};assert(xl_api->send(NULL,&packet)==-ENETDOWN);
  }
  int rc=xnet_close(k_uptime_get()+100);
  struct xnet_status status;assert(!xnet_status_get(&status));
  if(!strcmp(xl_case,"net-busy")||!strcmp(xl_case,"net-close-timeout")||!strcmp(xl_case,"net-backend")) {
   assert(rc<0&&!status.closed&&status.grants_held);
   if(!strcmp(xl_case,"net-busy"))assert(xl_revokes==xl_grants-1&&status.grants_held==1);
   else assert(!xl_revokes&&status.publication_possible);
   xl_retry=true;assert(!xnet_close(k_uptime_get()+1000));
  } else assert(!rc);
  assert(!xnet_status_get(&status));assert(!status.grants_held&&status.event_port==-1&&!status.watch_owned);
  assert(status.worker_joined&&xl_revokes==xl_grants);
  unsigned revokes=xl_revokes;assert(!xnet_close(k_uptime_get()+100));assert(xl_revokes==revokes);
  assert(xnet_start()==-EALREADY);
 } else {
  int rc=xshutdown_start(hook,NULL);
  if(!strcmp(xl_case,"shutdown-external-read-poison")||!strcmp(xl_case,"shutdown-external-watch-poison")) {
   assert(!rc);k_sleep(K_MSEC(250));
   struct xshutdown_status s;assert(!xshutdown_status_get(&s));
   assert(!s.request_owned&&!hooks&&!xl_closed&&!xl_hypercalls);
   assert(xshutdown_stop(k_uptime_get()+500)==-ETIMEDOUT);
  } else if(strstr(xl_case,"external")) {
   assert(!rc);struct xshutdown_status s;
   int64_t end=k_uptime_get()+1000;
   do { k_sleep(K_MSEC(1));assert(!xshutdown_status_get(&s)); }while(!s.cleanup_error&&k_uptime_get()<end);
   assert(s.request_owned&&s.cleanup_error);
   unsigned expected=strstr(xl_case,"ack")||strstr(xl_case,"hook")||strstr(xl_case,"reject")||strstr(xl_case,"store")?0:1;
   assert(xl_hypercalls==expected);k_sleep(K_MSEC(50));assert(xl_hypercalls==expected);
   if(strstr(xl_case,"external-read-"))assert(hooks==1&&xl_closed==1);
   assert(xshutdown_stop(k_uptime_get()+100)==-EBUSY);
  } else {
   assert(rc<0);assert(!xshutdown_stop(k_uptime_get()+1000));
   struct xshutdown_status s;assert(!xshutdown_status_get(&s));
   assert(s.initial_error==rc&&!s.watch_owned&&!s.features_possible&&s.worker_joined);
   assert(!xshutdown_stop(k_uptime_get()+100));assert(!xl_hypercalls&&!hooks&&!xl_closed);
  }
 }
 printf("PASS actual Zephyr kernel lifecycle %s grants=%u revoked=%u hypercalls=%u\n",xl_case,xl_grants,xl_revokes,xl_hypercalls);
 exit(0);
}
```

## src/boundaries.c
```c
/* Inject external failures/effects, never duplicate the lifecycle under test. */
#include <lifecycle_boundary.h>
#include <xenova/runtime.h>
#include <xenova/xenbus_vif.h>
#include <xenova/grant_pool.h>
#include <xenova/netfront_ring.h>
#include <assert.h>
#include <errno.h>
#include <string.h>
#include <stdio.h>
#include <stdlib.h>
const struct ethernet_api *xl_api;
const char *xl_case;
unsigned xl_hypercalls,xl_grants,xl_revokes,xl_opened,xl_closed,xl_features;
bool xl_retry,xl_race;
K_SEM_DEFINE(xl_acquired,0,1);
K_SEM_DEFINE(xl_release,0,1);
static struct xs_client client;
static struct xgp_entry table[512];
static struct xgp_pool pool={.table=table};
static unsigned front,watched;
static bool advertised;
static struct xnf_tx_ring *tx_ring;
static bool event_bound;
atomic_uint xl_polls;
atomic_uint xl_tx_done;
atomic_int xl_poll_error;
atomic_bool xl_wait_enabled;
#if defined(XL_PACKET_LOCK_TEST)
atomic_int xl_packet_lock_error;
static k_tid_t packet_thread;
int __real_z_impl_k_mutex_lock(struct k_mutex *,k_timeout_t);
int __wrap_z_impl_k_mutex_lock(struct k_mutex *m,k_timeout_t timeout) {
 int rc=k_current_get()==packet_thread?atomic_exchange(&xl_packet_lock_error,0):0;
 return rc?rc:__real_z_impl_k_mutex_lock(m,timeout);
}
#endif
K_SEM_DEFINE(xl_store_wait,0,1);
int __real_xnf_poll(struct xnf *);
int __wrap_xnf_poll(struct xnf *n) {
 atomic_fetch_add(&xl_polls,1);int rc=__real_xnf_poll(n);
 atomic_store(&xl_tx_done,n->stats.tx);
 if(rc){int empty=0;atomic_compare_exchange_strong(&xl_poll_error,&empty,rc);}return rc;
}
static bool is(const char *s) { return !strcmp(xl_case,s); }
k_tid_t __real_z_impl_k_thread_create(struct k_thread *,k_thread_stack_t *,size_t,k_thread_entry_t,void *,void *,void *,int,uint32_t,k_timeout_t);
k_tid_t __wrap_z_impl_k_thread_create(struct k_thread *t,k_thread_stack_t *stack,size_t size,k_thread_entry_t entry,void *a,void *b,void *c,int priority,uint32_t options,k_timeout_t delay) {
 static unsigned created;
 if(xl_case) {
  created++;
#if defined(XL_PACKET_LOCK_TEST)
  if(created==2)packet_thread=t;
#endif
  if((is("net-monitor-thread")&&created==1)||(is("net-packet-thread")&&created==2))return NULL;
 }
 return __real_z_impl_k_thread_create(t,stack,size,entry,a,b,c,priority,options,delay);
}
int xsr_open(void) { xl_opened++;return is("net-store")||is("shutdown-store")?-EIO:0; }
struct xs_client *xsr_acquire(int64_t end) {
 if(xl_wait_enabled&&front==4&&is("wait-lock")){k_sem_give(&xl_store_wait);return NULL;}
 return end>k_uptime_get()?&client:NULL;
}
void xsr_release(void) { }
int xs_read_text(struct xs_client *c,uint32_t tx,const char *p,char *v,size_t n,int ms) {
 ARG_UNUSED(c);ARG_UNUSED(tx);ARG_UNUSED(p);ARG_UNUSED(ms);snprintf(v,n,"42");return 0;
}
int xs_watch(struct xs_client *c,const char *p,uint32_t *id,int ms) {
 ARG_UNUSED(c);ARG_UNUSED(p);ARG_UNUSED(ms);*id=++watched;
 return is("shutdown-watch")||is("net-watch")?-ETIMEDOUT:0;
}
int xsr_unwatch(uint32_t id,int64_t end) { assert(id);return end<=k_uptime_get()?-ETIMEDOUT:0; }
static bool shutdown_watch_delivered;
static unsigned shutdown_watch_reads;
static int64_t shutdown_read_failed_at;
static bool shutdown_read_case(void) { return strstr(xl_case,"shutdown-external-read-")!=NULL; }
int xsr_watch_next(uint32_t id,int ms) {
 ARG_UNUSED(id);k_sleep(K_MSEC(ms));
 if(shutdown_read_case()){
  assert(!client.poisoned);
  if(!shutdown_watch_delivered){shutdown_watch_delivered=true;return 0;}
 }
 if(is("shutdown-external-watch-poison")){
  assert(!client.poisoned);
  client.poisoned=true;client.fatal_error=-ETIMEDOUT;
  return client.fatal_error;
 }
 if(xl_wait_enabled&&front==4){
  if(is("wait-watch-busy")){k_sem_give(&xl_store_wait);return -EBUSY;}
  if(is("wait-watch-poison")){client.poisoned=true;client.fatal_error=-ETIMEDOUT;k_sem_give(&xl_store_wait);}
  if(getenv("XL_WATCH_FLOOD"))return 0;
 }
 return client.poisoned?client.fatal_error:-ETIMEDOUT;
}
int xsr_watch_next_status(uint32_t id,int ms,bool *unusable) {
 int rc=xsr_watch_next(id,ms);if(unusable)*unusable=client.poisoned||client.closed;return rc;
}
int xsr_read(const char *p,char *v,size_t n,int ms) {
 if(ms<=0)return -ETIMEDOUT;
 if(strstr(p,"control/shutdown")) {
  if(shutdown_read_case()) {
   if(!shutdown_watch_delivered){snprintf(v,n,"%s","");return 0;}
   if(++shutdown_watch_reads==1) {
    shutdown_read_failed_at=k_uptime_get();
    if(is("shutdown-external-read-busy"))return -EBUSY;
    if(is("shutdown-external-read-again"))return -EAGAIN;
    if(is("shutdown-external-read-poison")){client.poisoned=true;client.fatal_error=-ETIMEDOUT;}
    return -ETIMEDOUT;
   }
   assert(shutdown_watch_reads==2&&!client.poisoned);
   assert(k_uptime_get()-shutdown_read_failed_at>=100);
  }
  bool external=strstr(xl_case,"external")&&!is("shutdown-external-watch-poison");
  snprintf(v,n,"%s",external?"reboot":"");return 0;
 }
 snprintf(v,n,"1");return 0;
}
int xsr_read_status(const char *p,char *v,size_t n,int ms,bool *unusable) {
 int rc=xsr_read(p,v,n,ms);if(unusable)*unusable=client.poisoned||client.closed;return rc;
}
int xsr_write(const char *p,const char *v,int ms) {
 if(ms<=0)return -ETIMEDOUT;
 if(client.poisoned)return client.fatal_error;
 if(strstr(p,"feature-")) {
  if(!strcmp(v,"1")) {
   xl_features++;
   if(is("shutdown-feature1")||(is("shutdown-feature2")&&xl_features==2))return -EIO;
  }
 } else if(strstr(p,"control/shutdown")) {
  if(is("shutdown-external-ack"))return -EIO;
 } else if(strstr(p,"/state"))front=(unsigned)(v[0]-'0');
 return 0;
}
int xs_write(struct xs_client *c,uint32_t tx,const char *p,const void *v,size_t n,int ms) {
 ARG_UNUSED(c);ARG_UNUSED(tx);ARG_UNUSED(n);return xsr_write(p,v,ms);
}
int xs_remaining(struct xs_client *c,int64_t end) { ARG_UNUSED(c);return MAX(0,end-k_uptime_get()); }
int xsr_transaction(int ms,xs_transaction_fn body,void *ctx) {
 int rc=body(&client,1,k_uptime_get()+ms,ctx);advertised=!rc;
 return is("net-publish-lost")?-ETIMEDOUT:rc;
}
int xsr_close(int64_t end) {
 assert(end>=k_uptime_get());xl_closed++;return is("shutdown-external-store")?-EIO:0;
}
int xvif_discover(struct xs_client *c,struct xvif *v,int ms) {
 ARG_UNUSED(c);ARG_UNUSED(ms);*v=(struct xvif){.domid=42,.backend_domid=0,.backend_state=XenbusStateInitWait};
 strcpy(v->frontend,"/local/domain/42/device/vif/0");strcpy(v->backend,"/local/domain/0/backend/vif/42/0");
 if(is("net-init-wait"))v->backend_state=XenbusStateInitialising;
 return is("net-discover")?-EIO:0;
}
int xvif_watch_backend(struct xs_client *c,const struct xvif *v,uint32_t *id,int ms) {
 ARG_UNUSED(v);return xs_watch(c,"/backend",id,ms);
}
int xvif_refresh(struct xs_client *c,struct xvif *v,int ms) {
 if(ms<=0)return -ETIMEDOUT;
 if(c->poisoned)return c->fatal_error;
 if(xl_wait_enabled&&(front==4||getenv("XL_CLOSE_UNAVAILABLE"))) {
  k_sem_give(&xl_store_wait);
  if(is("wait-delay"))k_sleep(K_MSEC(35));
  if(is("wait-timeout"))return -ETIMEDOUT;
  if(is("wait-busy"))return -EBUSY;
  if(is("wait-again"))return -EAGAIN;
  if(is("wait-poison")){c->poisoned=true;c->fatal_error=-ETIMEDOUT;return c->fatal_error;}
  if(is("wait-stop-race")){k_sem_give(&xl_acquired);assert(!k_sem_take(&xl_release,K_SECONDS(1)));}
  if(is("wait-identity"))return -EXDEV;
  if(is("wait-protocol"))return -EPROTO;
  if(is("wait-closing")){v->backend_state=XenbusStateClosing;return 0;}
  if(is("wait-closed")){v->backend_state=XenbusStateClosed;return 0;}
 }
 if((is("net-backend")&&!xl_retry)||is("net-init-wait"))return -ETIMEDOUT;
 v->backend_state=front==6?XenbusStateClosed:front==5?XenbusStateClosing:advertised?XenbusStateConnected:XenbusStateInitWait;
 if(is("net-close-timeout")&&!xl_retry&&front>=5)v->backend_state=XenbusStateConnected;
 return 0;
}
int xgrant_init(void) { return 0; }
int xgrant_share(uint16_t backend,void *page,bool ro,uint32_t *ref) {
 ARG_UNUSED(page);
 if(is("net-grant")&&xl_grants==3)return -ENOMEM;
 int rc=xgp_share(&pool,backend,1,ro,ref);if(!rc)xl_grants++;
 if(!rc&&xl_grants==1)tx_ring=page;
 if(xl_race&&xl_grants==1){k_sem_give(&xl_acquired);k_sem_take(&xl_release,K_FOREVER);}
 return rc;
}
int xgrant_revoke_until(uint32_t ref,int64_t end) {
 if(k_uptime_get()>=end)return -ETIMEDOUT;
 assert(!advertised||front==6); /* No reuse after a lost publish response. */
 if(is("net-busy")&&!xl_retry&&ref==XGP_FIRST+1)return -EBUSY;
 int rc=xgp_revoke(&pool,ref);assert(rc!=-ENOENT);if(!rc)xl_revokes++;return rc;
}
int xgrant_revoke(uint32_t ref) { return xgrant_revoke_until(ref,k_uptime_get()+20); }
int alloc_unbound_event_channel(unsigned dom) { ARG_UNUSED(dom);return is("net-event")?-ENOMEM:11; }
void mask_event_channel(unsigned p) { assert(p==11); }
int bind_event_channel(unsigned p,void (*fn)(void *),void *ctx) {
 ARG_UNUSED(fn);ARG_UNUSED(ctx);assert(p==11);if(is("net-bind"))return -EIO;event_bound=true;return 0;
}
void unbind_event_channel(unsigned p) { assert(p==11&&event_bound);event_bound=false; }
int evtchn_close(unsigned p) { assert(p==11&&!event_bound);return 0; }
int notify_evtchn(unsigned p) { assert(p==11);return 0; }
int HYPERVISOR_event_channel_op(unsigned op,void *p) { ARG_UNUSED(op);ARG_UNUSED(p);return is("net-unmask")?-EIO:0; }
int HYPERVISOR_sched_op(unsigned op,void *p) { assert(op==SCHEDOP_shutdown);assert(((struct sched_shutdown *)p)->reason==1);xl_hypercalls++;return 0; }
void net_if_flag_set(struct net_if *i,int f) { ARG_UNUSED(i);ARG_UNUSED(f); }
void ethernet_init(struct net_if *i) { ARG_UNUSED(i); }
void net_if_carrier_off(struct net_if *i) { ARG_UNUSED(i); }
void net_eth_carrier_off(struct net_if *i) { ARG_UNUSED(i); }
void net_eth_carrier_on(struct net_if *i) { ARG_UNUSED(i); }
int net_if_up(struct net_if *i) { ARG_UNUSED(i);return is("net-interface")?-EIO:0; }
int net_if_down(struct net_if *i) { ARG_UNUSED(i);return 0; }
void net_if_set_link_addr(struct net_if *i,const uint8_t *a,size_t n,int t) { ARG_UNUSED(i);ARG_UNUSED(a);ARG_UNUSED(n);ARG_UNUSED(t); }
void net_dhcpv4_start(struct net_if *i) { ARG_UNUSED(i); }
void net_dhcpv4_stop(struct net_if *i) { ARG_UNUSED(i); }
struct net_pkt *net_pkt_rx_alloc_with_buffer(struct net_if *i,size_t n,int a,int p,k_timeout_t t) { ARG_UNUSED(i);ARG_UNUSED(n);ARG_UNUSED(a);ARG_UNUSED(p);ARG_UNUSED(t);return NULL; }
int net_pkt_write(struct net_pkt *p,const void *d,size_t n) { ARG_UNUSED(p);ARG_UNUSED(d);ARG_UNUSED(n);return 0; }
int net_recv_data(struct net_if *i,struct net_pkt *p) { ARG_UNUSED(i);ARG_UNUSED(p);return 0; }
void net_pkt_unref(struct net_pkt *p) { ARG_UNUSED(p); }
size_t net_pkt_get_len(struct net_pkt *p) { return p->length; }
int net_pkt_read(struct net_pkt *p,void *out,size_t n) {
 if(is("net-send-race")){k_sem_give(&xl_acquired);k_sem_take(&xl_release,K_FOREVER);}
 else if(!strncmp(xl_case,"packet-",7)){
  k_sem_give(&xl_acquired);assert(!k_sem_take(&xl_release,K_SECONDS(3)));
 }
 memcpy(out,p->bytes,n);return 0;
}
static void complete_tx(bool corrupt) {
 uint32_t end=__atomic_load_n(&tx_ring->h.req_prod,__ATOMIC_ACQUIRE);
 for(uint32_t i=tx_ring->h.rsp_prod;i<end;i++) {
  uint16_t id=tx_ring->ring[i&(XNF_RING_SIZE-1)].req.id;
  tx_ring->ring[i&(XNF_RING_SIZE-1)].rsp=(struct xnf_tx_response){.id=corrupt?UINT16_MAX:id,.status=0};
 }
 __atomic_store_n(&tx_ring->h.rsp_prod,end,__ATOMIC_RELEASE);
}
void xl_complete_tx(void) { complete_tx(false); }
void xl_corrupt_tx(void) { complete_tx(true); }
```

## src/net_policy.c
```c
/* Product packet/observer threads; only Xen/Store/device boundaries are fixtures. */
#include <lifecycle_boundary.h>
#include <xenova/netfront.h>
#include <assert.h>
#include <errno.h>
#include <stdio.h>
#include <stdlib.h>
#include <string.h>

static struct xnet_status observed(int expected) {
 struct xnet_status status;int64_t end=k_uptime_get()+2000;
 do {
  assert(!xnet_status_get(&status));
  if(status.backend_observation==expected)return status;
  k_sleep(K_MSEC(1));
 }while(k_uptime_get()<end);
 assert(!"expected backend observation not reached");return status;
}
static void tx_reaped(uint64_t count) {
 struct xnf_stats stats;int64_t end=k_uptime_get()+1000;
 do {
  assert(!xnet_stats(&stats));if(stats.tx==count)return;
  k_sleep(K_MSEC(1));
 }while(k_uptime_get()<end);
 assert(!"TX completion not reaped");
}
int main(void) {
 xl_case=getenv("XL_CASE");assert(xl_case);xl_net_init();assert(!xnet_start());
 unsigned grants=xl_grants;struct net_pkt packet={.length=14};
 xl_wait_enabled=true;assert(!k_sem_take(&xl_store_wait,K_SECONDS(1)));
 bool fatal=!strcmp(xl_case,"wait-poison")||!strcmp(xl_case,"wait-watch-poison")||
  !strcmp(xl_case,"wait-closing")||!strcmp(xl_case,"wait-closed")||!strcmp(xl_case,"wait-identity")||!strcmp(xl_case,"wait-protocol");
 if(fatal){
  struct xnet_status broken=observed(!strcmp(xl_case,"wait-closing")||!strcmp(xl_case,"wait-closed")?3:4);
  int expected=!strcmp(xl_case,"wait-identity")?-EXDEV:!strcmp(xl_case,"wait-protocol")?-EPROTO:
   !strcmp(xl_case,"wait-poison")||!strcmp(xl_case,"wait-watch-poison")?-ETIMEDOUT:-ENETDOWN;
  assert(broken.backend_error==expected&&!broken.connected&&broken.first_observation_error==expected);
  assert(xl_api->send(NULL,&packet)==-ENETDOWN);xl_wait_enabled=false;
  k_sleep(K_MSEC(300));assert(xl_api->send(NULL,&packet)==-ENETDOWN&&xl_grants==grants);
  bool poisoned=!strcmp(xl_case,"wait-poison")||!strcmp(xl_case,"wait-watch-poison");
  int rc=xnet_close(k_uptime_get()+300);struct xnet_status done;assert(!xnet_status_get(&done));
  if(poisoned){assert(rc==-ETIMEDOUT&&!done.closed&&done.grants_held==grants&&!xl_revokes);}
  else assert(!rc&&done.closed&&xl_revokes==grants);
  puts("PASS terminal backend/identity/session failure never auto-reconnects or frees uncertain grants");exit(0);
 }
 struct xnet_status uncertain=observed(2);
 int expected=!strcmp(xl_case,"wait-busy")||!strcmp(xl_case,"wait-watch-busy")?-EBUSY:
  !strcmp(xl_case,"wait-again")?-EAGAIN:-ETIMEDOUT;
 assert(uncertain.connected&&!uncertain.backend_error&&uncertain.observation_error==expected&&uncertain.first_observation_error==expected);
 unsigned before=atomic_load(&xl_polls);k_sleep(K_MSEC(30));
 assert(atomic_load(&xl_polls)>before);
 if(getenv("XL_CLOSE_UNAVAILABLE")){
  xnet_stop_request();assert(xnet_close(k_uptime_get()+300)==-ETIMEDOUT);
  struct xnet_status held;assert(!xnet_status_get(&held));
  assert(held.stopping&&!held.closed&&!held.connected&&held.grants_held==grants&&!xl_revokes);
  assert(xl_api->send(NULL,&packet)==-ENETDOWN);xl_wait_enabled=false;
  assert(!xnet_close(k_uptime_get()+1000));assert(!xnet_status_get(&held));
  assert(held.closed&&!held.connected&&xl_revokes==grants);
  puts("PASS unavailable shutdown keeps grants, then closes without reopening TX");exit(0);
 }
 assert(!xl_api->send(NULL,&packet));xl_complete_tx();tx_reaped(1);
 struct xnet_waits failed;assert(!xnet_waits_get(&failed));assert(failed.store_unavailable>0);
 if(getenv("XL_REPEAT")){
  unsigned polls=atomic_load(&xl_polls);uint64_t calls=failed.store_observations;
  k_sleep(K_MSEC(1100));assert(!xnet_waits_get(&failed));
  assert(failed.store_observations-calls>=3&&failed.store_observations-calls<=6);
  assert(atomic_load(&xl_polls)>polls+10&&xl_grants==grants&&!xl_revokes);
 }
 /* Slot pressure is a bounded send refusal, not a link transition. */
 for(unsigned k=0;k<XNF_SLOTS;k++)assert(!xl_api->send(NULL,&packet));
 assert(xl_api->send(NULL,&packet)==-ENOBUFS);xl_complete_tx();tx_reaped(1+XNF_SLOTS);
 xl_wait_enabled=false;struct xnet_status recovered=observed(1);
 assert(recovered.connected&&!recovered.backend_error&&!recovered.observation_error);
 assert(recovered.first_observation_error==uncertain.first_observation_error);
 struct xnet_waits restored;assert(!xnet_waits_get(&restored));assert(restored.store_recoveries>0);
 assert(!xl_api->send(NULL,&packet));xl_complete_tx();tx_reaped(2+XNF_SLOTS);
 assert(xl_grants==grants); /* Observation recovery creates no second VIF/grant set. */
 if(getenv("XL_STOP_RACE")){
  xl_case="wait-stop-race";xl_wait_enabled=true;
  assert(!k_sem_take(&xl_acquired,K_SECONDS(1)));xnet_stop_request();
  assert(!xl_revokes);k_sem_give(&xl_release);k_sleep(K_MSEC(20));
  struct xnet_status stopped;assert(!xnet_status_get(&stopped));
  assert(stopped.stopping&&!stopped.connected&&xl_api->send(NULL,&packet)==-ENETDOWN);
  xl_wait_enabled=false;
 }
 assert(!xnet_close(k_uptime_get()+1000));
 struct xnet_status done;assert(!xnet_status_get(&done));
 assert(done.closed&&done.worker_joined&&done.monitor_joined&&xl_revokes==grants);
 printf("POLICY_RESULT {\"unavailable\":%llu,\"recoveries\":%llu,\"observations\":%llu,\"polls\":%u}\n",
  (unsigned long long)failed.store_unavailable,(unsigned long long)restored.store_recoveries,
  (unsigned long long)failed.store_observations,atomic_load(&xl_polls));
 puts("PASS transient observation keeps packet progress, recovers and closes owned resources");exit(0);
}
```

## src/packet_lock.c
```c
/* Actual TX owner holds the production mutex; kernel timeouts/poll/close are real. */
#include <lifecycle_boundary.h>
#include <xenova/netfront.h>
#include <assert.h>
#include <errno.h>
#include <stdio.h>
#include <stdlib.h>
#include <string.h>

K_THREAD_STACK_DEFINE(sender_stack,4096);
static struct k_thread sender;
static struct net_pkt packet={.length=14};
static int send_result;
static void send_packet(void *a,void *b,void *c) {
 ARG_UNUSED(a);ARG_UNUSED(b);ARG_UNUSED(c);send_result=xl_api->send(NULL,&packet);
}
static struct xnet_status status(void) {
 struct xnet_status s;assert(!xnet_status_get(&s));return s;
}
static void hold(void) {
 assert(k_thread_create(&sender,sender_stack,K_THREAD_STACK_SIZEOF(sender_stack),
  send_packet,NULL,NULL,NULL,8,0,K_NO_WAIT));
 assert(!k_sem_take(&xl_acquired,K_SECONDS(1)));
}
static void release(void) {
 k_sem_give(&xl_release);assert(!k_thread_join(&sender,K_SECONDS(1)));assert(!send_result);
}
static void reaped(unsigned count) {
 int64_t end=k_uptime_get()+1000;
 do {
  if(atomic_load(&xl_tx_done)==count)return;k_sleep(K_MSEC(1));
 }while(k_uptime_get()<end);
 assert(!"completion not processed after mutex release");
}
static struct xnet_status observed(int kind) {
 int64_t end=k_uptime_get()+1000;struct xnet_status s;
 do{s=status();if(s.backend_observation==kind)return s;k_sleep(K_MSEC(1));}while(k_uptime_get()<end);
 assert(!"backend observation not reached");return s;
}
static void link_stopped(void) {
 int64_t end=k_uptime_get()+1000;
 do{if(!status().connected)return;k_sleep(K_MSEC(1));}while(k_uptime_get()<end);
 assert(!"terminal error did not stop TX");
}
static void finished(unsigned grants) {
 struct xnet_status s=status();struct xnet_waits w;assert(!xnet_waits_get(&w));
 assert(s.closed&&s.worker_joined&&s.monitor_joined&&xl_revokes==grants);
 assert(xnet_start()==-EALREADY);
 printf("PACKET_RESULT {\"timeouts\":%llu,\"first_lock_error\":%d,\"last_poll_ms\":%llu,\"wait_max_us\":%llu,\"hold_max_us\":%llu}\n",
  (unsigned long long)w.packet_lock_timeouts,w.packet_lock_first_error,
  (unsigned long long)w.packet_last_poll_ms,(unsigned long long)w.packet_lock_wait_max_us,
  (unsigned long long)w.packet_lock_hold_max_us);
 puts("PASS packet mutex contention preserves worker, TX ownership and normal close");exit(0);
}
int main(void) {
 xl_case=getenv("XL_CASE");assert(xl_case);xl_net_init();assert(!xnet_start());
 const char *scenario=xl_case;
 unsigned grants=xl_grants;k_sleep(K_MSEC(20));hold();unsigned polls=atomic_load(&xl_polls);
 struct xnet_waits prior;assert(!xnet_waits_get(&prior));int64_t began=k_uptime_get();
 k_sleep(K_MSEC(!strcmp(scenario,"packet-long")?1000:100));struct xnet_status held=status();
 printf("PACKET_HELD connected=%d poll_delta=%u grants=%u\n",held.connected,atomic_load(&xl_polls)-polls,xl_grants);
 assert(held.connected&&!held.backend_error&&!xl_revokes&&xl_grants==grants);
 assert(atomic_load(&xl_polls)==polls);
 struct xnet_waits delayed;assert(!xnet_waits_get(&delayed));
 assert(delayed.packet_lock_timeouts&&delayed.packet_lock_first_error==-EAGAIN);
 assert(delayed.packet_last_poll_ms==prior.packet_last_poll_ms);
 assert(delayed.packet_lock_timeouts<=(uint64_t)(k_uptime_get()-began)/20+2);
 /* Snapshot reads never wait behind the stalled packet owner. */
 struct xnf_stats stats;assert(xnet_stats_try(&stats)==-EBUSY);
 /* Another sender loses only its own bounded attempt. */
 assert(xl_api->send(NULL,&packet)==-ETIMEDOUT&&status().connected);
 if(!strcmp(scenario,"packet-close")){
  int64_t begin=k_uptime_get(),end=begin+60;
  assert(xnet_close(end)==-ETIMEDOUT);int64_t elapsed=k_uptime_get()-begin;
  held=status();assert(held.stopping&&!held.closed&&held.grants_held==grants&&!xl_revokes);
  assert(elapsed>=60&&elapsed<=80); /* native 10ms tick allowance, not a target bound */
  assert(xl_api->send(NULL,&packet)==-ENETDOWN);
  release();xl_complete_tx();xl_case="net-ok";assert(!xnet_close(k_uptime_get()+1000));
  assert(status().cleanup_error==-ETIMEDOUT);finished(grants);
 }
 if(!strcmp(scenario,"packet-stop")){
  xnet_stop_request();assert(xl_api->send(NULL,&packet)==-ENETDOWN);
  release();xl_complete_tx();reaped(1); /* stop seals producers, not completion drain */
  assert(status().stopping&&!status().connected);xl_case="net-ok";
  assert(!xnet_close(k_uptime_get()+1000));finished(grants);
 }
 if(!strcmp(scenario,"packet-closing")||!strcmp(scenario,"packet-kernel-error")){
  if(!strcmp(scenario,"packet-closing")){
   xl_case="wait-closing";xl_wait_enabled=true;assert(!observed(3).connected);
  }else{atomic_store(&xl_packet_lock_error,-EIO);link_stopped();}
  unsigned stopped=atomic_load(&xl_polls);release();xl_complete_tx();k_sleep(K_MSEC(40));
  assert(atomic_load(&xl_polls)==stopped&&xl_grants==grants&&!xl_revokes);
  assert(xl_api->send(NULL,&packet)==-ENETDOWN);xl_wait_enabled=false;xl_case="net-ok";
  assert(!xnet_close(k_uptime_get()+1000));finished(grants);
 }
 if(!strcmp(scenario,"packet-store")){
  xl_case="wait-timeout";xl_wait_enabled=true;assert(observed(2).connected);
 }
 if(!strcmp(scenario,"packet-corrupt")){
  release();xl_corrupt_tx();link_stopped();
  assert(atomic_load(&xl_poll_error)==-EPROTO&&!atomic_load(&xl_tx_done));
  assert(xnet_stats(&stats)==-ENETDOWN&&xl_api->send(NULL,&packet)==-ENETDOWN);
  assert(!xl_revokes);xl_case="net-ok";assert(xnet_close(k_uptime_get()+1000)==-ENETDOWN);
  assert(atomic_load(&xl_poll_error)==-EPROTO&&status().cleanup_error==-ENETDOWN);
  assert(!xnet_close(k_uptime_get()+1000));finished(grants);
 }
 int64_t released=k_uptime_get();release();xl_complete_tx();reaped(1);
 printf("PACKET_RECOVERY elapsed_ms=%lld\n",(long long)(k_uptime_get()-released));
 assert(status().connected&&xl_grants==grants&&!xl_revokes);
 if(!strcmp(scenario,"packet-store")){
  xl_wait_enabled=false;assert(observed(1).connected);
  assert(status().first_observation_error==-ETIMEDOUT);
 }
 unsigned total=1;
 if(!strcmp(scenario,"packet-repeat")){
  for(unsigned i=0;i<2;i++){
   struct xnet_waits prior;assert(!xnet_waits_get(&prior));hold();k_sleep(K_MSEC(100));
   assert(!xnet_waits_get(&delayed)&&delayed.packet_lock_timeouts>prior.packet_lock_timeouts);
   release();xl_complete_tx();reaped(++total);
  }
 }
 assert(!xnet_waits_get(&delayed)&&delayed.packet_polls>polls&&delayed.packet_last_poll_ms);
 xl_case="net-ok";assert(!xl_api->send(NULL,&packet));xl_complete_tx();
 reaped(total+1);assert(!xnet_close(k_uptime_get()+1000));finished(grants);
}
```

## src/starter.c
```c
/* Execute the actual Starter main/exercise with the same external boundaries. */
#include <lifecycle_boundary.h>
#include <xenova/netfront.h>
#include <xenova/shutdown.h>
#include <xenova/runtime.h>
#include <assert.h>
#include <stdio.h>
#include <stdlib.h>
#include <string.h>
int xl_starter_main(void);
int starter_exercise_stop(int64_t);
int main(void) {
 xl_case=getenv("XL_CASE");assert(xl_case);xl_net_init();
 int rc=xl_starter_main();
 assert(!strcmp(xl_case,"net-ok")?rc==0:rc<0);
 assert(!xshutdown_stop(k_uptime_get()+1000));
 assert(!starter_exercise_stop(k_uptime_get()+1000));
 assert(!xnet_close(k_uptime_get()+1000));
 struct xnet_status n;struct xshutdown_status s;
 assert(!xnet_status_get(&n)&&!xshutdown_status_get(&s));
 assert(n.worker_joined&&!n.grants_held&&n.event_port<0);
 assert(s.worker_joined&&!s.watch_owned&&!s.features_possible);
 assert(!xl_hypercalls); /* Local init errors never become poweroff/reboot. */
 assert(!xsr_close(k_uptime_get()+1000));
 printf("PASS actual Network Starter lifecycle %s initial=%d\n",xl_case,rc);
 exit(0);
}
```

## src/wait.c
```c
/* Real packet/state threads; only the existing Store boundary is delayed. */
#include <lifecycle_boundary.h>
#include <xenova/netfront.h>
#include <assert.h>
#include <stdio.h>
#include <stdlib.h>
#include <string.h>
#include <errno.h>
int main(void) {
 xl_case=getenv("XL_CASE");assert(xl_case);xl_net_init();assert(!xnet_start());
 xl_wait_enabled=true;
 assert(!k_sem_take(&xl_store_wait,K_SECONDS(1)));
 if(!strcmp(xl_case,"wait-delay")) {
  unsigned before=atomic_load(&xl_polls);int64_t start=k_uptime_get();
  k_sleep(K_MSEC(20));unsigned progress=atomic_load(&xl_polls)-before;
  bool baseline=getenv("XL_EXPECT_BLOCKED")!=NULL;
  assert(baseline?progress==0:progress>0);
  printf("WAIT_RESULT {\"window_ms\":%lld,\"store_delay_ms\":35,\"packet_polls\":%u,\"baseline\":%s}\n",
   (long long)(k_uptime_get()-start),progress,baseline?"true":"false");
 } else {
  k_sleep(K_MSEC(20));struct xnet_status s;assert(!xnet_status_get(&s));
  bool transient=!strcmp(xl_case,"wait-timeout");
  assert(s.backend_observation==(!strcmp(xl_case,"wait-closing")?3:transient?2:4));
  assert(transient?!s.backend_error&&s.observation_error:s.backend_error!=0);
  struct net_pkt p={.length=14};assert(xl_api->send(NULL,&p)==(transient?0:-ENETDOWN));
  if(transient)xl_complete_tx();
  printf("WAIT_RESULT {\"observation\":%d,\"error\":%d}\n",s.backend_observation,s.backend_error);
 }
 xl_wait_enabled=false;assert(!xnet_close(k_uptime_get()+1000));
 struct xnet_status s;assert(!xnet_status_get(&s));assert(s.closed&&s.worker_joined);
 if(!getenv("XL_EXPECT_BLOCKED"))assert(s.monitor_joined);
 puts("PASS Store wait isolation and owned monitor cleanup");exit(0);
}
```
