## CMakeLists.txt
```
cmake_minimum_required(VERSION 3.20.5)
list(APPEND ZEPHYR_EXTRA_MODULES ${CMAKE_CURRENT_SOURCE_DIR}/../../../guests/zephyr/xen-store ${CMAKE_CURRENT_SOURCE_DIR}/../../../guests/zephyr/xen-runtime)
find_package(Zephyr REQUIRED HINTS $ENV{ZEPHYR_BASE})
project(xenova_shutdown_api_smoke)
target_sources(app PRIVATE src/main.c)
```

## prj.conf
```kconfig
CONFIG_CONSOLE=y
CONFIG_PRINTK=y
CONFIG_TIMER_READS_ITS_FREQUENCY_AT_RUNTIME=y
CONFIG_MAIN_STACK_SIZE=4096
CONFIG_HEAP_MEM_POOL_SIZE=16384
CONFIG_XEN_GRANT_TABLE=y
CONFIG_XENOVA_XENSTORE=y
CONFIG_XENOVA_RUNTIME=y
```

## app.overlay
```dts
/* SPDX-License-Identifier: Apache-2.0 */
/* Match the Xen event PPI level trigger in this separate G1 trial. */
#include <zephyr/dt-bindings/interrupt-controller/arm-gic.h>

&hypervisor {
	interrupts = <GIC_PPI 0x0f IRQ_TYPE_LEVEL IRQ_DEFAULT_PRIORITY>;
};
```

## src/main.c
```c
/* SPDX-License-Identifier: Apache-2.0 */
/* Target API smoke only; no network driver or driving behavior. */
#include <xenova/shutdown.h>
#include <zephyr/kernel.h>
static int quiesce(const char *request,int64_t deadline,void *context) {
 ARG_UNUSED(request);ARG_UNUSED(deadline);ARG_UNUSED(context);return 0;
}
int main(void){return xshutdown_start(quiesce,NULL);}
```
