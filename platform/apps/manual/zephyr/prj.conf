## CMakeLists.txt
```
# SPDX-License-Identifier: Apache-2.0
# Zephyr 수동주행 앱. 보드: native_sim (PC 시험, 호스트 소켓으로 브로커 접속) / xenvm (Xen 게스트 펌웨어)
cmake_minimum_required(VERSION 3.20.5)
list(APPEND ZEPHYR_EXTRA_MODULES
  ${CMAKE_CURRENT_SOURCE_DIR}/../../common/xenova-mqtt-c
  ${CMAKE_CURRENT_SOURCE_DIR}/../../common/xenova-drive-runtime
  ${CMAKE_CURRENT_SOURCE_DIR}/../../../guests/zephyr/xen-store
  ${CMAKE_CURRENT_SOURCE_DIR}/../../../guests/zephyr/xen-runtime
  ${CMAKE_CURRENT_SOURCE_DIR}/../../../guests/zephyr/diagnostics
  ${CMAKE_CURRENT_SOURCE_DIR}/../../../guests/zephyr/telemetry)
find_package(Zephyr REQUIRED HINTS $ENV{ZEPHYR_BASE})
project(xenova_manual)
target_sources(app PRIVATE src/main.c src/manual.c)
```

## Kconfig
```
# SPDX-License-Identifier: Apache-2.0
mainmenu "Xenova manual drive app"

# Identity and separate app/Telemetry credentials are provisioned per execution.
source "Kconfig.zephyr"
```

## prj.conf
```kconfig
CONFIG_CONSOLE=y
CONFIG_PRINTK=y
CONFIG_BOOT_BANNER=n
CONFIG_MAIN_STACK_SIZE=8192
CONFIG_XENOVA_MQTT_RX_BUF=4096
CONFIG_XENOVA_MQTT_TX_BUF=4096
CONFIG_HEAP_MEM_POOL_SIZE=65536
CONFIG_ASSERT=y
CONFIG_NETWORKING=y
CONFIG_NET_L2_ETHERNET=y
CONFIG_NET_IPV4=y
CONFIG_NET_IPV6=n
CONFIG_NET_ARP=y
CONFIG_NET_DHCPV4=y
CONFIG_NET_UDP=y
CONFIG_NET_TCP=y
CONFIG_NET_CONFIG_SETTINGS=n
CONFIG_NET_RX_STACK_SIZE=4096
CONFIG_NET_TX_STACK_SIZE=4096
CONFIG_NET_PKT_RX_COUNT=16
CONFIG_NET_PKT_TX_COUNT=16
CONFIG_NET_BUF_RX_COUNT=32
CONFIG_NET_BUF_TX_COUNT=32
CONFIG_NET_BUF_DATA_SIZE=256
CONFIG_SHELL=y
CONFIG_SHELL_STACK_SIZE=4096
CONFIG_SHELL_BACKEND_SERIAL=y
# Xen HVC poll_out drops bytes on a full ring; FIFO TX retries until consumed.
CONFIG_SHELL_BACKEND_SERIAL_API_INTERRUPT_DRIVEN=y
CONFIG_NET_SHELL=y
CONFIG_LOG=y
CONFIG_LOG_MODE_DEFERRED=y
CONFIG_THREAD_NAME=y
CONFIG_INIT_STACKS=y
CONFIG_THREAD_STACK_INFO=y
CONFIG_XENOVA_DIAGNOSTICS=y
CONFIG_XENOVA_TELEMETRY=y
# DHCP transaction IDs and diagnostic ping only; no cryptographic identity.
CONFIG_TEST_RANDOM_GENERATOR=y
CONFIG_TIMER_RANDOM_GENERATOR=y
CONFIG_NET_SOCKETS=y
CONFIG_MQTT_LIB=y
CONFIG_XENOVA_MQTT=y
CONFIG_XENOVA_DRIVE_RUNTIME=y
```

## boards/native_sim_native_64.conf
```kconfig
# PC 시험 (BOARD=native_sim/native/64): Zephyr 소켓을 호스트 소켓으로 넘긴다 (Native Simulator Offloaded Sockets).
# zephyr samples/net/sockets/echo_server/overlay-nsos.conf 와 같은 설정
CONFIG_ETH_NATIVE_TAP=n
CONFIG_NET_DRIVERS=y
CONFIG_NET_SOCKETS_OFFLOAD=y
CONFIG_NET_NATIVE_OFFLOADED_SOCKETS=y
CONFIG_XENOVA_MANUAL_BROKER_HOST="127.0.0.1"
CONFIG_XENOVA_MANUAL_VM_ID="22222222-2222-4222-8222-222222222222"
```

## boards/xenvm.conf
```kconfig
# Xen 게스트: 고정 프로필 (platform/guests/zephyr/starter-app 과 같다). 네트워크 경로는 시나리오 D3 결정 대기
CONFIG_TIMER_READS_ITS_FREQUENCY_AT_RUNTIME=y
# vm_id 를 XenStore 에서 읽는다 (platform/guests/zephyr/xen-store)
CONFIG_XENOVA_XENSTORE=y
```

## src/main.c
```c
/*
 * Zephyr 수동주행 앱 (S15P31E110-155). 계산 main은 20 ms 마다 입력 사본을 읽는다:
 *   최신 drive.input·vehicle.control → manual_step → drive.command 발행, 1초마다 app.heartbeat.
 * 별도 v1 worker가 수신·keepalive·재연결과 최신 후보 송신을 소유한다.
 * 계약: docs/contracts/mqtt-contract-v1.md §5·§6.1·§7. Python 참조 구현: platform/apps/manual/xenova_manual
 */
#include <zephyr/kernel.h>
#include <zephyr/logging/log.h>
#include <string.h>
#include <errno.h>

#include "manual.h"
#include "xm_zclient.h"

#include <xenova/drive_runtime.h>
LOG_MODULE_REGISTER(xenova_manual, LOG_LEVEL_INF);

static struct xm_zclient client;
int main(void)
{
	char events[XM_TOPIC_MAX], control[XM_TOPIC_MAX], input[XM_TOPIC_MAX], json[XM_COMMAND2_BYTES+1];
	struct manual_cfg cfg;
	const char *last_state = NULL;

	manual_cfg_default(&cfg);
	xm_topic_app_events(events, sizeof(events), MANUAL_APP_ID);
	xm_topic_vehicle_control(control, sizeof(control));
	xm_topic_manual_input(input, sizeof(input));

	int rc = xd_start(MANUAL_APP_ID, MANUAL_PERIOD_MS);
	if (rc) { LOG_ERR("common runtime failed %d", rc); return xd_finish(&client, rc); }

	int64_t start = k_uptime_get();
	int64_t next_beat = start;
	uint64_t calculation_sequence=0;

	while (!xd_stopping()) {
		int io_rc = xd_client_prepare(&client, control, input);
		if (io_rc && io_rc != -EAGAIN && io_rc != -EBUSY) { rc = io_rc; break; }
		bool ready = io_rc == 0;
		int64_t now = k_uptime_get();
		uint64_t cycles_us;
		if ((rc = xdiag_clock_us(&cycles_us))) { break; }
		if (cycles_us >= xd_next_release_us()) {
			if (xd_iteration_begin()) { break; }
			struct manual_inputs in;
			struct manual_command cmd;
			const char *state;
			int64_t control_age, input_seq, control_seq;

			xd_latest(&client, input, "drive.input", &in.input_payload, &in.input_age_ms, &input_seq);
			xd_latest(&client, control, "vehicle.control", &in.control_payload, &control_age, &control_seq);
			if (xd_step_begin()) { break; }
			manual_step(&cfg, &in, &cmd, &state);
			if (xd_step_end()) { break; }
			if(calculation_sequence==UINT64_MAX){rc=-EOVERFLOW;break;}
			++calculation_sequence;
			struct xm_manual_input source;
			int modern=xm_manual_input_parse(in.input_payload,&source);
			int encoded;
			if(!modern){
				/* The standalone legacy app has no actual Vehicle/clock owner.
				 * Modern propulsion runs in the integrated drive-manual app; a
				 * keys-only fallback here would invent both safety witnesses. */
				uint64_t completed;if((rc=xdiag_clock_us(&completed)))break;
				struct xm_drive_command2 stop={.generation=cmd.generation,
				 .calculation_sequence=calculation_sequence,.completed_guest_us=completed,
				 .driver_action_seq=source.action,.driver_state_seq=source.state};
				strcpy(stop.producer_role,"MANUAL");strcpy(stop.command_kind,"STOP");
				strcpy(stop.mission_id,"00000000-0000-0000-0000-000000000000");
				strcpy(stop.driver_session,source.session);
				struct xm_drive_command3 safe={.command=stop,.clock_probe_sequence=0};
				encoded=xm_drive_command3_json(json,sizeof(json),&safe);
			}else encoded=xm_drive_command_json(json, sizeof(json), cmd.generation, cmd.v_mps, cmd.steer_rad);
			xd_command(&client, events, json, encoded, cmd.generation, cmd.v_mps, cmd.steer_rad, input_seq, control_seq, in.input_age_ms, cfg.input_timeout_ms);

			if (ready && !xd_stopping() && now >= next_beat) {
				xm_app_heartbeat_json(json, sizeof(json), state, now - start);
				xd_publish(&client, events, "app.heartbeat", json);
				next_beat += ((now-next_beat)/MANUAL_HEARTBEAT_MS+1)*MANUAL_HEARTBEAT_MS;
			}
			if (state != last_state) {
				LOG_INF("state=%s generation=%u", state, cmd.generation);
				last_state = state;
			}
			/* Core and app share one fixed origin. Expired releases are skipped,
			 * not resynchronized to now+period or replayed as a burst. */
			uint64_t end_us;
			if ((rc = xdiag_clock_us(&end_us))) { break; }
			int32_t wait_ms = end_us < xd_next_release_us() ?
				(int32_t)((xd_next_release_us() - end_us + 999U) / 1000U) : 0;
			if (!xd_stopping()) { k_msleep(wait_ms); }
			xd_iteration_end();
		} else { k_sleep(K_MSEC(1)); }
	}
	return xd_finish(&client, rc);
}
```

## src/manual.c
```c
/* 수동주행 앱 로직 — Python xenova_manual/keymap.py·app.py 와 같은 규칙 (tests/test_manual.c 로 대조) */
#include <errno.h>
#include <string.h>

#include "manual.h"

void manual_cfg_default(struct manual_cfg *cfg)
{
	/* 실차 측정 전 값. 1/10 RC카 실내 시연 기준 (Python ManualSettings 기본값과 같다) */
	cfg->max_speed_mps = 1.0f;
	cfg->max_reverse_mps = 0.5f;
	cfg->max_steer_rad = 0.4f;
	cfg->input_timeout_ms = MANUAL_INPUT_TIMEOUT_MS;
}

void manual_target(const struct manual_cfg *cfg, uint32_t keys, float *v_mps, float *steer_rad)
{
	bool up = keys & XM_KEY_UP, down = keys & XM_KEY_DOWN;
	bool left = keys & XM_KEY_LEFT, right = keys & XM_KEY_RIGHT;

	if ((keys & XM_KEY_BRAKE) || (up && down)) {
		*v_mps = 0.0f;
	} else {
		*v_mps = (up ? cfg->max_speed_mps : 0.0f) - (down ? cfg->max_reverse_mps : 0.0f);
	}
	*steer_rad = (left ? cfg->max_steer_rad : 0.0f) - (right ? cfg->max_steer_rad : 0.0f);
}

void manual_step(const struct manual_cfg *cfg, const struct manual_inputs *in, struct manual_command *out,
		 const char **state)
{
	struct xm_vehicle_control control;
	uint32_t keys = 0;

	out->v_mps = 0.0f;
	out->steer_rad = 0.0f;
	struct xm_manual_input modern;
	int modern_rc = xm_manual_input_parse(in->input_payload, &modern);
	if (in->input_payload.p != NULL && in->input_age_ms <= cfg->input_timeout_ms &&
	    modern_rc == -ENOMSG &&
	    xm_drive_input_parse(in->input_payload, &keys) == 0) {
		manual_target(cfg, keys, &out->v_mps, &out->steer_rad);
	}

	if (in->control_payload.p != NULL && xm_vehicle_control_parse(in->control_payload, &control) == 0) {
		out->generation = control.generation;
		*state = strcmp(control.active_app, MANUAL_APP_ID) == 0 ? "active" : "standby";
	} else {
		out->generation = 0; /* ESP32 는 세대가 다르면 버리므로 차는 움직이지 않는다 */
		*state = "idle";
	}
}

static bool same_source(const struct xm_manual_input *a,const struct xm_manual_input *b)
{
 return a->profile==b->profile&&a->kind==b->kind&&!strcmp(a->session,b->session)&&
  !strcmp(a->source_instance,b->source_instance)&&!strcmp(a->device_instance,b->device_instance);
}
static bool same_admission(const struct xm_manual_input *a,const struct xm_manual_input *b)
{
 return !strcmp(a->input_epoch,b->input_epoch)&&a->grant_revision==b->grant_revision;
}
static int lease_stop(struct manual_lease_gate *g,struct manual_lease_command *out,int error,bool block)
{
 out->target.v_mps=out->target.steer_rad=0;out->stop=true;
 g->running=false;g->waiting_stop=true;g->blocked|=block;g->continuation_closed=true;
 return error;
}
int manual_lease_step(const struct manual_cfg *cfg,struct manual_lease_gate *g,const struct xm_manual_input *s,
 const struct xm_vehicle_control *control,const struct manual_lease_facts *f,struct manual_lease_command *out)
{
 if(!cfg||!g||!s||!control||!f||!out)return -EINVAL;
 *out=(struct manual_lease_command){.target.generation=control->generation,.stop=true};
 bool continuing=(!g->seen||same_source(&g->last,s))&&!strcmp(control->manual_policy,"CONTINUE_SESSION")&&f->continuation;
 bool first_continuation=continuing&&!g->seen&&!g->continuation_closed;
 if(!f->current||strcmp(control->mode,"MANUAL")||strcmp(control->active_app,MANUAL_APP_ID)||
    strcmp(control->manual_session,s->session)||!control->generation||
    s->generation>control->generation||
    (s->generation!=control->generation&&!continuing))return lease_stop(g,out,-EXDEV,false);
 if(g->generation>control->generation)return lease_stop(g,out,-EXDEV,true);
 if(g->generation&&g->generation!=control->generation&&!continuing){
  bool closed=g->continuation_closed;
  *g=(struct manual_lease_gate){.generation=control->generation,.waiting_stop=true,.continuation_closed=closed};
 }
 g->generation=control->generation;
 bool admitted_reset=!g->seen;
 if(g->seen){
  if(!same_source(&g->last,s)){
   /* A source change is a new selected driver context, never keyset fallback. */
   return lease_stop(g,out,-EXDEV,true);
  }
  if(s->state<g->last.state||s->action<g->last.action)return lease_stop(g,out,-EALREADY,false);
  if(s->state==g->last.state&&memcmp(s,&g->last,sizeof(*s)))return lease_stop(g,out,-EXDEV,true);
  if(s->state>g->last.state&&s->valid&&s->sample<=g->last.sample)return lease_stop(g,out,-EXDEV,true);
  if(s->action==g->last.action&&s->valid&&s->keys&&s->keys!=g->last.keys)return lease_stop(g,out,-EXDEV,true);
  if(s->kind==XM_MANUAL_PULSE&&s->keys&&s->action==g->last.action&&
     s->expires_pi_us!=g->last.expires_pi_us)return lease_stop(g,out,-EXDEV,true);
  if(!same_admission(&g->last,s)){
   bool reset=s->kind==XM_MANUAL_HELD&&s->state>g->last.state&&!s->valid&&!s->keys&&
    s->grant_revision>g->last.grant_revision&&!strcmp(s->reason,"REARM_REQUIRED");
   if(!reset)return lease_stop(g,out,-EXDEV,true);
   admitted_reset=true;
   g->blocked=false;g->rejected_action=0;g->waiting_stop=true;g->running=false;
  }
  /* A current HELD source that actually lost its lease cannot be revived by a
   * later sample. A stale result alone does not modify a newer source here. */
  if(s->kind==XM_MANUAL_HELD&&s->valid&&g->last.valid&&s->state>g->last.state&&
     s->source_pi_us>=g->last.expires_pi_us&&same_admission(&g->last,s))return lease_stop(g,out,-ETIME,true);
 }
 bool fresh=!g->seen||s->state>g->last.state;
 bool reset=s->kind==XM_MANUAL_HELD&&!s->valid&&!s->keys&&!strcmp(s->reason,"REARM_REQUIRED");
 bool release=s->kind==XM_MANUAL_HELD&&!s->valid&&!s->keys&&!strcmp(s->reason,"USER_RELEASE");
 if(fresh){g->last=*s;g->seen=true;g->continuation_closed=true;}
 if(!s->valid){
  if(reset&&admitted_reset)g->blocked=false;
  return lease_stop(g,out,(release||reset)&&!g->blocked?0:-ENODATA,!reset&&!release);
 }
 if(g->blocked)return lease_stop(g,out,-ENODATA,true);
 bool up=(s->keys&XM_KEY_UP)!=0,down=(s->keys&XM_KEY_DOWN)!=0;
 bool left=(s->keys&XM_KEY_LEFT)!=0,right=(s->keys&XM_KEY_RIGHT)!=0;
 if((up&&down)||(left&&right)||(s->keys&XM_KEY_BRAKE))return lease_stop(g,out,-EINVAL,s->kind==XM_MANUAL_HELD);
 int direction=up?1:down?-1:0;
 if(!direction||s->kind==XM_MANUAL_NEUTRAL_ONLY){
  /* A/D-only is STOP/steering hold, not an in-place servo request. */
  if(g->running){g->running=false;g->waiting_stop=true;}
  if(f->stop_ready)g->waiting_stop=false;
  return 0;
 }
 if(s->source_pi_us>f->now_pi_us||s->expires_pi_us<=f->now_pi_us||
    !f->command_until_pi_us||f->command_until_pi_us<=f->now_pi_us||
    f->command_until_pi_us>s->expires_pi_us||f->command_until_pi_us-f->now_pi_us>100000)return lease_stop(g,out,-ETIME,false);
 if(s->action<=g->rejected_action)return lease_stop(g,out,-ENODATA,false);
 bool reverse=g->direction&&g->direction!=direction;
 if(!g->running||reverse){
  /* A prepared B's first exact same-SID continuation has current Gateway
   * registry/input/clock/Vehicle proof. It does not invent a serial STOP or
   * turn moving feedback into stationary. Faults/fences/expiry spend this
   * one first-entry allowance for the whole app execution. */
  if(!first_continuation&&(!f->stop_ready||!f->stop_sequence||
     (g->direction&&f->stop_sequence==g->used_stop_sequence))){
   g->rejected_action=s->action;
   return lease_stop(g,out,-EAGAIN,false);
  }
  if(!first_continuation)g->used_stop_sequence=f->stop_sequence;
 }
 g->running=true;g->waiting_stop=false;g->direction=direction;
 manual_target(cfg,s->keys,&out->target.v_mps,&out->target.steer_rad);
 out->valid_until_pi_us=f->command_until_pi_us;out->stop=false;
 return 0;
}

int manual_vm_id_from_xenstore(const char *path, char out[XM_UUID_LEN + 1])
{
	static const char prefix[] = "/vm/";

	if (path == NULL || strncmp(path, prefix, sizeof(prefix) - 1) != 0) {
		return -EINVAL;
	}
	const char *uuid = path + sizeof(prefix) - 1;

	if (strlen(uuid) != XM_UUID_LEN) {
		return -EINVAL;
	}
	for (int i = 0; i < XM_UUID_LEN; i++) {
		char c = uuid[i];
		bool dash = i == 8 || i == 13 || i == 18 || i == 23;

		if (dash ? c != '-' : !((c >= '0' && c <= '9') || (c >= 'a' && c <= 'f') || (c >= 'A' && c <= 'F'))) {
			return -EINVAL;
		}
		out[i] = (c >= 'A' && c <= 'F') ? (char)(c - 'A' + 'a') : c;
	}
	out[XM_UUID_LEN] = '\0';
	if (strcmp(out, "00000000-0000-0000-0000-000000000000") == 0) {
		return -EINVAL; /* nil UUID 는 Domain-0 몫 (에이전트와 같은 규칙) */
	}
	return 0;
}
```

## src/manual.h
```c
/*
 * 수동주행 앱 로직 (OS 무관). Python 참조 구현(platform/apps/manual/xenova_manual)과 같은 동작:
 *  - 키 → (v_mps, steer_rad): up 전진, down 후진, left +, right −, 반대 키 동시면 그 축 0, brake 면 속도 0 (계약 §7)
 *  - drive.input 이 input_timeout_ms 보다 오래됐거나 keys 가 배열이 아니면 정지
 *  - generation 은 vehicle/control 값, 못 받았으면 0
 *  - app.heartbeat state: control 없음 idle, active_app == manual 이면 active, 아니면 standby (계약 §6.1)
 */
#ifndef XENOVA_MANUAL_H_
#define XENOVA_MANUAL_H_

#include <stdbool.h>
#include <stdint.h>

#include "xenova/mqtt/xm.h"

#define MANUAL_APP_ID           "manual"
#define MANUAL_PERIOD_MS        20   /* 계약 5.3: 50 Hz */
#define MANUAL_HEARTBEAT_MS     1000 /* 계약 6.1 */
#define MANUAL_INPUT_TIMEOUT_MS 200  /* 계약 7: 4번 놓치면 손을 뗀 것 */

struct manual_cfg {
	float max_speed_mps;
	float max_reverse_mps;
	float max_steer_rad;
	int64_t input_timeout_ms;
};

/* 한 주기 입력: 최신 메시지의 payload 와 나이. 없으면 payload.p == NULL */
struct manual_inputs {
	struct xm_span input_payload;   /* drive.input */
	int64_t input_age_ms;
	struct xm_span control_payload; /* vehicle.control */
};

struct manual_command {
	uint32_t generation;
	float v_mps;
	float steer_rad;
};

void manual_cfg_default(struct manual_cfg *cfg);
/*
 * Xen 이 자기 도메인의 XenStore "vm" 에 적어 둔 "/vm/<uuid>" 에서 vm_id 를 꺼낸다 (설계 §6 D5).
 * xen.cfg 의 uuid 가 플랫폼 vm_id 라 에이전트의 /etc/xenova/instance-id 와 같은 값이다. 소문자 표준형으로 낸다.
 */
int manual_vm_id_from_xenstore(const char *path, char out[XM_UUID_LEN + 1]);
void manual_target(const struct manual_cfg *cfg, uint32_t keys, float *v_mps, float *steer_rad);
/* 한 주기 계산. *state 에 heartbeat state 문자열 */
void manual_step(const struct manual_cfg *cfg, const struct manual_inputs *in, struct manual_command *out,
		 const char **state);

/* input2/3 계산자의 실제 Pi clock/차량/권위 검산 결과. wire나 copied READY가
 * 아니라 호출 시점의 소비자 증거다. STOP 준비는 원 STOP/APPLIED+fresh stationary를
 * 확인한 경계만 true로 준다. 실제 같은 방향/SID 승계에서는 Gateway가 검산한
 * 원 gate carry도 사용할 수 있으며 단순히 측정속도 0이라고 true로 만들지 않는다.
 * continuation은 실제 같은 SID 승계 검산 결과다. 최초 prepared B의 current
 * continuation은 별도 stop_ready/serial 번호를 발명하지 않고 한 번 진입한다. */
struct manual_lease_facts {
 uint64_t now_pi_us,command_until_pi_us,stop_sequence;
 bool current,stop_ready,continuation;
};
struct manual_lease_gate {
 struct xm_manual_input last;
 uint64_t rejected_action,used_stop_sequence;
 uint32_t generation;
 int direction;
 bool seen,blocked,waiting_stop,running,continuation_closed;
};
/* gate는 실제 joined app 실행 수명에 속한다. fault/fence/만료·mode 전환으로
 * zero-init하여 최초 continuation permit을 재발급하지 않는다. 새 실행만 초기화한다. */
struct manual_lease_command {
 struct manual_command target;
 uint64_t valid_until_pi_us;
 bool stop;
};
/* 원 입력 E·순번·generation을 수정하지 않는다. nonzero 실패는 STOP 결과이며
 * 원 action을 기다렸다가 자동 실행하지 않는다. legacy manual_step과 분리한다. */
int manual_lease_step(const struct manual_cfg *,struct manual_lease_gate *,const struct xm_manual_input *,
 const struct xm_vehicle_control *,const struct manual_lease_facts *,struct manual_lease_command *);

#endif /* XENOVA_MANUAL_H_ */
```
