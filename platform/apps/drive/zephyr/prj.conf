## CMakeLists.txt
```
# SPDX-License-Identifier: Apache-2.0
cmake_minimum_required(VERSION 3.20.5)
list(APPEND ZEPHYR_EXTRA_MODULES
  ${CMAKE_CURRENT_SOURCE_DIR}/../../common/xenova-mqtt-c
  ${CMAKE_CURRENT_SOURCE_DIR}/../../common/xenova-drive-runtime
  ${CMAKE_CURRENT_SOURCE_DIR}/../../../guests/zephyr/xen-store
  ${CMAKE_CURRENT_SOURCE_DIR}/../../../guests/zephyr/xen-runtime
  ${CMAKE_CURRENT_SOURCE_DIR}/../../../guests/zephyr/diagnostics
  ${CMAKE_CURRENT_SOURCE_DIR}/../../../guests/zephyr/telemetry)
find_package(Zephyr REQUIRED HINTS $ENV{ZEPHYR_BASE})
project(xenova_drive)
target_include_directories(app PRIVATE ../../autonomous/zephyr/src ../../manual/zephyr/src)
target_sources(app PRIVATE src/main.c src/controller.c src/adapter.c
  ../../autonomous/zephyr/src/autonomous.c ../../manual/zephyr/src/manual.c)
target_sources_ifdef(CONFIG_XENOVA_DRIVE_WORKERS app PRIVATE src/workers.c)

if(CONFIG_XENOVA_DRIVE_LATTICE)
  if(CONFIG_NET_NATIVE)
    set(DRIVE_CONN_MIN ${CONFIG_NET_MAX_CONTEXTS})
    if(CONFIG_NET_DHCPV4)
      math(EXPR DRIVE_CONN_MIN "${DRIVE_CONN_MIN} + 1")
    endif()
    if(CONFIG_NET_MAX_CONN LESS DRIVE_CONN_MIN)
      message(FATAL_ERROR "Lattice network endpoints require ${DRIVE_CONN_MIN}: configured contexts plus the DHCP handler")
    endif()
  endif()
  set(DRIVE_WORLD ${CMAKE_CURRENT_SOURCE_DIR}/../world)
  set(DRIVE_PLANNER ${CMAKE_CURRENT_SOURCE_DIR}/../planner)
  target_include_directories(app PRIVATE ${DRIVE_WORLD} ${DRIVE_WORLD}/generated
    ${DRIVE_WORLD}/nanopb ${DRIVE_PLANNER})
  target_sources(app PRIVATE src/lattice_app.c src/lattice_input.c src/lattice_memory.c
    ${DRIVE_WORLD}/world.c ${DRIVE_WORLD}/generated/world.pb.c
    ${DRIVE_WORLD}/nanopb/pb_common.c ${DRIVE_WORLD}/nanopb/pb_decode.c ${DRIVE_WORLD}/nanopb/pb_encode.c
    ${DRIVE_PLANNER}/task_reference.c ${DRIVE_PLANNER}/behavior.c ${DRIVE_PLANNER}/parking.c
    ${DRIVE_PLANNER}/lattice.c ${DRIVE_PLANNER}/engine.c ${DRIVE_PLANNER}/generated/primitives.c)
endif()
```

## Kconfig
```
# SPDX-License-Identifier: Apache-2.0
mainmenu "Xenova common A/B drive firmware"
source "Kconfig.zephyr"

config XENOVA_DRIVE_INPUT_DIAGNOSTICS
	bool "Bounded input clock/map diagnostics for an explicit trial build"
	depends on XENOVA_DRIVE_LATTICE && LOG && LOG_MODE_DEFERRED
	depends on !LOG_BLOCK_IN_THREAD && !LOG_MODE_IMMEDIATE && !LOG_FRONTEND
	default n
	help
	  Attempt at most 16 numeric clock and 8 map records per boot using the
	  existing deferred logger. Records may be dropped; they are not required
	  execution evidence. Does not enable native bootstrap or change timing,
	  identity, source trust, readiness or output authority.
```

## prj.conf
```kconfig
CONFIG_CONSOLE=y
CONFIG_PRINTK=y
CONFIG_BOOT_BANNER=n
CONFIG_MAIN_STACK_SIZE=8192
CONFIG_HEAP_MEM_POOL_SIZE=65536
CONFIG_ASSERT=y
CONFIG_NETWORKING=y
CONFIG_NET_L2_ETHERNET=y
CONFIG_NET_IPV4=y
CONFIG_NET_IPV6=n
CONFIG_NET_ARP=y
CONFIG_NET_DHCPV4=y
CONFIG_NET_UDP=y
CONFIG_NET_TCP=y
CONFIG_NET_CONFIG_SETTINGS=n
CONFIG_NET_RX_STACK_SIZE=4096
CONFIG_NET_TX_STACK_SIZE=4096
# Frozen ARM TCP retransmit/ARP-miss C frames need 1152 B before architecture saves.
# Keep scheduling/exception headroom; target high-water still requires validation.
CONFIG_NET_TCP_WORKQ_STACK_SIZE=2048
CONFIG_NET_PKT_RX_COUNT=16
CONFIG_NET_PKT_TX_COUNT=16
CONFIG_NET_BUF_RX_COUNT=32
CONFIG_NET_BUF_TX_COUNT=32
CONFIG_NET_BUF_DATA_SIZE=256
CONFIG_SHELL=y
CONFIG_SHELL_STACK_SIZE=4096
CONFIG_SHELL_BACKEND_SERIAL=y
# Xen HVC poll_out drops bytes on a full ring; FIFO TX retries until consumed.
CONFIG_SHELL_BACKEND_SERIAL_API_INTERRUPT_DRIVEN=y
CONFIG_NET_SHELL=y
CONFIG_LOG=y
CONFIG_LOG_MODE_DEFERRED=y
CONFIG_THREAD_NAME=y
CONFIG_INIT_STACKS=y
CONFIG_THREAD_STACK_INFO=y
CONFIG_XENOVA_DIAGNOSTICS=y
CONFIG_XENOVA_TELEMETRY=y
# DHCP transaction IDs and diagnostic ping only; no cryptographic identity.
CONFIG_TEST_RANDOM_GENERATOR=y
CONFIG_TIMER_RANDOM_GENERATOR=y
CONFIG_NET_SOCKETS=y
CONFIG_MQTT_LIB=y
CONFIG_XENOVA_MQTT=y
CONFIG_XENOVA_MQTT_MAX_SUBS=6
CONFIG_XENOVA_MQTT_LATEST_SLOTS=6
CONFIG_XENOVA_MQTT_PUB_TOPICS=8
CONFIG_XENOVA_DRIVE_RUNTIME=y
CONFIG_XENOVA_DRIVE_WORKERS=y
CONFIG_XENOVA_AUTO_DELAY_INJECTION=y

# input2/3와 command3의 명시 profile envelope 상한이다. legacy parser 상한은 유지한다.
CONFIG_XENOVA_MQTT_RX_BUF=4096
CONFIG_XENOVA_MQTT_TX_BUF=4096
```

## src/main.c
```c
/* SPDX-License-Identifier: Apache-2.0 */
/* A/B share this binary and one v1 I/O owner. Each calculation has its own
 * preemptible owner; the coordinator never waits for a calculation callback. */
#include <zephyr/kernel.h>
#include <xenova/drive_runtime.h>
#include <errno.h>
#include <string.h>
#include <stdio.h>
#include "controller.h"
#include "lifecycle.h"
#include "workers.h"
#if defined(CONFIG_XENOVA_DRIVE_LATTICE)
#include "lattice_app.h"
#endif

static struct xm_zclient client;
static struct drive_controller controller;
static struct xd_inputs inputs, source;
static struct drive_job job;
static struct drive_completion completed[DRIVE_TASK_COUNT];
static struct xdh_health health[DRIVE_TASK_COUNT];
static uint64_t seen[DRIVE_TASK_COUNT];
static uint64_t assessed_revision[DRIVE_TASK_COUNT], assessed_connection[DRIVE_TASK_COUNT];
static int64_t next_beat[DRIVE_TASK_COUNT], next_readiness[DRIVE_TASK_COUNT];
#if defined(CONFIG_XENOVA_DRIVE_WARM) && defined(CONFIG_XENOVA_DRIVE_LATTICE)
static struct drive_command_gate command_gate[DRIVE_TASK_COUNT];
#endif
#if defined(CONFIG_XENOVA_DRIVE_WARM)
struct app_lifecycle {
 char instance[XM_UUID_LEN+1],last_phase[16],last_state[16],last_reason[65];
 uint64_t check;uint32_t generation;int64_t due,stop_due;
 bool rotating,failed,residual_reported;
};
static struct app_lifecycle lifecycle[DRIVE_TASK_COUNT];
/* Only a changed root Bootstrap requests reset. No fault-driven restart
 * policy is introduced here. Revocation and join observation are separate. */
static bool warm_prepare(enum drive_task task)
{
 struct app_lifecycle *a=&lifecycle[task];const char *expected=inputs.app_instances[task];
 if(!expected[0])return false;
 if(a->failed){if(!strcmp(a->instance,expected))return false;a->failed=false;}
 if(!a->instance[0]){strcpy(a->instance,expected);return true;}
 if(!strcmp(a->instance,expected)&&!a->rotating)return true;
 struct drive_task_status status;
 if(drive_workers_status(task,&status))return false;
 if(!a->rotating){
  a->stop_due=k_uptime_get()+CONFIG_XENOVA_DRIVE_APP_STOP_MS;
  int rc=drive_task_cancel(task,status.lifetime,a->stop_due);
  if(rc)return false;
  xd_health_task_clear(task);
  a->rotating=true;
 }
 int rc=drive_task_join_poll(task,status.lifetime);
 if(rc){
  if(rc==-ETIMEDOUT&&!a->residual_reported){(void)xdiag_error("app-reinit-residual",rc);a->residual_reported=true;}
  return false;
 }
 struct drive_adapter *adapter=task==DRIVE_TASK_AUTO?&controller.automatic:&controller.manual;
#if defined(CONFIG_XENOVA_DRIVE_LATTICE)
 if(task==DRIVE_TASK_AUTO){int ready=drive_lattice_reset_poll(a->stop_due);if(ready)return false;}
 drive_lattice_adapter(adapter,task==DRIVE_TASK_MANUAL);
#else
 if(task==DRIVE_TASK_AUTO)drive_auto_adapter(adapter,&controller.auto_cfg);
 else drive_manual_adapter(adapter,&controller.manual_cfg);
#endif
 rc=drive_task_restart(task,status.lifetime,adapter);
 if(rc){strcpy(a->instance,expected);a->rotating=false;a->failed=true;(void)xdiag_error("app-reinit-start",rc);return false;}
 strcpy(a->instance,expected);a->rotating=false;a->check=0;a->due=0;a->residual_reported=false;
 seen[task]=assessed_revision[task]=assessed_connection[task]=0;
 memset(&completed[task],0,sizeof(completed[task]));memset(&health[task],0,sizeof(health[task]));
 return true;
}
static void warm_report(enum drive_task task,const struct drive_result *selected)
{
 struct app_lifecycle *a=&lifecycle[task];struct drive_task_status status;
 if(!a->instance[0]||a->rotating||a->failed||strcmp(a->instance,inputs.app_instances[task])||
    drive_workers_status(task,&status))return;
 bool chosen=selected->locally_active&&selected->mode==(task==DRIVE_TASK_AUTO?DRIVE_AUTO:DRIVE_MANUAL);
 const struct xd_received *in=task==DRIVE_TASK_AUTO?&inputs.perception:&inputs.input;
 struct drive_adapter *adapter=task==DRIVE_TASK_AUTO?&controller.automatic:&controller.manual;
 int64_t tick=k_uptime_get();
 const struct drive_completion *work=&completed[task];
 uint64_t clock=0;bool clock_valid=true;
 if(chosen&&drive_warm_current(&status,work,inputs.control_revision,inputs.connection_revision))clock_valid=xdiag_clock_us(&clock)==0;
 struct drive_warm_view view=drive_warm_classify(adapter,selected,&status,work,chosen,
  (struct xm_span){in->error?NULL:in->payload,in->error?0:in->length},in->error?-1:tick-in->received_ms,
  inputs.control_revision,inputs.connection_revision,tick,clock,clock_valid);
 const char *phase=view.phase,*state=view.state,*reason=view.reason;uint32_t generation=view.generation;
 bool changed=generation!=a->generation||strcmp(a->last_phase,phase)||strcmp(a->last_state,state)||strcmp(a->last_reason,reason?reason:"");
 if(!changed&&tick<a->due)return;
 if(a->check==UINT64_MAX){a->failed=true;(void)xdiag_error("app-supervision",-EOVERFLOW);return;}
 char topic[XM_TOPIC_MAX],payload[256];
 int n=xm_app_lifecycle_json(payload,sizeof(payload),generation,++a->check,work->progress,phase,state,reason);
 xm_topic_vm_app_events(topic,sizeof(topic),inputs.vm_id,task==DRIVE_TASK_AUTO?AUTO_APP_ID:MANUAL_APP_ID);
 if(n>0)(void)xd_publish_supervision(topic,payload,a->check,tick,&inputs);
 strcpy(a->last_phase,phase);strcpy(a->last_state,state);strcpy(a->last_reason,reason?reason:"");
 a->generation=generation;a->due=tick+100;
}
#endif
static void announce(const char *events,enum auto_reason previous,const struct drive_result *result,
 const struct drive_completion *work)
{
 const char *kind=NULL;char detail[48],json[96];
 if(result->auto_reason==AUTO_REASON_OBSTACLE_STOP){
  kind="obstacle";
  if(result->nearest_m>=0)snprintf(detail,sizeof(detail),"stop %d cm",(int)(result->nearest_m*100+.5f));
  else strcpy(detail,"stop");
 }else if(result->auto_reason==AUTO_REASON_NO_PERCEPTION){kind="perception_lost";strcpy(detail,"stop");}
 else if(previous==AUTO_REASON_OBSTACLE_STOP){kind="obstacle_cleared";strcpy(detail,"resume");}
 else if(previous==AUTO_REASON_NO_PERCEPTION){kind="perception_restored";strcpy(detail,"resume");}
 if(kind&&xm_perception_event_json(json,sizeof(json),kind,detail)>0)
  (void)xd_publish_completed(events,"perception.event",json,work->sequence,work->finished_ms,&source);
}
static int finish(int result)
{
 drive_workers_stop();
 int cleanup=drive_workers_join(xd_cleanup_deadline_ms());
 if(cleanup)xd_app_cleanup_error(cleanup);
#if defined(CONFIG_XENOVA_DRIVE_LATTICE)
 int input_cleanup=drive_lattice_join(xd_cleanup_deadline_ms());
 if(input_cleanup){xd_app_cleanup_error(input_cleanup);if(!cleanup)cleanup=input_cleanup;}
 if(!input_cleanup&&!cleanup)drive_lattice_report();
#endif
 return xd_finish(&client,result?result:cleanup);
}
static void provenance(const struct drive_completion *work,enum drive_task task)
{
 memset(&source,0,sizeof(source));
 strcpy(source.vm_id,work->source.vm_id);source.dual_mode=true;
 strcpy(source.app_instances[task],work->source.app_instance);
 source.control_revision=work->source.context_revision;
 source.connection_revision=work->source.connection_revision;
 source.control.seq=work->source.control_seq;
 source.input.error=source.perception.error=-ENODATA;
 struct xd_received *in=task==DRIVE_TASK_AUTO?&source.perception:&source.input;
 in->seq=work->source.input_seq;in->received_ms=work->source.input_received_ms;
 in->error=work->source.input_length?0:-ENODATA;
 /* 현대 MANUAL의 최종 송신 guard는 계산 당시 원 입력을 다시 검산한다.
  * 최신 RX body로 대체하거나 metadata만 있는 빈 payload를 넘기지 않는다. */
 in->length=work->source.input_length;
 if(in->length)memcpy(in->payload,work->source.input,in->length);
}
static int offer(enum drive_task task,uint64_t release,uint64_t sequence,uint64_t iteration_begin)
{
 const struct xd_received *in=task==DRIVE_TASK_AUTO?&inputs.perception:&inputs.input;
 memset(&job,0,sizeof(job));
 job.sequence=sequence;job.context_revision=inputs.control_revision;
 job.connection_revision=inputs.connection_revision;
 job.release_us=release;job.deadline_us=release+20000;
 job.iteration_begin_us=iteration_begin;
 struct drive_task_status status;int rc=drive_workers_status(task,&status);if(rc)return rc;
 job.lifetime=status.lifetime;
 job.input_seq=in->seq;job.control_seq=inputs.control.seq;job.input_received_ms=in->received_ms;
 if(task==DRIVE_TASK_MANUAL)job.manual_witness=inputs.manual_witness;
 strcpy(job.vm_id,inputs.vm_id);
 strcpy(job.app_instance,inputs.app_instances[task]);
 if(!inputs.control.error)job.control_length=inputs.control.length;
 if(!in->error)job.input_length=in->length;
 if(job.control_length>sizeof(job.control)-1||job.input_length>sizeof(job.input)-1)return -EMSGSIZE;
 memcpy(job.control,inputs.control.payload,job.control_length);
 memcpy(job.input,in->payload,job.input_length);
 return drive_workers_offer(task,&job);
}
/* Only the publication view changes epoch. The immutable completion remains
 * in counter time for lattice preparation and its original lease guards. */
static int command_time(const struct drive_completion *work,int64_t tick,int64_t *until,int64_t *age)
{
 const struct drive_sample *sample=&work->sample;
 if(sample->clock_domain==DRIVE_SAMPLE_UPTIME_MS){
  *until=sample->valid_until_ms;
  *age=tick-(sample->binary_input?sample->input_received_ms:work->source.input_received_ms);
  return 0;
 }
 if(sample->clock_domain!=DRIVE_SAMPLE_COUNTER_MS)return -EINVAL;
 int64_t before=k_uptime_get();uint64_t counter;
 int rc=xdiag_clock_us(&counter);if(rc)return rc;
 int64_t after=k_uptime_get();
 if(before<0||after<before||counter<work->end_us)return -ERANGE;
 int64_t elapsed;
 if(sample->binary_input){
  if(sample->input_received_ms<0)return -ERANGE;
  if((uint64_t)sample->input_received_ms>UINT64_MAX/1000)return -EOVERFLOW;
  uint64_t source_us=(uint64_t)sample->input_received_ms*1000;
  if(counter<source_us)return -ERANGE;
  uint64_t delta=counter-source_us;
  uint64_t age_ms=delta/1000+(delta%1000!=0);
  /* Millisecond uptime quantization leaves up to one extra millisecond in
   * the sampling interval. Charge it rather than understate input age. */
  uint64_t sampling_ms=(uint64_t)(after-before)+1;
  if(sampling_ms>(uint64_t)INT64_MAX||age_ms>(uint64_t)INT64_MAX-sampling_ms)return -EOVERFLOW;
  elapsed=(int64_t)(age_ms+sampling_ms);
 }else{
  if(work->source.input_received_ms<0||after<work->source.input_received_ms)return -ERANGE;
  elapsed=after-work->source.input_received_ms;
 }
 *age=elapsed;
 if(sample->valid_until_ms<=0)return -ETIME;
 if((uint64_t)sample->valid_until_ms>UINT64_MAX/1000)return -EOVERFLOW;
 uint64_t expiry=(uint64_t)sample->valid_until_ms*1000;
 if(counter>=expiry)return -ETIME;
 uint64_t remaining_ms=(expiry-counter)/1000;
 if(remaining_ms>(uint64_t)(INT64_MAX-before))return -EOVERFLOW;
 int64_t bound=before+(int64_t)remaining_ms;
 if(bound<=after)return -ETIME;
 *until=bound;return 0;
}
int main(void)
{
 char control[XM_TOPIC_MAX],input[XM_TOPIC_MAX],perception[XM_TOPIC_MAX];
 char events[XM_TOPIC_MAX],json[XM_COMMAND2_BYTES+1];
 xm_topic_vehicle_control(control,sizeof(control));xm_topic_manual_input(input,sizeof(input));
 xm_topic_app_events(perception,sizeof(perception),"perception");
 drive_controller_init(&controller);
 int rc=xd_start("drive-controller",20);
 if(rc)return finish(rc);
#if defined(CONFIG_XENOVA_DRIVE_LATTICE)
 rc=drive_lattice_start(&controller);if(rc)return finish(rc);
#endif
 rc=drive_workers_start(&controller.automatic,&controller.manual);
 if(rc)return finish(rc);
 uint64_t origin=xd_next_release_us(),next=origin;
 int64_t start=k_uptime_get();
 enum auto_reason last_reason=AUTO_REASON_NO_PERCEPTION;bool seen_perception=false;
 while(!xd_stopping()){
  int io=xd_client_prepare_dual(&client,control,input,perception);
  if(io&&io!=-EAGAIN&&io!=-EBUSY){rc=io;break;}
  if((rc=xd_iteration_begin()))break;
  xd_inputs_copy(&inputs);
#if defined(CONFIG_XENOVA_DRIVE_LATTICE)
  /* An unobserved busy snapshot denies this cycle without revoking the
   * derived clock; its original lease and observed disconnect guards remain. */
  if(xd_inputs_status()!=-EBUSY)drive_lattice_context(&inputs);
#endif
  struct xm_span cp={inputs.control.payload,inputs.control.length};
  if(inputs.control.error)cp=(struct xm_span){0};
  struct drive_result selected;drive_controller_select(&controller,inputs.vm_id,cp,&selected);
#if defined(CONFIG_XENOVA_DRIVE_WARM)
  bool admitted[DRIVE_TASK_COUNT];
  for(unsigned task=0;task<DRIVE_TASK_COUNT;task++)admitted[task]=warm_prepare(task);
#endif
  uint64_t now;if((rc=xdiag_clock_us(&now)))break;
  if(now>=next){
   uint64_t release=next+((now-next)/20000)*20000;
   if(release>UINT64_MAX-20000){rc=-EOVERFLOW;break;}
   next=release+20000;
   if(selected.control_valid&&inputs.control_revision&&strlen(inputs.vm_id)==XM_UUID_LEN){
    for(unsigned task=0;task<DRIVE_TASK_COUNT;task++){
#if defined(CONFIG_XENOVA_DRIVE_WARM)
     if(!admitted[task]||!selected.locally_active||selected.mode!=(task==DRIVE_TASK_AUTO?DRIVE_AUTO:DRIVE_MANUAL))continue;
#endif
     int status=offer(task,release,(release-origin)/20000+1,now);
     if(status&&status!=-EBUSY&&status!=-EALREADY){rc=status;break;}
    }
    if(rc)break;
   }
  }
  for(unsigned task=0;task<DRIVE_TASK_COUNT;task++){
#if defined(CONFIG_XENOVA_DRIVE_WARM)
   if(!admitted[task])continue;
#endif
   struct drive_completion *work=&completed[task];
   int status=drive_workers_read(task,inputs.control_revision,work);
   if(status==-ENODATA||status==-EXDEV||status==-EBUSY||status==-ESHUTDOWN)continue;
   if(status){rc=status;break;}
   if(work->sequence<=seen[task])continue;
   seen[task]=work->sequence;
   if(!work->performed||!selected.control_valid||
      work->source.connection_revision!=inputs.connection_revision||strcmp(work->source.vm_id,inputs.vm_id))continue;
   health[task]=work->health;
#if defined(CONFIG_XENOVA_DRIVE_LATTICE)
   drive_lattice_completed(work);
#endif
   assessed_revision[task]=work->context_revision;
   assessed_connection[task]=work->source.connection_revision;
   provenance(work,task);
   bool automatic=task==DRIVE_TASK_AUTO;
   bool chosen=automatic?selected.mode==DRIVE_AUTO:selected.mode!=DRIVE_AUTO;
   xm_topic_vm_app_events(events,sizeof(events),inputs.vm_id,automatic?AUTO_APP_ID:MANUAL_APP_ID);
   int64_t tick=k_uptime_get();
   if(!IS_ENABLED(CONFIG_XENOVA_DRIVE_WARM)&&tick>=next_readiness[task]&&!xd_stopping()){
    const char *reason=work->sample.reason;
    const char *ready=!reason?"READY":!strcmp(reason,"STATE_PREPARING")?"PREPARING":"NOT_READY";
    int n=xm_app_readiness_json(json,sizeof(json),selected.generation,work->progress,ready,reason);
    if(n>0)(void)xd_publish_completed(events,"app.readiness",json,work->sequence,work->finished_ms,&source);
    next_readiness[task]=tick+100;
   }
   if(tick>=next_beat[task]&&!xd_stopping()){
    const char *state=work->health.restrict_function?"error":selected.locally_active&&chosen?"active":"standby";
    int n=xm_app_heartbeat_json(json,sizeof(json),state,tick-start);
    if(n>0)(void)xd_publish_completed(events,"app.heartbeat",json,work->sequence,work->finished_ms,&source);
    next_beat[task]=tick+1000;
   }
   if(!chosen)continue;
   status=xd_completed_work(work->source.release_us,work->begin_us,work->end_us,
    work->source.iteration_begin_us,work->finished_ms,&source);
   if(status==-EALREADY)continue;
   if(status){rc=status;break;}
   /* Never publish an unassessed mode's zero-initialized health, nor attach
    * a result from an older control/connection to the new pair. */
   if(assessed_revision[0]==inputs.control_revision&&assessed_revision[1]==inputs.control_revision&&
      assessed_connection[0]==inputs.connection_revision&&assessed_connection[1]==inputs.connection_revision)
    xd_health_record(&health[DRIVE_TASK_AUTO],&health[DRIVE_TASK_MANUAL]);
   if(IS_ENABLED(CONFIG_XENOVA_DRIVE_WARM))xd_health_task_record(task,&work->health);
   bool command_due=true;
#if defined(CONFIG_XENOVA_DRIVE_WARM) && defined(CONFIG_XENOVA_DRIVE_LATTICE)
   struct drive_command_context command_context={.control_revision=work->context_revision,
    .connection_revision=work->source.connection_revision,.lifetime=work->source.lifetime,
    .generation=selected.generation,.mode=selected.mode};
   strcpy(command_context.app_instance,work->source.app_instance);
   command_due=drive_command_attempt_due(&command_gate[task],&command_context,lifecycle[task].check,
    work->sample.reason,work->sample.v_mps,work->sample.steer_rad);
#endif
   if(selected.mode!=DRIVE_STOP&&command_due){
    if((rc=xd_command_input(work->sample.binary_input?"world.track":automatic?"perception.result":"drive.input")))break;
    int64_t until=0,age=0;int encoded;
#if defined(CONFIG_XENOVA_DRIVE_LATTICE)
    struct xm_drive_command3 modern={0};uint64_t original_guest_until=0;
    if(work->sample.modern_command){
     status=drive_lattice_command(work,&modern,&original_guest_until);
     bool stop=!strcmp(modern.command.command_kind,"STOP");
     if(!status&&!stop){
      int64_t unused_bound=0;status=command_time(work,tick,&unused_bound,&age);
      if(!status)status=xd_command_bound_us(original_guest_until);
     }else if(stop&&!work->sample.binary_input)age=tick-work->source.input_received_ms;
     /* STOP은 만료한 계산/clock 때문에 보류하지 않는다. body는 원 completion을 나타낸다. */
     encoded=status?status:xm_drive_command3_json(json,sizeof(json),&modern);
     if(encoded>0)drive_lattice_command_attempt(work,&modern);
    }else
#endif
    {
     status=command_time(work,tick,&until,&age);
     if(status&&status!=-ETIME){rc=status;break;}
     if(!status&&until>0&&(rc=xd_command_bound(until)))break;
     encoded=status?status:xm_drive_command_json(json,sizeof(json),selected.generation,work->sample.v_mps,work->sample.steer_rad);
    }
    xd_command(&client,events,json,encoded,selected.generation,work->sample.v_mps,work->sample.steer_rad,
     work->sample.binary_input?work->sample.input_sequence:work->source.input_seq,work->source.control_seq,age,
     automatic?controller.auto_cfg.perception_timeout_ms:controller.manual_cfg.input_timeout_ms);
   }
   if(automatic&&work->sample.auto_reason!=last_reason){
    selected.auto_reason=work->sample.auto_reason;selected.nearest_m=work->sample.nearest_m;
    if(selected.locally_active&&seen_perception&&!xd_stopping())announce(events,last_reason,&selected,work);
    seen_perception=seen_perception||selected.auto_reason!=AUTO_REASON_NO_PERCEPTION;
    last_reason=selected.auto_reason;
   }
   xd_iteration_end();
  }
#if defined(CONFIG_XENOVA_DRIVE_WARM)
  for(unsigned task=0;task<DRIVE_TASK_COUNT;task++)warm_report(task,&selected);
#endif
  if(rc)break;
  if(!xd_stopping())k_sleep(K_MSEC(1));
 }
 return finish(rc);
}
```

## src/adapter.c
```c
/* SPDX-License-Identifier: Apache-2.0 */
/* Existing stateless algorithms. Replacements keep the adapter contract. */
#include "adapter.h"
#include <errno.h>
#include <string.h>

static int automatic(void *context,struct xm_span control,struct xm_span input,int64_t age,struct drive_sample *out)
{
 struct auto_cfg *cfg=context;struct auto_command cmd;struct auto_status status;
 struct auto_inputs in={.control_payload=control,.perception_payload=input,.perception_age_ms=age};
 auto_step(cfg,&in,&cmd,&status);
 out->v_mps=cmd.v_mps;out->steer_rad=cmd.steer_rad;out->nearest_m=status.nearest_m;out->auto_reason=status.reason;
 struct xm_perception_result parsed;
 if(!input.p)out->reason="INPUT_UNAVAILABLE";
 else if(age<0||age>cfg->perception_timeout_ms)out->reason="INPUT_STALE";
 else if(xm_perception_result_parse(input,&parsed))out->reason="INPUT_INVALID";
 return 0;
}
static int manual(void *context,struct xm_span control,struct xm_span input,int64_t age,struct drive_sample *out)
{
 struct manual_cfg *cfg=context;struct manual_command cmd;const char *state;
 struct manual_inputs in={.control_payload=control,.input_payload=input,.input_age_ms=age};
 manual_step(cfg,&in,&cmd,&state);out->v_mps=cmd.v_mps;out->steer_rad=cmd.steer_rad;
 uint32_t keys;
 if(!input.p)out->reason="INPUT_UNAVAILABLE";
 else if(age<0||age>cfg->input_timeout_ms)out->reason="INPUT_STALE";
 else if(xm_drive_input_parse(input,&keys))out->reason="INPUT_INVALID";
 return 0;
}
static const char *auto_qualify(const void *context,struct xm_span input,int64_t age)
{
 const struct auto_cfg *cfg=context;struct xm_perception_result parsed;
 if(!input.p)return "INPUT_UNAVAILABLE";
 if(age<0||age>cfg->perception_timeout_ms)return "INPUT_STALE";
 return xm_perception_result_parse(input,&parsed)?"INPUT_INVALID":NULL;
}
static const char *manual_qualify(const void *context,struct xm_span input,int64_t age)
{
 const struct manual_cfg *cfg=context;uint32_t keys;
 if(!input.p)return "INPUT_UNAVAILABLE";
 if(age<0||age>cfg->input_timeout_ms)return "INPUT_STALE";
 struct xm_manual_sample source;int rc=xm_manual_sample_parse(input,&source);
 if(rc!=-ENOMSG){
  if(rc)return "INPUT_INVALID";
  if(!source.valid)return "INPUT_UNAVAILABLE";
  if((uint64_t)age+source.age_ms>(uint64_t)cfg->input_timeout_ms)return "INPUT_STALE";
 }
 return xm_drive_input_parse(input,&keys)?"INPUT_INVALID":NULL;
}
const char *drive_adapter_qualify(const struct drive_adapter *adapter,struct xm_span input,int64_t age)
{
 if(!adapter||!adapter->qualify)return "STATE_PREPARING";
 if(adapter->requires_state_sync&&(!adapter->state_ready||
    !(adapter->state_usable?adapter->state_usable(adapter->context):drive_state_usable(adapter->prepared_state,adapter->state_context))))return "STATE_PREPARING";
 return adapter->qualify(adapter->context,input,age);
}
void drive_auto_adapter(struct drive_adapter *a,struct auto_cfg *cfg)
{
 auto_cfg_default(cfg);*a=(struct drive_adapter){.calculate=automatic,.context=cfg,
  .input_timeout_ms=cfg->perception_timeout_ms,.state_ready=true,.qualify=auto_qualify};
}
void drive_manual_adapter(struct drive_adapter *a,struct manual_cfg *cfg)
{
 manual_cfg_default(cfg);*a=(struct drive_adapter){.calculate=manual,.context=cfg,
  .input_timeout_ms=cfg->input_timeout_ms,.state_ready=true,.qualify=manual_qualify,.manual_input=true};
}
int drive_adapter_run(struct drive_adapter *a,struct xm_span control,struct xm_span input,int64_t age,struct drive_sample *out)
{
 return drive_adapter_run_observed(a,control,input,age,NULL,NULL,out);
}
int drive_adapter_run_observed(struct drive_adapter *a,struct xm_span control,struct xm_span input,
 int64_t age,const struct xd_manual_witness *w,const char *receiver,struct drive_sample *out)
{
 return drive_adapter_run_until(a,control,input,age,w,receiver,UINT64_MAX,out);
}
int drive_adapter_run_until(struct drive_adapter *a,struct xm_span control,struct xm_span input,
 int64_t age,const struct xd_manual_witness *w,const char *receiver,uint64_t deadline,struct drive_sample *out)
{
 memset(out,0,sizeof(*out));
 int rc=a->calculate_until?a->calculate_until(a->context,control,input,age,deadline,out):
  a->calculate?a->calculate(a->context,control,input,age,out):-ENOSYS;
 if(rc||a->progress==UINT64_MAX){out->reason="CALCULATION_FAILED";out->v_mps=out->steer_rad=0;return rc?rc:-EOVERFLOW;}
 ++a->progress;
 if(!__builtin_isfinite(out->v_mps)||!__builtin_isfinite(out->steer_rad)){
  out->reason="OUTPUT_INVALID";out->v_mps=out->steer_rad=0;return -ERANGE;
 }
 if(a->requires_state_sync){
  const char *ready=drive_adapter_qualify(a,input,age);
  if(ready){out->reason=ready;out->v_mps=out->steer_rad=0;}
 }
 if(a->manual_input&&!out->modern_command){
  struct xm_vehicle_control selected;
  if(!xm_vehicle_control_parse(control,&selected)&&selected.manual_policy[0]){
   struct xm_manual_sample source;
   int gate=drive_manual_begin(&a->movement,&selected);
   if(!gate)gate=xm_manual_sample_parse(input,&source);
   if(!gate&&w&&w->present){
    const struct xm_manual_sample *n=&w->neutral;
    if(!receiver||strcmp(receiver,w->receiver)||!n->valid||n->keys||n->age_ms>200||
       w->received_ms<0||strcmp(n->session,selected.manual_session)||n->generation!=selected.generation||
       n->sample>source.sample||n->action>source.action)gate=-EXDEV;
    else if(!a->movement.neutral||n->action>a->movement.neutral_action){
     a->movement.neutral=true;a->movement.neutral_action=n->action;
    }
   }
   if(!gate)gate=drive_manual_observe(&a->movement,&source,age);
   if(gate){out->reason=gate==-ETIME?"INPUT_STALE":gate==-ENODATA?"INPUT_UNAVAILABLE":"INPUT_INVALID";out->v_mps=out->steer_rad=0;}
   else if(!a->movement.allowed)out->v_mps=out->steer_rad=0;
  }
 }
 return 0;
}
```

## src/adapter.h
```c
/* SPDX-License-Identifier: Apache-2.0 */
/* App replacement boundary: calculation, input/state readiness and output
 * validation belong here. The runtime does not interpret algorithm reasons. */
#ifndef XENOVA_DRIVE_ADAPTER_H
#define XENOVA_DRIVE_ADAPTER_H
#include <xenova/mqtt/xm.h>
#include "autonomous.h"
#include "manual.h"
#include "preparation.h"
#include "manual_session.h"
#include "state_transfer.h"
#include <xenova/manual_input.h>

/* valid_until_ms and, for binary input only, input_received_ms retain this
 * epoch until publication. Zero keeps existing adapters in uptime-ms. */
enum drive_sample_clock { DRIVE_SAMPLE_UPTIME_MS, DRIVE_SAMPLE_COUNTER_MS };
struct drive_sample { float v_mps,steer_rad,nearest_m; enum auto_reason auto_reason; const char *reason;
 bool binary_input;enum drive_sample_clock clock_domain;int64_t input_sequence,input_received_ms,valid_until_ms;
 char map_epoch[37];uint64_t reference_revision,observation_sequence;uint32_t path_generation,tracker_index,maneuver_phase;
 /* 현대 command는 원 계산 snapshot에 추가한다. 위 legacy clock/source prefix는 유지한다. */
 bool modern_command,gate_required,hold_steer;int requested_direction;
 struct xm_drive_command3 command;uint64_t valid_until_guest_us,phase_until_pi_us;
 unsigned segment_index,cusp_index; };
typedef int (*drive_calculate)(void *context,struct xm_span control,struct xm_span input,
                               int64_t age_ms,struct drive_sample *out);
/* Bounded validation of immutable configuration/input, no work progress or I/O. */
typedef const char *(*drive_qualify)(const void *context,struct xm_span input,int64_t age_ms);
struct drive_adapter {
 drive_calculate calculate;
 int (*calculate_until)(void *,struct xm_span,struct xm_span,int64_t,uint64_t,struct drive_sample *);
 void *context;
 uint32_t input_timeout_ms;
 uint64_t progress;
 /* Stateful replacements must leave state_ready false until their own
  * synchronization/warm-up completes; a return from calculate is insufficient. */
 bool requires_state_sync,state_ready;
 /* Immutable app-owned proof and expected receiving context. Both outlive
  * worker join. A boolean alone never qualifies a stateful replacement. */
 const struct drive_state_preparation *prepared_state;
 const struct drive_state_context *state_context;
 bool manual_input;
 struct drive_manual_gate movement;
 drive_qualify qualify;
 bool (*state_usable)(const void *);
};
/* Successful application is preparation, not calculation progress or READY.
 * The adapter owner must already have joined any previous state consumer. */
static inline int drive_adapter_apply_maneuver(struct drive_adapter *adapter,
 struct drive_maneuver_copy *copy,const struct xm_envelope *envelope,struct xm_span payload,
 const struct xm_vehicle_control *control,const char *receiver_vm,
 const struct drive_state_context *target,const struct xm_state_context *current,
 const char *const *segments,size_t count,uint64_t now,uint64_t deadline)
{
 if(!adapter||!adapter->requires_state_sync||adapter->state_ready)return -EINVAL;
 int rc=drive_apply_maneuver(copy,envelope,payload,control,receiver_vm,target,current,segments,count,now,deadline);
 if(!rc){adapter->prepared_state=&copy->prepared;adapter->state_context=target;adapter->state_ready=true;}
 return rc;
}
void drive_auto_adapter(struct drive_adapter *,struct auto_cfg *);
void drive_manual_adapter(struct drive_adapter *,struct manual_cfg *);
int drive_adapter_run(struct drive_adapter *,struct xm_span control,struct xm_span input,
                      int64_t age_ms,struct drive_sample *out);
/* Immutable receive-owner neutral proof is scoped to this app instance.
 * It does not grant movement; the latest fresh sample must still pass the gate. */
int drive_adapter_run_observed(struct drive_adapter *,struct xm_span control,struct xm_span input,
 int64_t age_ms,const struct xd_manual_witness *,const char *receiver,struct drive_sample *out);
int drive_adapter_run_until(struct drive_adapter *,struct xm_span control,struct xm_span input,
 int64_t age_ms,const struct xd_manual_witness *,const char *receiver,uint64_t deadline_us,struct drive_sample *out);
const char *drive_adapter_qualify(const struct drive_adapter *,struct xm_span input,int64_t age_ms);
#endif
```

## src/auto_delay.c
```c
/* SPDX-License-Identifier: Apache-2.0 */
#include "auto_delay.h"

#include <zephyr/kernel.h>
#include <errno.h>

static struct k_spinlock lock;
static uint32_t configured_delay_ms;
static uint32_t consecutive_misses;
static int64_t expires_at_ms;
static bool unhealthy;

static bool active_locked(int64_t now)
{
	if (!configured_delay_ms || now >= expires_at_ms) {
		configured_delay_ms = 0;
		expires_at_ms = 0;
		return false;
	}
	return true;
}

int drive_auto_delay_start(uint32_t delay_ms, uint32_t duration_s)
{
	if (!delay_ms || delay_ms > DRIVE_AUTO_DELAY_MAX_MS || !duration_s ||
	    duration_s > DRIVE_AUTO_DELAY_MAX_DURATION_S) {
		return -EINVAL;
	}

	k_spinlock_key_t key = k_spin_lock(&lock);
	if (active_locked(k_uptime_get())) {
		k_spin_unlock(&lock, key);
		return -EBUSY;
	}
	configured_delay_ms = delay_ms;
	expires_at_ms = k_uptime_get() + (int64_t)duration_s * 1000;
	consecutive_misses = 0;
	unhealthy = false;
	k_spin_unlock(&lock, key);
	return 0;
}

void drive_auto_delay_stop(void)
{
	k_spinlock_key_t key = k_spin_lock(&lock);
	configured_delay_ms = 0;
	expires_at_ms = 0;
	consecutive_misses = 0;
	unhealthy = false;
	k_spin_unlock(&lock, key);
}

bool drive_auto_delay_active(void)
{
	k_spinlock_key_t key = k_spin_lock(&lock);
	bool active = active_locked(k_uptime_get());
	k_spin_unlock(&lock, key);
	return active;
}

void drive_auto_delay_apply(void)
{
	uint32_t delay_ms = 0;
	k_spinlock_key_t key = k_spin_lock(&lock);
	if (active_locked(k_uptime_get())) {
		delay_ms = configured_delay_ms;
	}
	k_spin_unlock(&lock, key);
	if (delay_ms) {
		k_busy_wait(delay_ms * 1000U);
	}
}

bool drive_auto_delay_observe_deadline(bool missed)
{
	k_spinlock_key_t key = k_spin_lock(&lock);
	if (missed) {
		if (consecutive_misses < DRIVE_AUTO_DEADLINE_MISS_LIMIT) {
			++consecutive_misses;
		}
		unhealthy = consecutive_misses >= DRIVE_AUTO_DEADLINE_MISS_LIMIT;
	} else {
		consecutive_misses = 0;
		unhealthy = false;
	}
	bool result = unhealthy;
	k_spin_unlock(&lock, key);
	return result;
}

void drive_auto_delay_status_get(struct drive_auto_delay_status *out)
{
	if (!out) {
		return;
	}
	k_spinlock_key_t key = k_spin_lock(&lock);
	bool active = active_locked(k_uptime_get());
	*out = (struct drive_auto_delay_status){
		.delay_ms = configured_delay_ms,
		.consecutive_deadline_misses = consecutive_misses,
		.expires_at_ms = expires_at_ms,
		.active = active,
		.unhealthy = unhealthy,
	};
	k_spin_unlock(&lock, key);
}
```

## src/auto_delay.h
```c
/* SPDX-License-Identifier: Apache-2.0 */
/* Test-only AUTO calculation delay. MQTT command wiring is deliberately separate. */
#ifndef XENOVA_DRIVE_AUTO_DELAY_H
#define XENOVA_DRIVE_AUTO_DELAY_H

#include <stdbool.h>
#include <stdint.h>
#include <errno.h>

#define DRIVE_AUTO_DELAY_MAX_MS 100U
#define DRIVE_AUTO_DELAY_MAX_DURATION_S 120U
#define DRIVE_AUTO_DEADLINE_MISS_LIMIT 5U

struct drive_auto_delay_status {
	uint32_t delay_ms;
	uint32_t consecutive_deadline_misses;
	int64_t expires_at_ms;
	bool active;
	bool unhealthy;
};

#if defined(CONFIG_XENOVA_AUTO_DELAY_INJECTION)
int drive_auto_delay_start(uint32_t delay_ms, uint32_t duration_s);
void drive_auto_delay_stop(void);
bool drive_auto_delay_active(void);
void drive_auto_delay_apply(void);
bool drive_auto_delay_observe_deadline(bool missed);
void drive_auto_delay_status_get(struct drive_auto_delay_status *out);
#else
static inline int drive_auto_delay_start(uint32_t delay_ms, uint32_t duration_s)
{
	(void)delay_ms;
	(void)duration_s;
	return -ENOTSUP;
}
static inline void drive_auto_delay_stop(void) {}
static inline bool drive_auto_delay_active(void) { return false; }
static inline void drive_auto_delay_apply(void) {}
static inline bool drive_auto_delay_observe_deadline(bool missed)
{
	(void)missed;
	return false;
}
static inline void drive_auto_delay_status_get(struct drive_auto_delay_status *out)
{
	if (out) {
		*out = (struct drive_auto_delay_status){0};
	}
}
#endif

#endif
```

## src/controller.c
```c
/* SPDX-License-Identifier: Apache-2.0 */
#include "controller.h"
#include <string.h>

bool drive_command_attempt_due(struct drive_command_gate *gate,const struct drive_command_context *context,
 uint64_t check,const char *reason,float v_mps,float steer_rad)
{
 if(!gate)return true;
 /* Exact zero excludes NaN/Inf without changing the existing output guard.
  * Invalid metadata must pass to the original path, never become a cache key. */
 size_t reason_length=reason?strnlen(reason,sizeof(gate->reason)):0;
 if(!reason_length||reason_length>=sizeof(gate->reason)||v_mps!=0||steer_rad!=0||!context||
    !context->control_revision||!context->connection_revision||!context->lifetime||!context->generation||
    (context->mode!=DRIVE_AUTO&&context->mode!=DRIVE_MANUAL)||
    strnlen(context->app_instance,sizeof(context->app_instance))!=XM_UUID_LEN){
  gate->restricted=false;return true;
 }
 bool same=gate->restricted&&gate->context.control_revision==context->control_revision&&
  gate->context.connection_revision==context->connection_revision&&gate->context.lifetime==context->lifetime&&
  gate->context.generation==context->generation&&gate->context.mode==context->mode&&
  !strcmp(gate->context.app_instance,context->app_instance)&&!strcmp(gate->reason,reason);
 if(same&&gate->check==check)return false;
 /* The check is a local supervisor observation, not a new command deadline.
  * Retain only the last attempted check; do not claim queue or device success. */
 gate->context=*context;gate->check=check;
 memcpy(gate->reason,reason,reason_length+1);gate->restricted=true;
 return true;
}

void drive_controller_init(struct drive_controller *c)
{
 memset(c,0,sizeof(*c));drive_auto_adapter(&c->automatic,&c->auto_cfg);drive_manual_adapter(&c->manual,&c->manual_cfg);
}
void drive_controller_health(struct drive_controller *c,int (*clock)(uint64_t *),
 uint64_t deadline,uint64_t uptime,const struct xdr_snapshot *resources,int resource_rc)
{
 c->clock_us=clock;c->deadline_us=deadline;c->resource_uptime_ms=uptime;
 c->resources=resources;c->resource_rc=resource_rc;
}
void drive_controller_deadline_missed(struct drive_result *r)
{
 if(!r->auto_health.restrict_function)r->auto_health.failure=XDH_DEADLINE;
 if(!r->manual_health.restrict_function)r->manual_health.failure=XDH_DEADLINE;
 r->auto_health.restrict_function=r->manual_health.restrict_function=true;
 if(!r->auto_not_ready||strcmp(r->auto_not_ready,"OUTPUT_INVALID"))r->auto_not_ready="CALCULATION_FAILED";
 if(!r->manual_not_ready||strcmp(r->manual_not_ready,"OUTPUT_INVALID"))r->manual_not_ready="CALCULATION_FAILED";
 r->auto_readiness=r->manual_readiness="NOT_READY";
 r->auto_state=r->manual_state="error";
 r->v_mps=r->steer_rad=0;
}
static void calculate(struct drive_controller *c,struct drive_adapter *adapter,
 struct xm_span control,struct xm_span input,int64_t age,struct drive_sample *sample,
 struct xdh_health *health)
{
 uint64_t begin=0,end=0;int clock_rc=c->clock_us?c->clock_us(&begin):0;
 int rc=drive_adapter_run(adapter,control,input,age,sample);
 if(!c->clock_us)return;
 int end_rc=c->clock_us(&end);
 struct xdh_work work={.state=XDH_COMPLETED,.required=true,.rc=rc,
  .clock_rc=clock_rc?clock_rc:end_rc,.begin_us=begin,.end_us=end,.deadline_us=c->deadline_us};
 (void)xdh_assess(&work,end,c->resource_uptime_ms,c->resources,c->resource_rc,health);
 if(health->restrict_function){
  if(!sample->reason||(strcmp(sample->reason,"OUTPUT_INVALID")&&strcmp(sample->reason,"CALCULATION_FAILED")))
   sample->reason="CALCULATION_FAILED";
  sample->v_mps=sample->steer_rad=0;
 }
}
static bool control_valid(struct drive_controller *c,struct xm_span payload,struct xm_vehicle_control *v)
{
 if(xm_vehicle_control_parse(payload,v))return false;
 bool safe=!strcmp(v->mode,"SAFE_STOP")&&!v->active_app[0]&&!v->active_vm_id[0];
 bool automatic=!strcmp(v->mode,"AUTO")&&!strcmp(v->active_app,AUTO_APP_ID);
 bool manual=(!strcmp(v->mode,"MANUAL")||!strcmp(v->mode,"AUTO_READY"))&&!strcmp(v->active_app,MANUAL_APP_ID);
 if(!safe&&(!(automatic||manual)||!v->active_vm_id[0]||
    !strcmp(v->active_vm_id,"00000000-0000-0000-0000-000000000000")))return false;
 if(c->seen_control){
  if(v->generation<c->accepted.generation)return false;
  if(v->generation==c->accepted.generation&&
     (strcmp(v->mode,c->accepted.mode)||strcmp(v->active_app,c->accepted.active_app)||
      strcmp(v->active_vm_id,c->accepted.active_vm_id)||strcmp(v->manual_session,c->accepted.manual_session)||
      strcmp(v->manual_policy,c->accepted.manual_policy)))return false;
 }
 c->accepted=*v;c->seen_control=true;return true;
}
void drive_controller_select(struct drive_controller *c,const char *local_vm_id,
 struct xm_span control,struct drive_result *out)
{
 struct xm_vehicle_control v;
 memset(out,0,sizeof(*out));
 out->control_valid=control_valid(c,control,&v);
 if(!out->control_valid)return;
 out->generation=v.generation;
 out->locally_active=local_vm_id&&!strcmp(local_vm_id,v.active_vm_id);
 if(!strcmp(v.mode,"AUTO"))out->mode=DRIVE_AUTO;
 else if(!strcmp(v.mode,"MANUAL")||!strcmp(v.mode,"AUTO_READY"))out->mode=DRIVE_MANUAL;
}
void drive_controller_step(struct drive_controller *c,const char *local_vm_id,
 struct xm_span control,struct xm_span input,int64_t input_age_ms,
 struct xm_span perception,int64_t perception_age_ms,struct drive_result *out)
{
 drive_controller_select(c,local_vm_id,control,out);
 struct xm_span accepted=out->control_valid?control:(struct xm_span){0};
 struct drive_sample ac,mc;
 calculate(c,&c->automatic,accepted,perception,perception_age_ms,&ac,&out->auto_health);
 calculate(c,&c->manual,accepted,input,input_age_ms,&mc,&out->manual_health);
 out->auto_progress=c->automatic.progress;out->manual_progress=c->manual.progress;
 out->auto_not_ready=out->control_valid?ac.reason:"CONTROL_UNAPPLIED";
 out->manual_not_ready=out->control_valid?mc.reason:"CONTROL_UNAPPLIED";
 out->auto_readiness=!out->auto_not_ready?"READY":!strcmp(out->auto_not_ready,"STATE_PREPARING")?"PREPARING":"NOT_READY";
 out->manual_readiness=!out->manual_not_ready?"READY":!strcmp(out->manual_not_ready,"STATE_PREPARING")?"PREPARING":"NOT_READY";
 out->auto_reason=ac.auto_reason;out->nearest_m=ac.nearest_m;
 out->auto_state=out->manual_state="idle";
 if(!out->control_valid)return;
 /* Input readiness is distinct from a failed calculation. */
 bool auto_failed=ac.reason&&(!strcmp(ac.reason,"CALCULATION_FAILED")||!strcmp(ac.reason,"OUTPUT_INVALID"));
 bool manual_failed=mc.reason&&(!strcmp(mc.reason,"CALCULATION_FAILED")||!strcmp(mc.reason,"OUTPUT_INVALID"));
 out->auto_state=auto_failed?"error":
  (out->locally_active&&out->mode==DRIVE_AUTO?"active":"standby");
 out->manual_state=manual_failed?"error":
  (out->locally_active&&out->mode==DRIVE_MANUAL?"active":"standby");
 if(out->mode==DRIVE_AUTO){out->v_mps=ac.v_mps;out->steer_rad=ac.steer_rad;}
 else if(out->mode==DRIVE_MANUAL){out->v_mps=mc.v_mps;out->steer_rad=mc.steer_rad;}
}
```

## src/controller.h
```c
/* SPDX-License-Identifier: Apache-2.0 */
/* One firmware, two existing calculations. Selection is Gateway-owned; this
 * adapter validates generations and never elects itself or changes algorithms. */
#ifndef XENOVA_DRIVE_CONTROLLER_H
#define XENOVA_DRIVE_CONTROLLER_H
#include "adapter.h"
#include <xenova/health.h>

enum drive_mode { DRIVE_STOP, DRIVE_AUTO, DRIVE_MANUAL };
struct drive_controller {
 struct auto_cfg auto_cfg;
 struct manual_cfg manual_cfg;
 struct drive_adapter automatic,manual;
 struct xm_vehicle_control accepted;
 bool seen_control;
 /* One calculation owner's immutable per-cycle evidence; never MQTT/Store. */
 int (*clock_us)(uint64_t *);
 const struct xdr_snapshot *resources;
 uint64_t deadline_us, resource_uptime_ms;
 int resource_rc;
};
struct drive_result {
 enum drive_mode mode;
 bool control_valid, locally_active;
 uint32_t generation;
 float v_mps, steer_rad;
 const char *auto_state, *manual_state;
 enum auto_reason auto_reason;
 float nearest_m;
 uint64_t auto_progress,manual_progress;
 const char *auto_readiness,*manual_readiness,*auto_not_ready,*manual_not_ready;
 struct xdh_health auto_health,manual_health;
};
/* One coordinator's bounded repeat-attempt metadata, never a delivery ACK. */
struct drive_command_context {
 uint64_t control_revision,connection_revision,lifetime;
 uint32_t generation;
 enum drive_mode mode;
 char app_instance[XM_UUID_LEN+1];
};
struct drive_command_gate {
 struct drive_command_context context;
 uint64_t check;
 char reason[65];
 bool restricted;
};
/* First restricted exact-zero result or changed context/reason is immediate.
 * Same restriction retries at each existing supervisor check. A true return
 * permits an attempt only: mailbox rejection/TX loss is not cached success.
 * Valid results (including neutral zero) and uncacheable inputs always pass. */
bool drive_command_attempt_due(struct drive_command_gate *,const struct drive_command_context *,
 uint64_t check,const char *reason,float v_mps,float steer_rad);
void drive_controller_init(struct drive_controller *);
/* Enable the existing release deadline. Missing resource evidence is advisory;
 * an unverified work clock cannot certify an on-time result. */
void drive_controller_health(struct drive_controller *,int (*clock_us)(uint64_t *),
 uint64_t deadline_us,uint64_t uptime_ms,const struct xdr_snapshot *,int resource_rc);
/* Whole serial step missed the same release deadline, including adapter cost. */
void drive_controller_deadline_missed(struct drive_result *);
/* Pure existing control validation/selection; no app progress or readiness. */
void drive_controller_select(struct drive_controller *, const char *local_vm_id,
 struct xm_span control, struct drive_result *);
/* Both real calculations complete before returning. Missing/invalid/regressed
 * control produces no command; standby still computes the selected mode. */
void drive_controller_step(struct drive_controller *, const char *local_vm_id,
 struct xm_span control, struct xm_span input, int64_t input_age_ms,
 struct xm_span perception, int64_t perception_age_ms, struct drive_result *);
#endif
```

## src/lattice_app.h
```c
/* SPDX-License-Identifier: Apache-2.0 */
#ifndef XENOVA_LATTICE_APP_H
#define XENOVA_LATTICE_APP_H
#include "controller.h"
#include "workers.h"
#include "world.h"
#include <xenova/drive_io.h>
int drive_lattice_start(struct drive_controller *);
void drive_lattice_context(const struct xd_inputs *);
/* Actual worker health/deadline assessment precedes source-state export. */
void drive_lattice_completed(const struct drive_completion *);
/* 실제 completion의 원 clock seq/E/metadata로만 command3를 만든다. */
int drive_lattice_command(const struct drive_completion *,struct xm_drive_command3 *,uint64_t *original_guest_until_us);
/* 송신 시도 bookkeeping이며 실제 STOP/APPLIED 증거는 아니다. */
void drive_lattice_command_attempt(const struct drive_completion *,const struct xm_drive_command3 *);
/* Old AUTO calculation owner has joined before this poll/restart. */
int drive_lattice_reset_poll(int64_t original_deadline_ms);
void drive_lattice_adapter(struct drive_adapter *,bool manual);
int drive_lattice_join(int64_t original_deadline_ms);
/* Called by the state I/O owner. Builds a real completed-path snapshot only;
 * no timer creates calculation progress and no ownership is granted here. */
int drive_lattice_snapshot(dw_state *);
void drive_lattice_report(void);
#endif
```

## src/lattice_memory.c
```c
/* SPDX-License-Identifier: Apache-2.0 */
/* No payload copying/scanning, no transport, no readiness or progress effects. */
#include "lattice_memory.h"
#include <xenova/diagnostics.h>
#include <errno.h>
#if defined(CONFIG_XENOVA_DRIVE_WORKERS) && defined(CONFIG_XENOVA_DRIVE_RUNTIME)
#include "workers.h"
#include <xenova/drive_io.h>
#define MANUAL_MEMORY 1
#endif
static void memory_observe(struct xdr_app_region out[XDR_APP_REGIONS],struct xdr_app_buffer detail[XDR_MANUAL_REGIONS],void *context){
 struct drive_engine *e=context;
 for(unsigned i=0;i<XDR_AUTO_REGIONS;i++){
  struct dw_memory m={0};enum de_result rc=de_memory_read(e,i,&m);
  out[i]=(struct xdr_app_region){.rc=rc==DE_BUSY?-EBUSY:rc?-EIO:0,
   .reserved=m.reserved,.capacity=m.capacity,.used=m.used,.peak=m.peak,
   .exhausted=m.exhausted,.contention=m.contention};
 }
#if defined(MANUAL_MEMORY)
 int rc=xd_io_memory_read(&out[4],&detail[0]);
 if(rc)out[4].rc=rc;
 rc=drive_workers_memory_read(&out[5],&detail[1]);
 if(rc)for(unsigned i=5;i<XDR_APP_REGIONS;i++)out[i].rc=rc;
#else
 (void)detail;
#endif
}
int drive_lattice_memory_register(struct drive_engine *engine){
 if(!engine)return -EINVAL;
 return xdiag_app_memory_register(memory_observe,engine,
#if defined(MANUAL_MEMORY)
 XDR_APP_REGIONS
#else
 XDR_AUTO_REGIONS
#endif
 );
}
```

## src/lattice_memory.h
```c
/* SPDX-License-Identifier: Apache-2.0 */
/* Boot-lifetime, metadata-only Diagnostics bridge for the actual app owners. */
#ifndef XENOVA_LATTICE_MEMORY_H
#define XENOVA_LATTICE_MEMORY_H
#include "engine.h"
int drive_lattice_memory_register(struct drive_engine *);
#endif
```
