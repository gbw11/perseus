## platform/apps/common/xenova-drive-runtime/Kconfig
```kconfig
# SPDX-License-Identifier: Apache-2.0
config XENOVA_DRIVE_RUNTIME
	bool "Existing drive apps: common diagnostics and transport lifecycle"
	depends on XENOVA_DIAGNOSTICS && XENOVA_TELEMETRY && XENOVA_MQTT
	select XENOVA_MQTT_BOUNDED_IO

if XENOVA_DRIVE_RUNTIME
config XENOVA_DRIVE_IO_PRIORITY
	int "v1 communication worker ordinary preemptive priority"
	range 0 14
	default 8
	help
	  Separate bounded I/O owner, not a real-time scheduling guarantee.

config XENOVA_DRIVE_COMMAND_MAX_AGE_MS
	int "Maximum unsent command candidate age (ms)"
	range 1 1000
	default 200
	help
	  Provisional local queue limit, separate from the 20ms release and socket
	  timeout. Fresh-input motion also expires at the original input deadline.
	  Final Gateway control/generation validation remains necessary.

config XENOVA_DRIVE_RECORDER
	bool "Optional bounded experiment recorder and console pages"
	default y if XENOVA_DRIVE_NATIVE_TEST
	default n
	help
	  Keep source and transmission rows only for an explicitly selected
	  experiment build. Runtime health, timing and shutdown remain available
	  without these arrays. This does not enable periodic console output.

config XENOVA_DRIVE_CAPTURE_ROWS
	int "Bounded source measurement rows (never overwrite)"
	depends on XENOVA_DRIVE_RECORDER
	range 128 16384
	default 12288
	help
	  Local experimental observer, not a new MQTT metric or driving algorithm.
	  At 50Hz this holds a 180s window; overflow is explicit, never hidden.

config XENOVA_DRIVE_NATIVE_TEST
	bool "Runtime-file bootstrap and bounded native test exit"
	depends on ARCH_POSIX
	default n

config XENOVA_DRIVE_WORKERS
	bool "Independent app calculation-owner foundation"
	default n
	help
	  Local app execution building block. This does not change the verified
	  MQTT readiness profile or activate warm Standby automatically.

config XENOVA_AUTO_DELAY_INJECTION
	bool "Test-only AUTO calculation delay injection"
	depends on XENOVA_DRIVE_WORKERS
	default n
	help
	  Subscribes drive-v1 to the VM command topic for bounded auto_delay demo
	  commands and adds a busy-wait after the real AUTO calculation. The existing
	  calculation health/lifecycle restricts the affected app; this injector
	  does not declare a VM trust failure. This is a test fault
	  injector, not an operating driving policy, and is excluded from normal builds.

config XENOVA_DRIVE_WARM
	bool "Explicit warm-drive-1 app lifecycle profile"
	depends on XENOVA_DRIVE_WORKERS
	default n
	help
	  Requires matching root Bootstrap, per-app binding and Gateway/Worker
	  consumers. Waiting qualification is not calculation or output permission.
	  The 100ms supervisor/300ms lease are bounded foundation test settings,
	  not acceptance of a future stateful driving algorithm or vehicle timing.

config XENOVA_DRIVE_APP_STOP_MS
	int "Warm profile local app cleanup allowance (ms)"
	depends on XENOVA_DRIVE_WARM
	range 20 1000
	default 500
	help
	  Foundation test allowance for a root-requested app reset. Expiry retains
	  resources and reports failure; it never grants abort or another attempt.

config XENOVA_DRIVE_LATTICE
	bool "Explicit bounded lattice/tracker product profile"
	depends on XENOVA_DRIVE_WARM
	default n
	help
	  Requires an explicit generated vehicle/resource profile and separate
	  binary world/state inputs. No operating vehicle values are inferred.

if XENOVA_DRIVE_WORKERS
config XENOVA_DRIVE_WORKER_STACK_SIZE
	int "Reserved stack bytes per calculation owner"
	range 4096 32768
	default 8192
config XENOVA_DRIVE_AUTO_PRIORITY
	int "Preemptible AUTO calculation priority"
	range 0 14
	default 10
config XENOVA_DRIVE_MANUAL_PRIORITY
	int "Preemptible MANUAL calculation priority"
	range 0 14
	default 6
endif
endif
```

## platform/apps/common/xenova-mqtt-c/zephyr/Kconfig
```kconfig
# SPDX-License-Identifier: Apache-2.0
config XENOVA_MQTT
	bool "Xenova MQTT contract v1 client (xenova_mqtt C)"
	depends on NETWORKING && NET_SOCKETS && MQTT_LIB
	help
	  Topic, policy, envelope and seq rules of docs/contracts/mqtt-contract-v1.md
	  over Zephyr net/mqtt. No dynamic memory. One thread owns a client.

if XENOVA_MQTT

config XENOVA_MQTT_BOUNDED_IO
	bool "Use the shared deadline-bounded TCP transport"
	depends on XENOVA_TELEMETRY
	help
	  Separate socket state per client; reuses Publisher's Zephyr transport.
	  Connect/send/read are bounded, including broker absence during quiesce.

config XENOVA_MQTT_IO_MS
	int "Maximum v1 socket operation budget (ms)"
	depends on XENOVA_MQTT_BOUNDED_IO
	range 1 250
	default 250
	help
	  This is a network I/O deadline, not the driving release period. A connect
	  can consume this budget; actual skipped releases/lateness stay observable.

config XENOVA_MQTT_RX_BUF
	int "MQTT receive buffer bytes"
	default 1280
	help
	  Must hold the largest subscribed message (driving topics are 1 KB).

config XENOVA_MQTT_TX_BUF
	int "MQTT transmit buffer bytes"
	default 1280

config XENOVA_MQTT_MAX_SUBS
	int "Subscriptions per client"
	default 4

config XENOVA_MQTT_LATEST_SLOTS
	int "Latest-only message slots per client"
	default 4

config XENOVA_MQTT_PUB_TOPICS
	int "Published topics with their own seq counter"
	default 4

endif
```

## platform/guests/zephyr/diagnostics/Kconfig
```kconfig
# SPDX-License-Identifier: Apache-2.0
menuconfig XENOVA_DIAGNOSTICS
	bool "Xenova local diagnostics"
	help
	  Bounded, transport-independent boot/error snapshots and timing hooks.
	  No MQTT, automatic thread scans, fatal-handler override or VM control.

if XENOVA_DIAGNOSTICS
config XENOVA_DIAGNOSTICS_CPU
	bool "Single-vCPU guest runtime windows and thread lifetimes"
	depends on !SMP
	select THREAD_RUNTIME_STATS
	select THREAD_MONITOR
	select THREAD_NAME
	select TRACING
	default y if BOARD_XENVM || BOARD_NATIVE_SIM
	help
	  Frozen Zephyr usage API, 200 ms cached collection, no stack scan.
	  Finite-width accounting gaps are invalidated rather than repaired.

config XENOVA_DIAGNOSTICS_POOLS
	bool "Fixed network data pool payload occupancy"
	depends on NETWORKING && NET_BUF_FIXED_DATA_SIZE
	select NET_BUF_POOL_USAGE
	default y

config XENOVA_DIAGNOSTICS_TIMING
	bool "64-bit cycle clock and periodic work measurements"
	depends on TIMER_HAS_64BIT_CYCLE_COUNTER
	default y

config XENOVA_DIAGNOSTICS_THREADS
	bool "On-demand thread/stack snapshots"
	default y
	select THREAD_MONITOR
	select THREAD_NAME
	select THREAD_STACK_INFO
	select INIT_STACKS
	help
	  Uses the same stack-space API as Thread Analyzer but preserves errors.
	  Scanning is intrusive; do not request it during jitter measurements.

config XENOVA_DIAGNOSTICS_MAX_THREADS
	int "Maximum thread rows in a snapshot"
	range 1 32
	default 16

config XENOVA_DIAGNOSTICS_STACK_SCAN_LIMIT
	int "Maximum stack bytes scanned per thread"
	range 256 65536
	default 16384

config XENOVA_DIAGNOSTICS_HEAP
	bool "Kernel system heap statistics (frozen Zephyr 4.4 adapter)"
	depends on HEAP_MEM_POOL_SIZE > 0
	select SYS_HEAP_RUNTIME_STATS
	default y
endif

choice TRACING_FORMAT_CHOICE
	default TRACING_USER if XENOVA_DIAGNOSTICS_CPU
endchoice
```

## platform/guests/zephyr/diagnostics/tests/zephyr-app/testcase.yaml
```yaml
tests:
  xenova.diagnostics.default:
    platform_allow: native_sim/native/64
    tags: xenova diagnostics
  xenova.diagnostics.unavailable:
    platform_allow: native_sim/native/64
    tags: xenova diagnostics
    extra_configs:
      - CONFIG_XENOVA_DIAGNOSTICS_THREADS=n
      - CONFIG_XENOVA_DIAGNOSTICS_HEAP=n
      - CONFIG_XENOVA_DIAGNOSTICS_TIMING=n
  xenova.diagnostics.truncated:
    platform_allow: native_sim/native/64
    tags: xenova diagnostics
    extra_configs:
      - CONFIG_XENOVA_DIAGNOSTICS_MAX_THREADS=1
      - CONFIG_XENOVA_DIAGNOSTICS_STACK_SCAN_LIMIT=256
```

## platform/guests/zephyr/telemetry/Kconfig
```kconfig
# SPDX-License-Identifier: Apache-2.0
menuconfig XENOVA_TELEMETRY
	bool "Xenova Telemetry Publisher 2.0"
	depends on XENOVA_DIAGNOSTICS && NETWORKING && NET_IPV4 && NET_TCP
	select MQTT_LIB
	select MQTT_LIB_CUSTOM_TRANSPORT
	select MQTT_CLEAN_SESSION
	select JSON_LIBRARY
	help
	  Separate worker-owned MQTT client. No fixed identity, anonymous fallback,
	  v1 changes, automatic stack scanning or app-health inference.

if XENOVA_TELEMETRY
config XENOVA_TELEMETRY_STACK_SIZE
	int "Publisher worker stack bytes"
	range 8192 32768
	default 12288
config XENOVA_TELEMETRY_PRIORITY
	int "Publisher preemptible thread priority"
	range 9 14
	default 10
config XENOVA_TELEMETRY_TEST_OBSERVER
	bool "Native integration test source observer (not production output)"
	depends on ARCH_POSIX
	default n
endif
```

## platform/guests/zephyr/xen-runtime/Kconfig
```kconfig
# SPDX-License-Identifier: Apache-2.0
config XENOVA_RUNTIME
 bool "Xenova shared XenStore and cooperative shutdown"
 depends on XENOVA_XENSTORE

config XENOVA_NETFRONT
 bool "Xenova single-VIF RX-copy Ethernet"
 depends on XENOVA_RUNTIME && !XEN_GRANT_TABLE && NETWORKING && NET_L2_ETHERNET && NET_IPV4

if XENOVA_RUNTIME
config XENOVA_SHUTDOWN_BUDGET_MS
 int "Bounded application quiesce and transport cleanup budget (ms)"
 range 100 120000
 default 15000
 help
   Local transport resource budget, not a vehicle safety timeout or readiness SLA.
   Applications must validate it within the caller Manager's original deadline.

config XENOVA_SHUTDOWN_THREAD_PRIORITY
 int "Shutdown service ordinary preemptive thread priority"
 range 0 14
 default 6
 help
   Provisional application scheduling choice; no CPU pinning or RT guarantee.

config XENOVA_NETFRONT_THREAD_PRIORITY
 int "Netfront ordinary preemptive worker priority"
 depends on XENOVA_NETFRONT
 range 0 14
 default 7
 help
   Provisional application scheduling choice; measure with the actual workload.
endif
```

## platform/guests/zephyr/xen-store/Kconfig
```kconfig
# SPDX-License-Identifier: Apache-2.0
config XENOVA_XENSTORE
	bool "Xenova XenStore client"
	depends on XEN && XEN_EVENTS && ARM64 && MMU && !SMP
	help
	  Bounded XenStore wire client and read-only XenBus VIF observation.
	  The caller owns one client and serializes lifecycle operations.
```

## platform/yocto/meta-perseus/conf/layer.conf
```bitbake
# Perseus project-specific Yocto layer

BBPATH .= ":${LAYERDIR}"

BBFILES += "${LAYERDIR}/recipes-*/*/*.bb \
            ${LAYERDIR}/recipes-*/*/*.bbappend"

BBFILE_COLLECTIONS += "perseus"
BBFILE_PATTERN_perseus = "^${LAYERDIR}/"
BBFILE_PRIORITY_perseus = "8"

LAYERSERIES_COMPAT_perseus = "wrynose"
```

## platform/yocto/meta-zenova/conf/layer.conf
```bitbake
# Zenova project-specific Yocto layer

BBPATH .= ":${LAYERDIR}"

BBFILES += "${LAYERDIR}/recipes-*/*/*.bb \
            ${LAYERDIR}/recipes-*/*/*.bbappend"

BBFILE_COLLECTIONS += "zenova"
BBFILE_PATTERN_zenova = "^${LAYERDIR}/"
BBFILE_PRIORITY_zenova = "8"

LAYERSERIES_COMPAT_zenova = "wrynose"
```
